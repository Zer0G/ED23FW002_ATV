/* ASAP2 file for OpenECU and ETAS INCA calibration tool.
* Auto-generated from 'capi.py' (version 3.2.0-FS r2022-1) at Wed Feb 21 16:56:46 2024 (local time).
* Information taken from:
* ATV.dde_group.tmp
* automatic library DDEs
*/
ASAP2_VERSION 1 31
/begin PROJECT New_model_v1.8.2_M560_000 "(none)"
/begin HEADER "(none)" VERSION "1_8_2" /end HEADER
/begin MODULE OpenECU_M560_000 ""
/begin MOD_PAR ""
 /begin MEMORY_SEGMENT Strategy "Strategy/application code" CODE FLASH INTERN 0x1040000 0x240000 -1 -1 -1 -1 -1 /end MEMORY_SEGMENT
 /begin MEMORY_SEGMENT Calibration "Calibration data" DATA FLASH INTERN 0x1000000 0x20400 -1 -1 -1 -1 -1 /end MEMORY_SEGMENT
/end MOD_PAR
/begin IF_DATA ASAP1B_CCP
 /begin SOURCE "10_ms" 3 10 /* Rate in Scaling Unit: 10*1 ms */ /begin QP_BLOB 0 LENGTH 30 CAN_ID_FIXED 1784 RASTER 2 FIRST_PID 0 /end QP_BLOB /end SOURCE
 /begin SOURCE "100_ms" 3 100 /* Rate in Scaling Unit: 100*1 ms */ /begin QP_BLOB 1 LENGTH 30 CAN_ID_FIXED 1784 RASTER 5 FIRST_PID 30 /end QP_BLOB /end SOURCE
 /begin SOURCE "200_ms" 3 200 /* Rate in Scaling Unit: 200*1 ms */ /begin QP_BLOB 2 LENGTH 30 CAN_ID_FIXED 1784 RASTER 6 FIRST_PID 60 /end QP_BLOB /end SOURCE
 /begin SOURCE "1000_ms" 3 1000 /* Rate in Scaling Unit: 1000*1 ms */ /begin QP_BLOB 3 LENGTH 30 CAN_ID_FIXED 1784 RASTER 8 FIRST_PID 90 /end QP_BLOB /end SOURCE
 /begin RASTER "Time synchronous event channel - 10 ms" "10_ms" 2 /* Raster 2 (Reference from signal SOURCE)*/ 3 10 /* Rate in Scaling Unit: 10*1 ms */ /end RASTER
 /begin RASTER "Time synchronous event channel - 100 ms" "100_ms" 5 /* Raster 5 (Reference from signal SOURCE)*/ 3 100 /* Rate in Scaling Unit: 100*1 ms */ /end RASTER
 /begin RASTER "Time synchronous event channel - 200 ms" "200_ms" 6 /* Raster 6 (Reference from signal SOURCE)*/ 3 200 /* Rate in Scaling Unit: 200*1 ms */ /end RASTER
 /begin RASTER "Time synchronous event channel - 1000 ms" "1000_ms" 8 /* Raster 8 (Reference from signal SOURCE)*/ 3 1000 /* Rate in Scaling Unit: 1000*1 ms */ /end RASTER
 /begin TP_BLOB /* CCP version */ 0x201 /* Blob version */ 0x202 /* CAN msg ID - send */ 1785 /* CAN msg ID - recv */ 1784 /* station address */ 0 /* byte order */ 1
  /begin CAN_PARAM /* crystal frequency */ 0x1F4 /* timing register 0 */ 0x41 /* timing register 1 */ 0x25 /end CAN_PARAM
  /* Global measurement mode settings */ DAQ_MODE BURST CONSISTENCY ODT ADDRESS_EXTENSION ODT
  /begin CHECKSUM_PARAM /* algorithm */ 0x8006 /* limit */ 0xFFFFFFFF CHECKSUM_CALCULATION ACTIVE_PAGE /end CHECKSUM_PARAM
  /begin DEFINED_PAGES 1 "reference page" /* address ext. */ 0x0 /* base address */ 0x1000000 /* page length */ 0x257a FLASH /end DEFINED_PAGES
  /begin DEFINED_PAGES 2 "working page" /* address ext. */ 0x0 /* base address */ 0x9000000 /* page length */ 0x257a RAM RAM_INIT_BY_ECU /end DEFINED_PAGES
  OPTIONAL_CMD 0x08 /* START_STOP_ALL */ OPTIONAL_CMD 0x09 /* GET_CAL_PAGE */ OPTIONAL_CMD 0x0C /* SET_S_STATUS */ OPTIONAL_CMD 0x0D /* GET_S_STATUS */ OPTIONAL_CMD 0x0E /* BUILD_CHKSUM */ OPTIONAL_CMD 0x0F /* SHORT_UP */ OPTIONAL_CMD 0x10 /* CLEAR_MEMORY */ OPTIONAL_CMD 0x11 /* SET_CAL_PAGE */ OPTIONAL_CMD 0x18 /* PROGRAM */ OPTIONAL_CMD 0x23 /* DNLOAD_6 */ OPTIONAL_CMD 0x22 /* PROGRAM_6 */ /end TP_BLOB
/end IF_DATA
/* Scalar measurable for DDE 'atv_12v'. */
/begin MEASUREMENT atv_12v "12V level (V)" FLOAT32_IEEE CU_ATV_12V 1 100 0.0 0.0 ECU_ADDRESS 0x4002288c BYTE_ORDER MSB_FIRST /end MEASUREMENT
/begin COMPU_METHOD CU_ATV_12V "Conversion method for atv_12v" RAT_FUNC "%10.3" "V" COEFFS 0.000000 1.000000 0.000000 0.000000 0.000000 1.000000 /end COMPU_METHOD
/* Scalar measurable for DDE 'atv_4wd_din'. */
/begin MEASUREMENT atv_4wd_din "2WD/4WD Selector" UBYTE CU_ATV_4WD_DIN 1 100 0.0 1.0 ECU_ADDRESS 0x40022955 BYTE_ORDER MSB_FIRST /end MEASUREMENT
/begin COMPU_METHOD CU_ATV_4WD_DIN "Conversion method for atv_4wd_din" RAT_FUNC "%10.0" "one" COEFFS 0.000000 1.000000 0.000000 0.000000 0.000000 1.000000 /end COMPU_METHOD
/* Scalar measurable for DDE 'atv_GenCurrentSetPoint'. */
/begin MEASUREMENT atv_GenCurrentSetPoint "Generator Current Set Point" SWORD CU_ATV_GENCURRENTSETPOINT 1 100 0.0 0.0 ECU_ADDRESS 0x40022928 BYTE_ORDER MSB_FIRST /end MEASUREMENT
/begin COMPU_METHOD CU_ATV_GENCURRENTSETPOINT "Conversion method for atv_GenCurrentSetPoint" RAT_FUNC "%10.0" "A" COEFFS 0.000000 1.000000 0.000000 0.000000 0.000000 1.000000 /end COMPU_METHOD
/* Scalar measurable for DDE 'atv_GenSelProcessed'. */
/begin MEASUREMENT atv_GenSelProcessed "Generator Selector Position" UBYTE CU_ATV_GENSELPROCESSED 1 100 0.0 0.0 ECU_ADDRESS 0x4002292e BYTE_ORDER MSB_FIRST /end MEASUREMENT
/begin COMPU_METHOD CU_ATV_GENSELPROCESSED "Conversion method for atv_GenSelProcessed" RAT_FUNC "%10.0" "one" COEFFS 0.000000 1.000000 0.000000 0.000000 0.000000 1.000000 /end COMPU_METHOD
/* Scalar measurable for DDE 'atv_HandBrakePos'. */
/begin MEASUREMENT atv_HandBrakePos "Hand Brake Lock Position" FLOAT32_IEEE CU_ATV_HANDBRAKEPOS 1 100 0.0 0.0 ECU_ADDRESS 0x40022880 BYTE_ORDER MSB_FIRST /end MEASUREMENT
/begin COMPU_METHOD CU_ATV_HANDBRAKEPOS "Conversion method for atv_HandBrakePos" RAT_FUNC "%10.3" "V" COEFFS 0.000000 1.000000 0.000000 0.000000 0.000000 1.000000 /end COMPU_METHOD
/* Scalar measurable for DDE 'atv_HandBrakeStatus'. */
/begin MEASUREMENT atv_HandBrakeStatus "Hand Brake Status" UBYTE CU_ATV_HANDBRAKESTATUS 1 100 0.0 1.0 ECU_ADDRESS 0x40022954 BYTE_ORDER MSB_FIRST /end MEASUREMENT
/begin COMPU_METHOD CU_ATV_HANDBRAKESTATUS "Conversion method for atv_HandBrakeStatus" RAT_FUNC "%10.0" "one" COEFFS 0.000000 1.000000 0.000000 0.000000 0.000000 1.000000 /end COMPU_METHOD
/* Scalar measurable for DDE 'atv_ICE_Start_Timer'. */
/begin MEASUREMENT atv_ICE_Start_Timer "ICE restart Timer [s]" SLONG CU_ATV_ICE_START_TIMER 1 100 0.0 0.0 ECU_ADDRESS 0x400228c8 BYTE_ORDER MSB_FIRST /end MEASUREMENT
/begin COMPU_METHOD CU_ATV_ICE_START_TIMER "Conversion method for atv_ICE_Start_Timer" RAT_FUNC "%10.0" "sec" COEFFS 0.000000 1.000000 0.000000 0.000000 0.000000 1.000000 /end COMPU_METHOD
/* Scalar measurable for DDE 'atv_ICE_Start_Timer_Valid'. */
/begin MEASUREMENT atv_ICE_Start_Timer_Valid "ICE restart Timer Valid (Boolean)" UBYTE CU_ATV_ICE_START_TIMER_VALID 1 100 0.0 1.0 ECU_ADDRESS 0x40022958 BYTE_ORDER MSB_FIRST /end MEASUREMENT
/begin COMPU_METHOD CU_ATV_ICE_START_TIMER_VALID "Conversion method for atv_ICE_Start_Timer_Valid" RAT_FUNC "%10.0" "one" COEFFS 0.000000 1.000000 0.000000 0.000000 0.000000 1.000000 /end COMPU_METHOD
/* Scalar measurable for DDE 'atv_IceFault'. */
/begin MEASUREMENT atv_IceFault "Ice Fault  (Boolean)" UBYTE CU_ATV_ICEFAULT 1 100 0.0 1.0 ECU_ADDRESS 0x4002295f BYTE_ORDER MSB_FIRST /end MEASUREMENT
/begin COMPU_METHOD CU_ATV_ICEFAULT "Conversion method for atv_IceFault" RAT_FUNC "%10.0" "one" COEFFS 0.000000 1.000000 0.000000 0.000000 0.000000 1.000000 /end COMPU_METHOD
/* Scalar measurable for DDE 'atv_IceKey_out'. */
/begin MEASUREMENT atv_IceKey_out "Ice Ignition  (Boolean)" UBYTE CU_ATV_ICEKEY_OUT 1 100 0.0 1.0 ECU_ADDRESS 0x4002295c BYTE_ORDER MSB_FIRST /end MEASUREMENT
/begin COMPU_METHOD CU_ATV_ICEKEY_OUT "Conversion method for atv_IceKey_out" RAT_FUNC "%10.0" "one" COEFFS 0.000000 1.000000 0.000000 0.000000 0.000000 1.000000 /end COMPU_METHOD
/* Scalar measurable for DDE 'atv_IceOn'. */
/begin MEASUREMENT atv_IceOn "Ice Status  (Boolean)" UBYTE CU_ATV_ICEON 1 100 0.0 1.0 ECU_ADDRESS 0x4002295e BYTE_ORDER MSB_FIRST /end MEASUREMENT
/begin COMPU_METHOD CU_ATV_ICEON "Conversion method for atv_IceOn" RAT_FUNC "%10.0" "one" COEFFS 0.000000 1.000000 0.000000 0.000000 0.000000 1.000000 /end COMPU_METHOD
/* Scalar measurable for DDE 'atv_IceRG'. */
/begin MEASUREMENT atv_IceRG "Debug Reg Ice" UBYTE CU_ATV_ICERG 1 100 0.0 0.0 ECU_ADDRESS 0x4002293b BYTE_ORDER MSB_FIRST /end MEASUREMENT
/begin COMPU_METHOD CU_ATV_ICERG "Conversion method for atv_IceRG" RAT_FUNC "%10.0" "one" COEFFS 0.000000 1.000000 0.000000 0.000000 0.000000 1.000000 /end COMPU_METHOD
/* Scalar measurable for DDE 'atv_IceSM'. */
/begin MEASUREMENT atv_IceSM "Debug Start Ice" UBYTE CU_ATV_ICESM 1 100 0.0 0.0 ECU_ADDRESS 0x4002293a BYTE_ORDER MSB_FIRST /end MEASUREMENT
/begin COMPU_METHOD CU_ATV_ICESM "Conversion method for atv_IceSM" RAT_FUNC "%10.0" "one" COEFFS 0.000000 1.000000 0.000000 0.000000 0.000000 1.000000 /end COMPU_METHOD
/* Scalar measurable for DDE 'atv_IceShutdown_out'. */
/begin MEASUREMENT atv_IceShutdown_out "Ice Status  (Boolean)" UBYTE CU_ATV_ICESHUTDOWN_OUT 1 100 0.0 1.0 ECU_ADDRESS 0x4002295d BYTE_ORDER MSB_FIRST /end MEASUREMENT
/begin COMPU_METHOD CU_ATV_ICESHUTDOWN_OUT "Conversion method for atv_IceShutdown_out" RAT_FUNC "%10.0" "one" COEFFS 0.000000 1.000000 0.000000 0.000000 0.000000 1.000000 /end COMPU_METHOD
/* Scalar measurable for DDE 'atv_PumpAFault'. */
/begin MEASUREMENT atv_PumpAFault "Pump A Disabled" UBYTE CU_ATV_PUMPAFAULT 1 100 0.0 1.0 ECU_ADDRESS 0x40022961 BYTE_ORDER MSB_FIRST /end MEASUREMENT
/begin COMPU_METHOD CU_ATV_PUMPAFAULT "Conversion method for atv_PumpAFault" RAT_FUNC "%10.0" "one" COEFFS 0.000000 1.000000 0.000000 0.000000 0.000000 1.000000 /end COMPU_METHOD
/* Scalar measurable for DDE 'atv_PumpBFault'. */
/begin MEASUREMENT atv_PumpBFault "Pump B Disabled" UBYTE CU_ATV_PUMPBFAULT 1 100 0.0 1.0 ECU_ADDRESS 0x40022960 BYTE_ORDER MSB_FIRST /end MEASUREMENT
/begin COMPU_METHOD CU_ATV_PUMPBFAULT "Conversion method for atv_PumpBFault" RAT_FUNC "%10.0" "one" COEFFS 0.000000 1.000000 0.000000 0.000000 0.000000 1.000000 /end COMPU_METHOD
/* Scalar measurable for DDE 'atv_RPM_Gen'. */
/begin MEASUREMENT atv_RPM_Gen "Generator Speed [RPM]" SWORD CU_ATV_RPM_GEN 1 100 0.0 0.0 ECU_ADDRESS 0x4002291a BYTE_ORDER MSB_FIRST /end MEASUREMENT
/begin COMPU_METHOD CU_ATV_RPM_GEN "Conversion method for atv_RPM_Gen" RAT_FUNC "%10.0" "RPM" COEFFS 0.000000 1.000000 0.000000 0.000000 0.000000 1.000000 /end COMPU_METHOD
/* Scalar measurable for DDE 'atv_RegMapSelProcessed'. */
/begin MEASUREMENT atv_RegMapSelProcessed "Regen Map Selector Position" UBYTE CU_ATV_REGMAPSELPROCESSED 1 100 0.0 0.0 ECU_ADDRESS 0x40022932 BYTE_ORDER MSB_FIRST /end MEASUREMENT
/begin COMPU_METHOD CU_ATV_REGMAPSELPROCESSED "Conversion method for atv_RegMapSelProcessed" RAT_FUNC "%10.0" "one" COEFFS 0.000000 1.000000 0.000000 0.000000 0.000000 1.000000 /end COMPU_METHOD
/* Scalar measurable for DDE 'atv_TRad_in'. */
/begin MEASUREMENT atv_TRad_in "Radiator Temperature" SWORD CU_ATV_TRAD_IN 1 100 0.0 0.0 ECU_ADDRESS 0x40022922 BYTE_ORDER MSB_FIRST /end MEASUREMENT
/begin COMPU_METHOD CU_ATV_TRAD_IN "Conversion method for atv_TRad_in" RAT_FUNC "%10.0" "degree_Celsius" COEFFS 0.000000 1.000000 0.000000 0.000000 0.000000 1.000000 /end COMPU_METHOD
/* Scalar measurable for DDE 'atv_TRad_out'. */
/begin MEASUREMENT atv_TRad_out "Radiator Temperature" SWORD CU_ATV_TRAD_OUT 1 100 0.0 0.0 ECU_ADDRESS 0x4002291e BYTE_ORDER MSB_FIRST /end MEASUREMENT
/begin COMPU_METHOD CU_ATV_TRAD_OUT "Conversion method for atv_TRad_out" RAT_FUNC "%10.0" "degree_Celsius" COEFFS 0.000000 1.000000 0.000000 0.000000 0.000000 1.000000 /end COMPU_METHOD
/* Scalar measurable for DDE 'atv_T_Air'. */
/begin MEASUREMENT atv_T_Air "Air Temperature" SWORD CU_ATV_T_AIR 1 100 0.0 0.0 ECU_ADDRESS 0x40022918 BYTE_ORDER MSB_FIRST /end MEASUREMENT
/begin COMPU_METHOD CU_ATV_T_AIR "Conversion method for atv_T_Air" RAT_FUNC "%10.0" "degree_Celsius" COEFFS 0.000000 1.000000 0.000000 0.000000 0.000000 1.000000 /end COMPU_METHOD
/* Scalar measurable for DDE 'atv_T_ICE'. */
/begin MEASUREMENT atv_T_ICE "Generator Motor Temperature [°C]" SWORD CU_ATV_T_ICE 1 100 0.0 0.0 ECU_ADDRESS 0x4002291c BYTE_ORDER MSB_FIRST /end MEASUREMENT
/begin COMPU_METHOD CU_ATV_T_ICE "Conversion method for atv_T_ICE" RAT_FUNC "%10.0" "degree_Celsius" COEFFS 0.000000 1.000000 0.000000 0.000000 0.000000 1.000000 /end COMPU_METHOD
/* Scalar measurable for DDE 'atv_app_code_day'. */
/begin MEASUREMENT atv_app_code_day "Day the application code was built." UWORD CU_ATV_APP_CODE_DAY 1 100 0.0 0.0 ECU_ADDRESS 0x400228e8 BYTE_ORDER MSB_FIRST /end MEASUREMENT
/begin COMPU_METHOD CU_ATV_APP_CODE_DAY "Conversion method for atv_app_code_day" RAT_FUNC "%10.0" "one" COEFFS 0.000000 1.000000 0.000000 0.000000 0.000000 1.000000 /end COMPU_METHOD
/* Scalar measurable for DDE 'atv_app_code_major_ver'. */
/begin MEASUREMENT atv_app_code_major_ver "Major version of the application code." UWORD CU_ATV_APP_CODE_MAJOR_VER 1 100 0.0 0.0 ECU_ADDRESS 0x400228ea BYTE_ORDER MSB_FIRST /end MEASUREMENT
/begin COMPU_METHOD CU_ATV_APP_CODE_MAJOR_VER "Conversion method for atv_app_code_major_ver" RAT_FUNC "%10.0" "one" COEFFS 0.000000 1.000000 0.000000 0.000000 0.000000 1.000000 /end COMPU_METHOD
/* Scalar measurable for DDE 'atv_app_code_minor_ver'. */
/begin MEASUREMENT atv_app_code_minor_ver "Minor version of the application code." UWORD CU_ATV_APP_CODE_MINOR_VER 1 100 0.0 0.0 ECU_ADDRESS 0x400228ec BYTE_ORDER MSB_FIRST /end MEASUREMENT
/begin COMPU_METHOD CU_ATV_APP_CODE_MINOR_VER "Conversion method for atv_app_code_minor_ver" RAT_FUNC "%10.0" "one" COEFFS 0.000000 1.000000 0.000000 0.000000 0.000000 1.000000 /end COMPU_METHOD
/* Scalar measurable for DDE 'atv_app_code_month'. */
/begin MEASUREMENT atv_app_code_month "Month the application code was built." UWORD CU_ATV_APP_CODE_MONTH 1 100 0.0 0.0 ECU_ADDRESS 0x400228e6 BYTE_ORDER MSB_FIRST /end MEASUREMENT
/begin COMPU_METHOD CU_ATV_APP_CODE_MONTH "Conversion method for atv_app_code_month" RAT_FUNC "%10.0" "one" COEFFS 0.000000 1.000000 0.000000 0.000000 0.000000 1.000000 /end COMPU_METHOD
/* Scalar measurable for DDE 'atv_app_code_subminor_ver'. */
/begin MEASUREMENT atv_app_code_subminor_ver "Sub-minor version of the application code." UWORD CU_ATV_APP_CODE_SUBMINOR_VER 1 100 0.0 0.0 ECU_ADDRESS 0x400228ee BYTE_ORDER MSB_FIRST /end MEASUREMENT
/begin COMPU_METHOD CU_ATV_APP_CODE_SUBMINOR_VER "Conversion method for atv_app_code_subminor_ver" RAT_FUNC "%10.0" "one" COEFFS 0.000000 1.000000 0.000000 0.000000 0.000000 1.000000 /end COMPU_METHOD
/* Scalar measurable for DDE 'atv_app_code_year'. */
/begin MEASUREMENT atv_app_code_year "Year the application code was built." UWORD CU_ATV_APP_CODE_YEAR 1 100 0.0 0.0 ECU_ADDRESS 0x400228e4 BYTE_ORDER MSB_FIRST /end MEASUREMENT
/begin COMPU_METHOD CU_ATV_APP_CODE_YEAR "Conversion method for atv_app_code_year" RAT_FUNC "%10.0" "one" COEFFS 0.000000 1.000000 0.000000 0.000000 0.000000 1.000000 /end COMPU_METHOD
/* Scalar measurable for DDE 'atv_apu_req_in'. */
/begin MEASUREMENT atv_apu_req_in "APU Button (Boolean)" UBYTE CU_ATV_APU_REQ_IN 1 100 0.0 1.0 ECU_ADDRESS 0x40022945 BYTE_ORDER MSB_FIRST /end MEASUREMENT
/begin COMPU_METHOD CU_ATV_APU_REQ_IN "Conversion method for atv_apu_req_in" RAT_FUNC "%10.0" "one" COEFFS 0.000000 1.000000 0.000000 0.000000 0.000000 1.000000 /end COMPU_METHOD
/* Scalar measurable for DDE 'atv_bmsMaxChgCurr'. */
/begin MEASUREMENT atv_bmsMaxChgCurr "BMS Max allowed charge current" SWORD CU_ATV_BMSMAXCHGCURR 1 100 0.0 0.0 ECU_ADDRESS 0x40022926 BYTE_ORDER MSB_FIRST /end MEASUREMENT
/begin COMPU_METHOD CU_ATV_BMSMAXCHGCURR "Conversion method for atv_bmsMaxChgCurr" RAT_FUNC "%10.0" "A" COEFFS 0.000000 1.000000 0.000000 0.000000 0.000000 1.000000 /end COMPU_METHOD
/* Scalar measurable for DDE 'atv_bmsMaxDisCurr'. */
/begin MEASUREMENT atv_bmsMaxDisCurr "BMS Max allowed discharge current" SWORD CU_ATV_BMSMAXDISCURR 1 100 0.0 0.0 ECU_ADDRESS 0x4002292c BYTE_ORDER MSB_FIRST /end MEASUREMENT
/begin COMPU_METHOD CU_ATV_BMSMAXDISCURR "Conversion method for atv_bmsMaxDisCurr" RAT_FUNC "%10.0" "A" COEFFS 0.000000 1.000000 0.000000 0.000000 0.000000 1.000000 /end COMPU_METHOD
/* Scalar measurable for DDE 'atv_boot_code_day'. */
/begin MEASUREMENT atv_boot_code_day "Day the boot code was built." UWORD CU_ATV_BOOT_CODE_DAY 1 100 0.0 0.0 ECU_ADDRESS 0x400228f4 BYTE_ORDER MSB_FIRST /end MEASUREMENT
/begin COMPU_METHOD CU_ATV_BOOT_CODE_DAY "Conversion method for atv_boot_code_day" RAT_FUNC "%10.0" "one" COEFFS 0.000000 1.000000 0.000000 0.000000 0.000000 1.000000 /end COMPU_METHOD
/* Scalar measurable for DDE 'atv_boot_code_major_ver'. */
/begin MEASUREMENT atv_boot_code_major_ver "Major version of the boot code." UWORD CU_ATV_BOOT_CODE_MAJOR_VER 1 100 0.0 0.0 ECU_ADDRESS 0x400228f6 BYTE_ORDER MSB_FIRST /end MEASUREMENT
/begin COMPU_METHOD CU_ATV_BOOT_CODE_MAJOR_VER "Conversion method for atv_boot_code_major_ver" RAT_FUNC "%10.0" "one" COEFFS 0.000000 1.000000 0.000000 0.000000 0.000000 1.000000 /end COMPU_METHOD
/* Scalar measurable for DDE 'atv_boot_code_minor_ver'. */
/begin MEASUREMENT atv_boot_code_minor_ver "Minor version of the boot code." UWORD CU_ATV_BOOT_CODE_MINOR_VER 1 100 0.0 0.0 ECU_ADDRESS 0x400228f8 BYTE_ORDER MSB_FIRST /end MEASUREMENT
/begin COMPU_METHOD CU_ATV_BOOT_CODE_MINOR_VER "Conversion method for atv_boot_code_minor_ver" RAT_FUNC "%10.0" "one" COEFFS 0.000000 1.000000 0.000000 0.000000 0.000000 1.000000 /end COMPU_METHOD
/* Scalar measurable for DDE 'atv_boot_code_month'. */
/begin MEASUREMENT atv_boot_code_month "Month the boot code was built." UWORD CU_ATV_BOOT_CODE_MONTH 1 100 0.0 0.0 ECU_ADDRESS 0x400228f2 BYTE_ORDER MSB_FIRST /end MEASUREMENT
/begin COMPU_METHOD CU_ATV_BOOT_CODE_MONTH "Conversion method for atv_boot_code_month" RAT_FUNC "%10.0" "one" COEFFS 0.000000 1.000000 0.000000 0.000000 0.000000 1.000000 /end COMPU_METHOD
/* Scalar measurable for DDE 'atv_boot_code_subminor_ver'. */
/begin MEASUREMENT atv_boot_code_subminor_ver "Sub-minor version of the boot code." UWORD CU_ATV_BOOT_CODE_SUBMINOR_VER 1 100 0.0 0.0 ECU_ADDRESS 0x400228fa BYTE_ORDER MSB_FIRST /end MEASUREMENT
/begin COMPU_METHOD CU_ATV_BOOT_CODE_SUBMINOR_VER "Conversion method for atv_boot_code_subminor_ver" RAT_FUNC "%10.0" "one" COEFFS 0.000000 1.000000 0.000000 0.000000 0.000000 1.000000 /end COMPU_METHOD
/* Scalar measurable for DDE 'atv_boot_code_year'. */
/begin MEASUREMENT atv_boot_code_year "Year the boot code was built." UWORD CU_ATV_BOOT_CODE_YEAR 1 100 0.0 0.0 ECU_ADDRESS 0x400228f0 BYTE_ORDER MSB_FIRST /end MEASUREMENT
/begin COMPU_METHOD CU_ATV_BOOT_CODE_YEAR "Conversion method for atv_boot_code_year" RAT_FUNC "%10.0" "one" COEFFS 0.000000 1.000000 0.000000 0.000000 0.000000 1.000000 /end COMPU_METHOD
/* Scalar measurable for DDE 'atv_brake2epedal_split_actual'. */
/begin MEASUREMENT atv_brake2epedal_split_actual "Actual epedal split (map based)" SWORD CU_ATV_BRAKE2EPEDAL_SPLIT_ACTU0 1 100 0.0 0.0 ECU_ADDRESS 0x40022924 BYTE_ORDER MSB_FIRST /end MEASUREMENT
/begin COMPU_METHOD CU_ATV_BRAKE2EPEDAL_SPLIT_ACTU0 "Conversion method for atv_brake2epedal_split_actual" RAT_FUNC "%10.0" "one" COEFFS 0.000000 1.000000 0.000000 0.000000 0.000000 1.000000 /end COMPU_METHOD
/* Scalar measurable for DDE 'atv_brake_pedalX1000'. */
/begin MEASUREMENT atv_brake_pedalX1000 "Brake Input 0-1000" UWORD CU_ATV_BRAKE_PEDALX1000 1 100 0.0 0.0 ECU_ADDRESS 0x400228cc BYTE_ORDER MSB_FIRST /end MEASUREMENT
/begin COMPU_METHOD CU_ATV_BRAKE_PEDALX1000 "Conversion method for atv_brake_pedalX1000" RAT_FUNC "%10.0" "V" COEFFS 0.000000 1.000000 0.000000 0.000000 0.000000 1.000000 /end COMPU_METHOD
/* Scalar measurable for DDE 'atv_brake_pedal_digital_in'. */
/begin MEASUREMENT atv_brake_pedal_digital_in "Brake Pedal In Digital" UBYTE CU_ATV_BRAKE_PEDAL_DIGITAL_IN 1 100 0.0 1.0 ECU_ADDRESS 0x40022943 BYTE_ORDER MSB_FIRST /end MEASUREMENT
/begin COMPU_METHOD CU_ATV_BRAKE_PEDAL_DIGITAL_IN "Conversion method for atv_brake_pedal_digital_in" RAT_FUNC "%10.0" "one" COEFFS 0.000000 1.000000 0.000000 0.000000 0.000000 1.000000 /end COMPU_METHOD
/* Scalar measurable for DDE 'atv_can_wakeup'. */
/begin MEASUREMENT atv_can_wakeup "Wake On Can" UBYTE CU_ATV_CAN_WAKEUP 1 100 0.0 1.0 ECU_ADDRESS 0x40022950 BYTE_ORDER MSB_FIRST /end MEASUREMENT
/begin COMPU_METHOD CU_ATV_CAN_WAKEUP "Conversion method for atv_can_wakeup" RAT_FUNC "%10.0" "one" COEFFS 0.000000 1.000000 0.000000 0.000000 0.000000 1.000000 /end COMPU_METHOD
/* Scalar measurable for DDE 'atv_chg_present'. */
/begin MEASUREMENT atv_chg_present "Battery Charger Detected" UBYTE CU_ATV_CHG_PRESENT 1 100 0.0 1.0 ECU_ADDRESS 0x4002294f BYTE_ORDER MSB_FIRST /end MEASUREMENT
/begin COMPU_METHOD CU_ATV_CHG_PRESENT "Conversion method for atv_chg_present" RAT_FUNC "%10.0" "one" COEFFS 0.000000 1.000000 0.000000 0.000000 0.000000 1.000000 /end COMPU_METHOD
/* Scalar measurable for DDE 'atv_cpu_loading'. */
/begin MEASUREMENT atv_cpu_loading "CPU loading seen in last 50ms" UBYTE CU_ATV_CPU_LOADING 1 100 0.0 0.0 ECU_ADDRESS 0x40022935 BYTE_ORDER MSB_FIRST /end MEASUREMENT
/begin COMPU_METHOD CU_ATV_CPU_LOADING "Conversion method for atv_cpu_loading" RAT_FUNC "%10.0" "%" COEFFS 0.000000 1.000000 0.000000 0.000000 0.000000 1.000000 /end COMPU_METHOD
/* Scalar measurable for DDE 'atv_cpu_loading_max'. */
/begin MEASUREMENT atv_cpu_loading_max "Maximum CPU loading seen in any 50ms period" UBYTE CU_ATV_CPU_LOADING_MAX 1 100 0.0 0.0 ECU_ADDRESS 0x40022936 BYTE_ORDER MSB_FIRST /end MEASUREMENT
/begin COMPU_METHOD CU_ATV_CPU_LOADING_MAX "Conversion method for atv_cpu_loading_max" RAT_FUNC "%10.0" "%" COEFFS 0.000000 1.000000 0.000000 0.000000 0.000000 1.000000 /end COMPU_METHOD
/* Scalar measurable for DDE 'atv_dbg_pumpA_out'. */
/begin MEASUREMENT atv_dbg_pumpA_out "Pump A (Debug Signal)" UBYTE CU_ATV_DBG_PUMPA_OUT 1 100 0.0 1.0 ECU_ADDRESS 0x40022947 BYTE_ORDER MSB_FIRST /end MEASUREMENT
/begin COMPU_METHOD CU_ATV_DBG_PUMPA_OUT "Conversion method for atv_dbg_pumpA_out" RAT_FUNC "%10.0" "one" COEFFS 0.000000 1.000000 0.000000 0.000000 0.000000 1.000000 /end COMPU_METHOD
/* Scalar measurable for DDE 'atv_dbg_pumpB_out'. */
/begin MEASUREMENT atv_dbg_pumpB_out "Pump A (Debug Signal)" UBYTE CU_ATV_DBG_PUMPB_OUT 1 100 0.0 1.0 ECU_ADDRESS 0x40022962 BYTE_ORDER MSB_FIRST /end MEASUREMENT
/begin COMPU_METHOD CU_ATV_DBG_PUMPB_OUT "Conversion method for atv_dbg_pumpB_out" RAT_FUNC "%10.0" "one" COEFFS 0.000000 1.000000 0.000000 0.000000 0.000000 1.000000 /end COMPU_METHOD
/* Scalar measurable for DDE 'atv_en_dcdc_out'. */
/begin MEASUREMENT atv_en_dcdc_out "RUN LED Status" UBYTE CU_ATV_EN_DCDC_OUT 1 100 0.0 1.0 ECU_ADDRESS 0x4002295a BYTE_ORDER MSB_FIRST /end MEASUREMENT
/begin COMPU_METHOD CU_ATV_EN_DCDC_OUT "Conversion method for atv_en_dcdc_out" RAT_FUNC "%10.0" "one" COEFFS 0.000000 1.000000 0.000000 0.000000 0.000000 1.000000 /end COMPU_METHOD
/* Scalar measurable for DDE 'atv_fmot_run_timer'. */
/begin MEASUREMENT atv_fmot_run_timer "ICE Run Timer [sec]" ULONG CU_ATV_FMOT_RUN_TIMER 1 100 0.0 2000000000.0 ECU_ADDRESS 0x40022894 BYTE_ORDER MSB_FIRST /end MEASUREMENT
/begin COMPU_METHOD CU_ATV_FMOT_RUN_TIMER "Conversion method for atv_fmot_run_timer" RAT_FUNC "%10.0" "m" COEFFS 0.000000 1.000000 0.000000 0.000000 0.000000 1.000000 /end COMPU_METHOD
/* Scalar measurable for DDE 'atv_footBrake_X1000_out'. */
/begin MEASUREMENT atv_footBrake_X1000_out "footbrake Gen Out [0.1%]" UWORD CU_ATV_FOOTBRAKE_X1000_OUT 1 100 0.0 0.0 ECU_ADDRESS 0x400228e2 BYTE_ORDER MSB_FIRST /end MEASUREMENT
/begin COMPU_METHOD CU_ATV_FOOTBRAKE_X1000_OUT "Conversion method for atv_footBrake_X1000_out" RAT_FUNC "%10.0" "one" COEFFS 0.000000 1.000000 0.000000 0.000000 0.000000 1.000000 /end COMPU_METHOD
/* Scalar measurable for DDE 'atv_fs1_in'. */
/begin MEASUREMENT atv_fs1_in "Foot Pedal FS1 Switch Status input" UBYTE CU_ATV_FS1_IN 1 100 0.0 1.0 ECU_ADDRESS 0x40022953 BYTE_ORDER MSB_FIRST /end MEASUREMENT
/begin COMPU_METHOD CU_ATV_FS1_IN "Conversion method for atv_fs1_in" RAT_FUNC "%10.0" "one" COEFFS 0.000000 1.000000 0.000000 0.000000 0.000000 1.000000 /end COMPU_METHOD
/* Scalar measurable for DDE 'atv_fs1_out'. */
/begin MEASUREMENT atv_fs1_out "Foot Pedal FS1 Switch Status output" UBYTE CU_ATV_FS1_OUT 1 100 0.0 1.0 ECU_ADDRESS 0x40022956 BYTE_ORDER MSB_FIRST /end MEASUREMENT
/begin COMPU_METHOD CU_ATV_FS1_OUT "Conversion method for atv_fs1_out" RAT_FUNC "%10.0" "one" COEFFS 0.000000 1.000000 0.000000 0.000000 0.000000 1.000000 /end COMPU_METHOD
/* Scalar measurable for DDE 'atv_fuel_level'. */
/begin MEASUREMENT atv_fuel_level "Fuel Level [%]" UBYTE CU_ATV_FUEL_LEVEL 1 100 0.0 0.0 ECU_ADDRESS 0x40022931 BYTE_ORDER MSB_FIRST /end MEASUREMENT
/begin COMPU_METHOD CU_ATV_FUEL_LEVEL "Conversion method for atv_fuel_level" RAT_FUNC "%10.0" "one" COEFFS 0.000000 1.000000 0.000000 0.000000 0.000000 1.000000 /end COMPU_METHOD
/* Scalar measurable for DDE 'atv_fuel_qty'. */
/begin MEASUREMENT atv_fuel_qty "Fuel Quantity [liters]" FLOAT32_IEEE CU_ATV_FUEL_QTY 1 100 0.0 0.0 ECU_ADDRESS 0x400228c0 BYTE_ORDER MSB_FIRST /end MEASUREMENT
/begin COMPU_METHOD CU_ATV_FUEL_QTY "Conversion method for atv_fuel_qty" RAT_FUNC "%10.3" "l" COEFFS 0.000000 1.000000 0.000000 0.000000 0.000000 1.000000 /end COMPU_METHOD
/* Scalar measurable for DDE 'atv_fuel_reserve'. */
/begin MEASUREMENT atv_fuel_reserve "Fuel Reserve  (Boolean)" UBYTE CU_ATV_FUEL_RESERVE 1 100 0.0 1.0 ECU_ADDRESS 0x40022957 BYTE_ORDER MSB_FIRST /end MEASUREMENT
/begin COMPU_METHOD CU_ATV_FUEL_RESERVE "Conversion method for atv_fuel_reserve" RAT_FUNC "%10.0" "one" COEFFS 0.000000 1.000000 0.000000 0.000000 0.000000 1.000000 /end COMPU_METHOD
/* Scalar measurable for DDE 'atv_ice_rpm_req'. */
/begin MEASUREMENT atv_ice_rpm_req "ICE PWM RPM request [%]" SWORD CU_ATV_ICE_RPM_REQ 1 100 0.0 0.0 ECU_ADDRESS 0x4002292a BYTE_ORDER MSB_FIRST /end MEASUREMENT
/begin COMPU_METHOD CU_ATV_ICE_RPM_REQ "Conversion method for atv_ice_rpm_req" RAT_FUNC "%10.0" "rpm" COEFFS 0.000000 1.000000 0.000000 0.000000 0.000000 1.000000 /end COMPU_METHOD
/* Scalar measurable for DDE 'atv_ice_run_timer'. */
/begin MEASUREMENT atv_ice_run_timer "ICE Run Timer [sec]" ULONG CU_ATV_ICE_RUN_TIMER 1 100 0.0 2000000000.0 ECU_ADDRESS 0x40022898 BYTE_ORDER MSB_FIRST /end MEASUREMENT
/begin COMPU_METHOD CU_ATV_ICE_RUN_TIMER "Conversion method for atv_ice_run_timer" RAT_FUNC "%10.0" "m" COEFFS 0.000000 1.000000 0.000000 0.000000 0.000000 1.000000 /end COMPU_METHOD
/* Scalar measurable for DDE 'atv_map'. */
/begin MEASUREMENT atv_map "Actual map" UBYTE CU_ATV_MAP 1 100 0.0 0.0 ECU_ADDRESS 0x40022934 BYTE_ORDER MSB_FIRST /end MEASUREMENT
/begin COMPU_METHOD CU_ATV_MAP "Conversion method for atv_map" RAT_FUNC "%10.0" "one" COEFFS 0.000000 1.000000 0.000000 0.000000 0.000000 1.000000 /end COMPU_METHOD
/* Scalar measurable for DDE 'atv_max_cell'. */
/begin MEASUREMENT atv_max_cell "Max Cell" UWORD CU_ATV_MAX_CELL 1 100 0.0 0.0 ECU_ADDRESS 0x400228ce BYTE_ORDER MSB_FIRST /end MEASUREMENT
/begin COMPU_METHOD CU_ATV_MAX_CELL "Conversion method for atv_max_cell" RAT_FUNC "%10.0" "one" COEFFS 0.000000 1.000000 0.000000 0.000000 0.000000 1.000000 /end COMPU_METHOD
/* Scalar measurable for DDE 'atv_min_cell'. */
/begin MEASUREMENT atv_min_cell "Max Cell" UWORD CU_ATV_MIN_CELL 1 100 0.0 0.0 ECU_ADDRESS 0x400228d0 BYTE_ORDER MSB_FIRST /end MEASUREMENT
/begin COMPU_METHOD CU_ATV_MIN_CELL "Conversion method for atv_min_cell" RAT_FUNC "%10.0" "one" COEFFS 0.000000 1.000000 0.000000 0.000000 0.000000 1.000000 /end COMPU_METHOD
/* Scalar measurable for DDE 'atv_motoring_x1000_front'. */
/begin MEASUREMENT atv_motoring_x1000_front "Throttle output front positive torque 0-1000" UWORD CU_ATV_MOTORING_X1000_FRONT 1 100 0.0 0.0 ECU_ADDRESS 0x400228d6 BYTE_ORDER MSB_FIRST /end MEASUREMENT
/begin COMPU_METHOD CU_ATV_MOTORING_X1000_FRONT "Conversion method for atv_motoring_x1000_front" RAT_FUNC "%10.0" "V" COEFFS 0.000000 1.000000 0.000000 0.000000 0.000000 1.000000 /end COMPU_METHOD
/* Scalar measurable for DDE 'atv_motoring_x1000_front_final'. */
/begin MEASUREMENT atv_motoring_x1000_front_final "Throttle output front positive torque limited 0-1000" UWORD CU_ATV_MOTORING_X1000_FRONT_FI0 1 100 0.0 0.0 ECU_ADDRESS 0x400228d8 BYTE_ORDER MSB_FIRST /end MEASUREMENT
/begin COMPU_METHOD CU_ATV_MOTORING_X1000_FRONT_FI0 "Conversion method for atv_motoring_x1000_front_final" RAT_FUNC "%10.0" "V" COEFFS 0.000000 1.000000 0.000000 0.000000 0.000000 1.000000 /end COMPU_METHOD
/* Scalar measurable for DDE 'atv_motoring_x1000_rear'. */
/begin MEASUREMENT atv_motoring_x1000_rear "Throttle output rear positive torque 0-1000" UWORD CU_ATV_MOTORING_X1000_REAR 1 100 0.0 0.0 ECU_ADDRESS 0x400228d4 BYTE_ORDER MSB_FIRST /end MEASUREMENT
/begin COMPU_METHOD CU_ATV_MOTORING_X1000_REAR "Conversion method for atv_motoring_x1000_rear" RAT_FUNC "%10.0" "V" COEFFS 0.000000 1.000000 0.000000 0.000000 0.000000 1.000000 /end COMPU_METHOD
/* Scalar measurable for DDE 'atv_motoring_x1000_rear_final'. */
/begin MEASUREMENT atv_motoring_x1000_rear_final "Throttle output rear positive torque limited 0-1000" UWORD CU_ATV_MOTORING_X1000_REAR_FIN0 1 100 0.0 0.0 ECU_ADDRESS 0x400228da BYTE_ORDER MSB_FIRST /end MEASUREMENT
/begin COMPU_METHOD CU_ATV_MOTORING_X1000_REAR_FIN0 "Conversion method for atv_motoring_x1000_rear_final" RAT_FUNC "%10.0" "V" COEFFS 0.000000 1.000000 0.000000 0.000000 0.000000 1.000000 /end COMPU_METHOD
/* Scalar measurable for DDE 'atv_mtr_current_limit'. */
/begin MEASUREMENT atv_mtr_current_limit "Motoring Current Limit" UWORD CU_ATV_MTR_CURRENT_LIMIT 1 100 0.0 0.0 ECU_ADDRESS 0x40022916 BYTE_ORDER MSB_FIRST /end MEASUREMENT
/begin COMPU_METHOD CU_ATV_MTR_CURRENT_LIMIT "Conversion method for atv_mtr_current_limit" RAT_FUNC "%10.0" "A" COEFFS 0.000000 1.000000 0.000000 0.000000 0.000000 1.000000 /end COMPU_METHOD
/* Scalar measurable for DDE 'atv_odometer'. */
/begin MEASUREMENT atv_odometer "Odometer [m*100]" ULONG CU_ATV_ODOMETER 1 100 0.0 0.0 ECU_ADDRESS 0x4002289c BYTE_ORDER MSB_FIRST /end MEASUREMENT
/begin COMPU_METHOD CU_ATV_ODOMETER "Conversion method for atv_odometer" RAT_FUNC "%10.0" "m" COEFFS 0.000000 1.000000 0.000000 0.000000 0.000000 1.000000 /end COMPU_METHOD
/* Scalar measurable for DDE 'atv_platform_code_day'. */
/begin MEASUREMENT atv_platform_code_day "Day the platform library code was built." UWORD CU_ATV_PLATFORM_CODE_DAY 1 100 0.0 0.0 ECU_ADDRESS 0x4002290c BYTE_ORDER MSB_FIRST /end MEASUREMENT
/begin COMPU_METHOD CU_ATV_PLATFORM_CODE_DAY "Conversion method for atv_platform_code_day" RAT_FUNC "%10.0" "one" COEFFS 0.000000 1.000000 0.000000 0.000000 0.000000 1.000000 /end COMPU_METHOD
/* Scalar measurable for DDE 'atv_platform_code_major_ver'. */
/begin MEASUREMENT atv_platform_code_major_ver "Major version of the platform library code." UWORD CU_ATV_PLATFORM_CODE_MAJOR_VER 1 100 0.0 0.0 ECU_ADDRESS 0x4002290e BYTE_ORDER MSB_FIRST /end MEASUREMENT
/begin COMPU_METHOD CU_ATV_PLATFORM_CODE_MAJOR_VER "Conversion method for atv_platform_code_major_ver" RAT_FUNC "%10.0" "one" COEFFS 0.000000 1.000000 0.000000 0.000000 0.000000 1.000000 /end COMPU_METHOD
/* Scalar measurable for DDE 'atv_platform_code_minor_ver'. */
/begin MEASUREMENT atv_platform_code_minor_ver "Minor version of the platform library code." UWORD CU_ATV_PLATFORM_CODE_MINOR_VER 1 100 0.0 0.0 ECU_ADDRESS 0x40022910 BYTE_ORDER MSB_FIRST /end MEASUREMENT
/begin COMPU_METHOD CU_ATV_PLATFORM_CODE_MINOR_VER "Conversion method for atv_platform_code_minor_ver" RAT_FUNC "%10.0" "one" COEFFS 0.000000 1.000000 0.000000 0.000000 0.000000 1.000000 /end COMPU_METHOD
/* Scalar measurable for DDE 'atv_platform_code_month'. */
/begin MEASUREMENT atv_platform_code_month "Month the platform library code was built." UWORD CU_ATV_PLATFORM_CODE_MONTH 1 100 0.0 0.0 ECU_ADDRESS 0x4002290a BYTE_ORDER MSB_FIRST /end MEASUREMENT
/begin COMPU_METHOD CU_ATV_PLATFORM_CODE_MONTH "Conversion method for atv_platform_code_month" RAT_FUNC "%10.0" "one" COEFFS 0.000000 1.000000 0.000000 0.000000 0.000000 1.000000 /end COMPU_METHOD
/* Scalar measurable for DDE 'atv_platform_code_subminor_ver'. */
/begin MEASUREMENT atv_platform_code_subminor_ver "Sub-minor version of the platform library code." UWORD CU_ATV_PLATFORM_CODE_SUBMINOR_0 1 100 0.0 0.0 ECU_ADDRESS 0x40022912 BYTE_ORDER MSB_FIRST /end MEASUREMENT
/begin COMPU_METHOD CU_ATV_PLATFORM_CODE_SUBMINOR_0 "Conversion method for atv_platform_code_subminor_ver" RAT_FUNC "%10.0" "one" COEFFS 0.000000 1.000000 0.000000 0.000000 0.000000 1.000000 /end COMPU_METHOD
/* Scalar measurable for DDE 'atv_platform_code_year'. */
/begin MEASUREMENT atv_platform_code_year "Year the platform library code was built." UWORD CU_ATV_PLATFORM_CODE_YEAR 1 100 0.0 0.0 ECU_ADDRESS 0x40022908 BYTE_ORDER MSB_FIRST /end MEASUREMENT
/begin COMPU_METHOD CU_ATV_PLATFORM_CODE_YEAR "Conversion method for atv_platform_code_year" RAT_FUNC "%10.0" "one" COEFFS 0.000000 1.000000 0.000000 0.000000 0.000000 1.000000 /end COMPU_METHOD
/* Scalar measurable for DDE 'atv_pm_0'. */
/begin MEASUREMENT atv_pm_0 "Power Mode Selector Pos 0" UBYTE CU_ATV_PM_0 1 100 0.0 1.0 ECU_ADDRESS 0x4002296d BYTE_ORDER MSB_FIRST /end MEASUREMENT
/begin COMPU_METHOD CU_ATV_PM_0 "Conversion method for atv_pm_0" RAT_FUNC "%10.0" "one" COEFFS 0.000000 1.000000 0.000000 0.000000 0.000000 1.000000 /end COMPU_METHOD
/* Scalar measurable for DDE 'atv_pm_1'. */
/begin MEASUREMENT atv_pm_1 "Power Mode Selector Pos 1" UBYTE CU_ATV_PM_1 1 100 0.0 1.0 ECU_ADDRESS 0x4002296c BYTE_ORDER MSB_FIRST /end MEASUREMENT
/begin COMPU_METHOD CU_ATV_PM_1 "Conversion method for atv_pm_1" RAT_FUNC "%10.0" "one" COEFFS 0.000000 1.000000 0.000000 0.000000 0.000000 1.000000 /end COMPU_METHOD
/* Scalar measurable for DDE 'atv_pm_2'. */
/begin MEASUREMENT atv_pm_2 "Power Mode Selector Pos 2" UBYTE CU_ATV_PM_2 1 100 0.0 1.0 ECU_ADDRESS 0x4002296b BYTE_ORDER MSB_FIRST /end MEASUREMENT
/begin COMPU_METHOD CU_ATV_PM_2 "Conversion method for atv_pm_2" RAT_FUNC "%10.0" "one" COEFFS 0.000000 1.000000 0.000000 0.000000 0.000000 1.000000 /end COMPU_METHOD
/* Scalar measurable for DDE 'atv_pm_Electric'. */
/begin MEASUREMENT atv_pm_Electric "Power Mode Selector Electric Mode" UBYTE CU_ATV_PM_ELECTRIC 1 100 0.0 1.0 ECU_ADDRESS 0x40022966 BYTE_ORDER MSB_FIRST /end MEASUREMENT
/begin COMPU_METHOD CU_ATV_PM_ELECTRIC "Conversion method for atv_pm_Electric" RAT_FUNC "%10.0" "one" COEFFS 0.000000 1.000000 0.000000 0.000000 0.000000 1.000000 /end COMPU_METHOD
/* Scalar measurable for DDE 'atv_pm_Hybrid'. */
/begin MEASUREMENT atv_pm_Hybrid "Power Mode Selector Hybrid Mode" UBYTE CU_ATV_PM_HYBRID 1 100 0.0 0.0 ECU_ADDRESS 0x4002293c BYTE_ORDER MSB_FIRST /end MEASUREMENT
/begin COMPU_METHOD CU_ATV_PM_HYBRID "Conversion method for atv_pm_Hybrid" RAT_FUNC "%10.0" "one" COEFFS 0.000000 1.000000 0.000000 0.000000 0.000000 1.000000 /end COMPU_METHOD
/* Scalar measurable for DDE 'atv_pm_PreOp'. */
/begin MEASUREMENT atv_pm_PreOp "Power Mode Selector PreOp Mode" UBYTE CU_ATV_PM_PREOP 1 100 0.0 1.0 ECU_ADDRESS 0x40022964 BYTE_ORDER MSB_FIRST /end MEASUREMENT
/begin COMPU_METHOD CU_ATV_PM_PREOP "Conversion method for atv_pm_PreOp" RAT_FUNC "%10.0" "one" COEFFS 0.000000 1.000000 0.000000 0.000000 0.000000 1.000000 /end COMPU_METHOD
/* Scalar measurable for DDE 'atv_pm_Stealth'. */
/begin MEASUREMENT atv_pm_Stealth "Power Mode Selector Stealth Electric Mode" UBYTE CU_ATV_PM_STEALTH 1 100 0.0 1.0 ECU_ADDRESS 0x40022965 BYTE_ORDER MSB_FIRST /end MEASUREMENT
/begin COMPU_METHOD CU_ATV_PM_STEALTH "Conversion method for atv_pm_Stealth" RAT_FUNC "%10.0" "one" COEFFS 0.000000 1.000000 0.000000 0.000000 0.000000 1.000000 /end COMPU_METHOD
/* Scalar measurable for DDE 'atv_pm_g'. */
/begin MEASUREMENT atv_pm_g "Power Mode Selector Pos Giorno" UBYTE CU_ATV_PM_G 1 100 0.0 1.0 ECU_ADDRESS 0x40022967 BYTE_ORDER MSB_FIRST /end MEASUREMENT
/begin COMPU_METHOD CU_ATV_PM_G "Conversion method for atv_pm_g" RAT_FUNC "%10.0" "one" COEFFS 0.000000 1.000000 0.000000 0.000000 0.000000 1.000000 /end COMPU_METHOD
/* Scalar measurable for DDE 'atv_pm_s1'. */
/begin MEASUREMENT atv_pm_s1 "Power Mode Selector Pos S1" UBYTE CU_ATV_PM_S1 1 100 0.0 1.0 ECU_ADDRESS 0x40022968 BYTE_ORDER MSB_FIRST /end MEASUREMENT
/begin COMPU_METHOD CU_ATV_PM_S1 "Conversion method for atv_pm_s1" RAT_FUNC "%10.0" "one" COEFFS 0.000000 1.000000 0.000000 0.000000 0.000000 1.000000 /end COMPU_METHOD
/* Scalar measurable for DDE 'atv_pm_s2'. */
/begin MEASUREMENT atv_pm_s2 "Power Mode Selector Pos S2" UBYTE CU_ATV_PM_S2 1 100 0.0 1.0 ECU_ADDRESS 0x40022969 BYTE_ORDER MSB_FIRST /end MEASUREMENT
/begin COMPU_METHOD CU_ATV_PM_S2 "Conversion method for atv_pm_s2" RAT_FUNC "%10.0" "one" COEFFS 0.000000 1.000000 0.000000 0.000000 0.000000 1.000000 /end COMPU_METHOD
/* Scalar measurable for DDE 'atv_pm_s3'. */
/begin MEASUREMENT atv_pm_s3 "Power Mode Selector Pos S3" UBYTE CU_ATV_PM_S3 1 100 0.0 1.0 ECU_ADDRESS 0x4002296a BYTE_ORDER MSB_FIRST /end MEASUREMENT
/begin COMPU_METHOD CU_ATV_PM_S3 "Conversion method for atv_pm_s3" RAT_FUNC "%10.0" "one" COEFFS 0.000000 1.000000 0.000000 0.000000 0.000000 1.000000 /end COMPU_METHOD
/* Scalar measurable for DDE 'atv_prg_code_day'. */
/begin MEASUREMENT atv_prg_code_day "Day the reprogramming code was built." UWORD CU_ATV_PRG_CODE_DAY 1 100 0.0 0.0 ECU_ADDRESS 0x40022900 BYTE_ORDER MSB_FIRST /end MEASUREMENT
/begin COMPU_METHOD CU_ATV_PRG_CODE_DAY "Conversion method for atv_prg_code_day" RAT_FUNC "%10.0" "one" COEFFS 0.000000 1.000000 0.000000 0.000000 0.000000 1.000000 /end COMPU_METHOD
/* Scalar measurable for DDE 'atv_prg_code_major_ver'. */
/begin MEASUREMENT atv_prg_code_major_ver "Major version of the reprogramming code." UWORD CU_ATV_PRG_CODE_MAJOR_VER 1 100 0.0 0.0 ECU_ADDRESS 0x40022902 BYTE_ORDER MSB_FIRST /end MEASUREMENT
/begin COMPU_METHOD CU_ATV_PRG_CODE_MAJOR_VER "Conversion method for atv_prg_code_major_ver" RAT_FUNC "%10.0" "one" COEFFS 0.000000 1.000000 0.000000 0.000000 0.000000 1.000000 /end COMPU_METHOD
/* Scalar measurable for DDE 'atv_prg_code_minor_ver'. */
/begin MEASUREMENT atv_prg_code_minor_ver "Minor version of the reprogramming code." UWORD CU_ATV_PRG_CODE_MINOR_VER 1 100 0.0 0.0 ECU_ADDRESS 0x40022904 BYTE_ORDER MSB_FIRST /end MEASUREMENT
/begin COMPU_METHOD CU_ATV_PRG_CODE_MINOR_VER "Conversion method for atv_prg_code_minor_ver" RAT_FUNC "%10.0" "one" COEFFS 0.000000 1.000000 0.000000 0.000000 0.000000 1.000000 /end COMPU_METHOD
/* Scalar measurable for DDE 'atv_prg_code_month'. */
/begin MEASUREMENT atv_prg_code_month "Month the reprogramming code was built." UWORD CU_ATV_PRG_CODE_MONTH 1 100 0.0 0.0 ECU_ADDRESS 0x400228fe BYTE_ORDER MSB_FIRST /end MEASUREMENT
/begin COMPU_METHOD CU_ATV_PRG_CODE_MONTH "Conversion method for atv_prg_code_month" RAT_FUNC "%10.0" "one" COEFFS 0.000000 1.000000 0.000000 0.000000 0.000000 1.000000 /end COMPU_METHOD
/* Scalar measurable for DDE 'atv_prg_code_subminor_ver'. */
/begin MEASUREMENT atv_prg_code_subminor_ver "Sub-minor version of the reprogramming code." UWORD CU_ATV_PRG_CODE_SUBMINOR_VER 1 100 0.0 0.0 ECU_ADDRESS 0x40022906 BYTE_ORDER MSB_FIRST /end MEASUREMENT
/begin COMPU_METHOD CU_ATV_PRG_CODE_SUBMINOR_VER "Conversion method for atv_prg_code_subminor_ver" RAT_FUNC "%10.0" "one" COEFFS 0.000000 1.000000 0.000000 0.000000 0.000000 1.000000 /end COMPU_METHOD
/* Scalar measurable for DDE 'atv_prg_code_year'. */
/begin MEASUREMENT atv_prg_code_year "Year the reprogramming code was built." UWORD CU_ATV_PRG_CODE_YEAR 1 100 0.0 0.0 ECU_ADDRESS 0x400228fc BYTE_ORDER MSB_FIRST /end MEASUREMENT
/begin COMPU_METHOD CU_ATV_PRG_CODE_YEAR "Conversion method for atv_prg_code_year" RAT_FUNC "%10.0" "one" COEFFS 0.000000 1.000000 0.000000 0.000000 0.000000 1.000000 /end COMPU_METHOD
/* Scalar measurable for DDE 'atv_reg_current_limit'. */
/begin MEASUREMENT atv_reg_current_limit "Regen Current Limit" UWORD CU_ATV_REG_CURRENT_LIMIT 1 100 0.0 0.0 ECU_ADDRESS 0x40022914 BYTE_ORDER MSB_FIRST /end MEASUREMENT
/begin COMPU_METHOD CU_ATV_REG_CURRENT_LIMIT "Conversion method for atv_reg_current_limit" RAT_FUNC "%10.0" "A" COEFFS 0.000000 1.000000 0.000000 0.000000 0.000000 1.000000 /end COMPU_METHOD
/* Scalar measurable for DDE 'atv_regen_x1000_front'. */
/begin MEASUREMENT atv_regen_x1000_front "Throttle output front neutral braking 0-1000" UWORD CU_ATV_REGEN_X1000_FRONT 1 100 0.0 0.0 ECU_ADDRESS 0x400228dc BYTE_ORDER MSB_FIRST /end MEASUREMENT
/begin COMPU_METHOD CU_ATV_REGEN_X1000_FRONT "Conversion method for atv_regen_x1000_front" RAT_FUNC "%10.0" "V" COEFFS 0.000000 1.000000 0.000000 0.000000 0.000000 1.000000 /end COMPU_METHOD
/* Scalar measurable for DDE 'atv_regen_x1000_rear'. */
/begin MEASUREMENT atv_regen_x1000_rear "Throttle output rear neutral braking 0-1000" UWORD CU_ATV_REGEN_X1000_REAR 1 100 0.0 0.0 ECU_ADDRESS 0x400228de BYTE_ORDER MSB_FIRST /end MEASUREMENT
/begin COMPU_METHOD CU_ATV_REGEN_X1000_REAR "Conversion method for atv_regen_x1000_rear" RAT_FUNC "%10.0" "V" COEFFS 0.000000 1.000000 0.000000 0.000000 0.000000 1.000000 /end COMPU_METHOD
/* Scalar measurable for DDE 'atv_regmap'. */
/begin MEASUREMENT atv_regmap "Actual regeneration map" UBYTE CU_ATV_REGMAP 1 100 0.0 0.0 ECU_ADDRESS 0x40022933 BYTE_ORDER MSB_FIRST /end MEASUREMENT
/begin COMPU_METHOD CU_ATV_REGMAP "Conversion method for atv_regmap" RAT_FUNC "%10.0" "one" COEFFS 0.000000 1.000000 0.000000 0.000000 0.000000 1.000000 /end COMPU_METHOD
/* Scalar measurable for DDE 'atv_rmot_run_timer'. */
/begin MEASUREMENT atv_rmot_run_timer "ICE Run Timer [sec]" ULONG CU_ATV_RMOT_RUN_TIMER 1 100 0.0 2000000000.0 ECU_ADDRESS 0x400228a0 BYTE_ORDER MSB_FIRST /end MEASUREMENT
/begin COMPU_METHOD CU_ATV_RMOT_RUN_TIMER "Conversion method for atv_rmot_run_timer" RAT_FUNC "%10.0" "m" COEFFS 0.000000 1.000000 0.000000 0.000000 0.000000 1.000000 /end COMPU_METHOD
/* Scalar measurable for DDE 'atv_runLed_out'. */
/begin MEASUREMENT atv_runLed_out "RUN LED Status" UBYTE CU_ATV_RUNLED_OUT 1 100 0.0 1.0 ECU_ADDRESS 0x40022949 BYTE_ORDER MSB_FIRST /end MEASUREMENT
/begin COMPU_METHOD CU_ATV_RUNLED_OUT "Conversion method for atv_runLed_out" RAT_FUNC "%10.0" "one" COEFFS 0.000000 1.000000 0.000000 0.000000 0.000000 1.000000 /end COMPU_METHOD
/* Scalar measurable for DDE 'atv_stack_used'. */
/begin MEASUREMENT atv_stack_used "Amount of used stack" ULONG CU_ATV_STACK_USED 1 100 0.0 0.0 ECU_ADDRESS 0x400228a4 BYTE_ORDER MSB_FIRST /end MEASUREMENT
/begin COMPU_METHOD CU_ATV_STACK_USED "Conversion method for atv_stack_used" RAT_FUNC "%10.0" "byte" COEFFS 0.000000 1.000000 0.000000 0.000000 0.000000 1.000000 /end COMPU_METHOD
/* Scalar measurable for DDE 'atv_startBtnArmed'. */
/begin MEASUREMENT atv_startBtnArmed "Start Conditions Verified" UBYTE CU_ATV_STARTBTNARMED 1 100 0.0 1.0 ECU_ADDRESS 0x4002295b BYTE_ORDER MSB_FIRST /end MEASUREMENT
/begin COMPU_METHOD CU_ATV_STARTBTNARMED "Conversion method for atv_startBtnArmed" RAT_FUNC "%10.0" "one" COEFFS 0.000000 1.000000 0.000000 0.000000 0.000000 1.000000 /end COMPU_METHOD
/* Scalar measurable for DDE 'atv_startConditions'. */
/begin MEASUREMENT atv_startConditions "Start Conditions Verified" UBYTE CU_ATV_STARTCONDITIONS 1 100 0.0 1.0 ECU_ADDRESS 0x40022944 BYTE_ORDER MSB_FIRST /end MEASUREMENT
/begin COMPU_METHOD CU_ATV_STARTCONDITIONS "Conversion method for atv_startConditions" RAT_FUNC "%10.0" "one" COEFFS 0.000000 1.000000 0.000000 0.000000 0.000000 1.000000 /end COMPU_METHOD
/* Scalar measurable for DDE 'atv_state_out'. */
/begin MEASUREMENT atv_state_out "VSM State" UBYTE CU_ATV_STATE_OUT 1 100 0.0 0.0 ECU_ADDRESS 0x40022938 BYTE_ORDER MSB_FIRST /end MEASUREMENT
/begin COMPU_METHOD CU_ATV_STATE_OUT "Conversion method for atv_state_out" RAT_FUNC "%10.0" "one" COEFFS 0.000000 1.000000 0.000000 0.000000 0.000000 1.000000 /end COMPU_METHOD
/* Scalar measurable for DDE 'atv_sub_state_out'. */
/begin MEASUREMENT atv_sub_state_out "VSM SubState" UBYTE CU_ATV_SUB_STATE_OUT 1 100 0.0 0.0 ECU_ADDRESS 0x40022939 BYTE_ORDER MSB_FIRST /end MEASUREMENT
/begin COMPU_METHOD CU_ATV_SUB_STATE_OUT "Conversion method for atv_sub_state_out" RAT_FUNC "%10.0" "one" COEFFS 0.000000 1.000000 0.000000 0.000000 0.000000 1.000000 /end COMPU_METHOD
/* Scalar measurable for DDE 'atv_task_duration_1s'. */
/begin MEASUREMENT atv_task_duration_1s "Duration of 1s task (last measured valued)" ULONG CU_ATV_TASK_DURATION_1S 1 100 0.0 0.0 ECU_ADDRESS 0x400228a8 BYTE_ORDER MSB_FIRST /end MEASUREMENT
/begin COMPU_METHOD CU_ATV_TASK_DURATION_1S "Conversion method for atv_task_duration_1s" RAT_FUNC "%10.0" "microsecond" COEFFS 0.000000 1.000000 0.000000 0.000000 0.000000 1.000000 /end COMPU_METHOD
/* Scalar measurable for DDE 'atv_task_duration_1s_max'. */
/begin MEASUREMENT atv_task_duration_1s_max "Duration of 1s task (maximum since power up)" ULONG CU_ATV_TASK_DURATION_1S_MAX 1 100 0.0 0.0 ECU_ADDRESS 0x400228ac BYTE_ORDER MSB_FIRST /end MEASUREMENT
/begin COMPU_METHOD CU_ATV_TASK_DURATION_1S_MAX "Conversion method for atv_task_duration_1s_max" RAT_FUNC "%10.0" "microsecond" COEFFS 0.000000 1.000000 0.000000 0.000000 0.000000 1.000000 /end COMPU_METHOD
/* Scalar measurable for DDE 'atv_throttleGen_X1000_out'. */
/begin MEASUREMENT atv_throttleGen_X1000_out "Ice StartTorque [0.1%]" UWORD CU_ATV_THROTTLEGEN_X1000_OUT 1 100 0.0 0.0 ECU_ADDRESS 0x400228e0 BYTE_ORDER MSB_FIRST /end MEASUREMENT
/begin COMPU_METHOD CU_ATV_THROTTLEGEN_X1000_OUT "Conversion method for atv_throttleGen_X1000_out" RAT_FUNC "%10.0" "one" COEFFS 0.000000 1.000000 0.000000 0.000000 0.000000 1.000000 /end COMPU_METHOD
/* Scalar measurable for DDE 'atv_throttleX1000'. */
/begin MEASUREMENT atv_throttleX1000 "Throttle Input 0-1000" UWORD CU_ATV_THROTTLEX1000 1 100 0.0 0.0 ECU_ADDRESS 0x400228d2 BYTE_ORDER MSB_FIRST /end MEASUREMENT
/begin COMPU_METHOD CU_ATV_THROTTLEX1000 "Conversion method for atv_throttleX1000" RAT_FUNC "%10.0" "one" COEFFS 0.000000 1.000000 0.000000 0.000000 0.000000 1.000000 /end COMPU_METHOD
/* Scalar measurable for DDE 'atv_v_dbg_chg_req'. */
/begin MEASUREMENT atv_v_dbg_chg_req "HV Relay Control (Debug Signal)" UBYTE CU_ATV_V_DBG_CHG_REQ 1 100 0.0 1.0 ECU_ADDRESS 0x40022951 BYTE_ORDER MSB_FIRST /end MEASUREMENT
/begin COMPU_METHOD CU_ATV_V_DBG_CHG_REQ "Conversion method for atv_v_dbg_chg_req" RAT_FUNC "%10.0" "one" COEFFS 0.000000 1.000000 0.000000 0.000000 0.000000 1.000000 /end COMPU_METHOD
/* Scalar measurable for DDE 'atv_v_dbg_heater_req'. */
/begin MEASUREMENT atv_v_dbg_heater_req "HV Relay Control (Debug Signal)" UBYTE CU_ATV_V_DBG_HEATER_REQ 1 100 0.0 1.0 ECU_ADDRESS 0x40022952 BYTE_ORDER MSB_FIRST /end MEASUREMENT
/begin COMPU_METHOD CU_ATV_V_DBG_HEATER_REQ "Conversion method for atv_v_dbg_heater_req" RAT_FUNC "%10.0" "one" COEFFS 0.000000 1.000000 0.000000 0.000000 0.000000 1.000000 /end COMPU_METHOD
/* Scalar measurable for DDE 'atv_vehicle_SOC'. */
/begin MEASUREMENT atv_vehicle_SOC "Vehicle SOC [%]" UBYTE CU_ATV_VEHICLE_SOC 1 100 0.0 0.0 ECU_ADDRESS 0x40022937 BYTE_ORDER MSB_FIRST /end MEASUREMENT
/begin COMPU_METHOD CU_ATV_VEHICLE_SOC "Conversion method for atv_vehicle_SOC" RAT_FUNC "%10.0" "%" COEFFS 0.000000 1.000000 0.000000 0.000000 0.000000 1.000000 /end COMPU_METHOD
/* Scalar measurable for DDE 'atv_wakelock_out'. */
/begin MEASUREMENT atv_wakelock_out "Wakelock Status" UBYTE CU_ATV_WAKELOCK_OUT 1 100 0.0 1.0 ECU_ADDRESS 0x40022959 BYTE_ORDER MSB_FIRST /end MEASUREMENT
/begin COMPU_METHOD CU_ATV_WAKELOCK_OUT "Conversion method for atv_wakelock_out" RAT_FUNC "%10.0" "one" COEFFS 0.000000 1.000000 0.000000 0.000000 0.000000 1.000000 /end COMPU_METHOD
/* Scalar measurable for DDE 'atv_xa1_ain_throttle_raw'. */
/begin MEASUREMENT atv_xa1_ain_throttle_raw "Throttle Input V (Raw Voltage)" FLOAT32_IEEE CU_ATV_XA1_AIN_THROTTLE_RAW 1 100 0.0 0.0 ECU_ADDRESS 0x40022878 BYTE_ORDER MSB_FIRST /end MEASUREMENT
/begin COMPU_METHOD CU_ATV_XA1_AIN_THROTTLE_RAW "Conversion method for atv_xa1_ain_throttle_raw" RAT_FUNC "%10.3" "V" COEFFS 0.000000 1.000000 0.000000 0.000000 0.000000 1.000000 /end COMPU_METHOD
/* Scalar measurable for DDE 'atv_xa3_brake_pedal_raw_ain'. */
/begin MEASUREMENT atv_xa3_brake_pedal_raw_ain "Brake Pedal (Raw Voltage)" FLOAT32_IEEE CU_ATV_XA3_BRAKE_PEDAL_RAW_AIN 1 100 0.0 0.0 ECU_ADDRESS 0x4002285c BYTE_ORDER MSB_FIRST /end MEASUREMENT
/begin COMPU_METHOD CU_ATV_XA3_BRAKE_PEDAL_RAW_AIN "Conversion method for atv_xa3_brake_pedal_raw_ain" RAT_FUNC "%10.3" "V" COEFFS 0.000000 1.000000 0.000000 0.000000 0.000000 1.000000 /end COMPU_METHOD
/* Scalar measurable for DDE 'atv_xc1_raw_ain'. */
/begin MEASUREMENT atv_xc1_raw_ain "Fwd Selector (Raw Voltage)" FLOAT32_IEEE CU_ATV_XC1_RAW_AIN 1 100 0.0 0.0 ECU_ADDRESS 0x40022854 BYTE_ORDER MSB_FIRST /end MEASUREMENT
/begin COMPU_METHOD CU_ATV_XC1_RAW_AIN "Conversion method for atv_xc1_raw_ain" RAT_FUNC "%10.3" "V" COEFFS 0.000000 1.000000 0.000000 0.000000 0.000000 1.000000 /end COMPU_METHOD
/* Scalar measurable for DDE 'atv_xc4_raw_ain'. */
/begin MEASUREMENT atv_xc4_raw_ain "Rwd Selector (Raw Voltage)" FLOAT32_IEEE CU_ATV_XC4_RAW_AIN 1 100 0.0 0.0 ECU_ADDRESS 0x40022858 BYTE_ORDER MSB_FIRST /end MEASUREMENT
/begin COMPU_METHOD CU_ATV_XC4_RAW_AIN "Conversion method for atv_xc4_raw_ain" RAT_FUNC "%10.3" "V" COEFFS 0.000000 1.000000 0.000000 0.000000 0.000000 1.000000 /end COMPU_METHOD
/* Scalar measurable for DDE 'atv_xd1_key_ain'. */
/begin MEASUREMENT atv_xd1_key_ain "Key Input (V)" FLOAT32_IEEE CU_ATV_XD1_KEY_AIN 1 100 0.0 0.0 ECU_ADDRESS 0x40022850 BYTE_ORDER MSB_FIRST /end MEASUREMENT
/begin COMPU_METHOD CU_ATV_XD1_KEY_AIN "Conversion method for atv_xd1_key_ain" RAT_FUNC "%10.3" "V" COEFFS 0.000000 1.000000 0.000000 0.000000 0.000000 1.000000 /end COMPU_METHOD
/* Scalar measurable for DDE 'atv_xd2'. */
/begin MEASUREMENT atv_xd2 "Power Mode Selector s56" FLOAT32_IEEE CU_ATV_XD2 1 100 0.0 0.0 ECU_ADDRESS 0x400228b4 BYTE_ORDER MSB_FIRST /end MEASUREMENT
/begin COMPU_METHOD CU_ATV_XD2 "Conversion method for atv_xd2" RAT_FUNC "%10.3" "V" COEFFS 0.000000 1.000000 0.000000 0.000000 0.000000 1.000000 /end COMPU_METHOD
/* Scalar measurable for DDE 'atv_xd3_raw_ain'. */
/begin MEASUREMENT atv_xd3_raw_ain "Foot Pedal FS1 Switch (Raw Voltage)" FLOAT32_IEEE CU_ATV_XD3_RAW_AIN 1 100 0.0 0.0 ECU_ADDRESS 0x4002287c BYTE_ORDER MSB_FIRST /end MEASUREMENT
/begin COMPU_METHOD CU_ATV_XD3_RAW_AIN "Conversion method for atv_xd3_raw_ain" RAT_FUNC "%10.3" "V" COEFFS 0.000000 1.000000 0.000000 0.000000 0.000000 1.000000 /end COMPU_METHOD
/* Scalar measurable for DDE 'atv_xe2_raw_ain'. */
/begin MEASUREMENT atv_xe2_raw_ain "APU Button (Raw Voltage)" FLOAT32_IEEE CU_ATV_XE2_RAW_AIN 1 100 0.0 0.0 ECU_ADDRESS 0x40022860 BYTE_ORDER MSB_FIRST /end MEASUREMENT
/begin COMPU_METHOD CU_ATV_XE2_RAW_AIN "Conversion method for atv_xe2_raw_ain" RAT_FUNC "%10.3" "V" COEFFS 0.000000 1.000000 0.000000 0.000000 0.000000 1.000000 /end COMPU_METHOD
/* Scalar measurable for DDE 'atv_xe3_ain'. */
/begin MEASUREMENT atv_xe3_ain "(not defined)" SLONG CU_ATV_XE3_AIN 1 100 0.0 0.0 ECU_ADDRESS 0x400228c4 BYTE_ORDER MSB_FIRST /end MEASUREMENT
/begin COMPU_METHOD CU_ATV_XE3_AIN "Conversion method for atv_xe3_ain" RAT_FUNC "%10.0" "V" COEFFS 0.000000 1.000000 0.000000 0.000000 0.000000 1.000000 /end COMPU_METHOD
/* Scalar measurable for DDE 'atv_xe4_raw_ain'. */
/begin MEASUREMENT atv_xe4_raw_ain "2WD/4WD  Selector (Raw Voltage)" FLOAT32_IEEE CU_ATV_XE4_RAW_AIN 1 100 0.0 0.0 ECU_ADDRESS 0x40022884 BYTE_ORDER MSB_FIRST /end MEASUREMENT
/begin COMPU_METHOD CU_ATV_XE4_RAW_AIN "Conversion method for atv_xe4_raw_ain" RAT_FUNC "%10.3" "V" COEFFS 0.000000 1.000000 0.000000 0.000000 0.000000 1.000000 /end COMPU_METHOD
/* Scalar measurable for DDE 'atv_xf4'. */
/begin MEASUREMENT atv_xf4 "PumpA Fault" UBYTE CU_ATV_XF4 1 100 0.0 1.0 ECU_ADDRESS 0x40022946 BYTE_ORDER MSB_FIRST /end MEASUREMENT
/begin COMPU_METHOD CU_ATV_XF4 "Conversion method for atv_xf4" RAT_FUNC "%10.0" "one" COEFFS 0.000000 1.000000 0.000000 0.000000 0.000000 1.000000 /end COMPU_METHOD
/* Scalar measurable for DDE 'atv_yb3_raw_ain'. */
/begin MEASUREMENT atv_yb3_raw_ain "Fuel Sensor [V]" FLOAT32_IEEE CU_ATV_YB3_RAW_AIN 1 100 0.0 0.0 ECU_ADDRESS 0x40022874 BYTE_ORDER MSB_FIRST /end MEASUREMENT
/begin COMPU_METHOD CU_ATV_YB3_RAW_AIN "Conversion method for atv_yb3_raw_ain" RAT_FUNC "%10.3" "V" COEFFS 0.000000 1.000000 0.000000 0.000000 0.000000 1.000000 /end COMPU_METHOD
/* Scalar measurable for DDE 'atv_ye2'. */
/begin MEASUREMENT atv_ye2 "Active Suspension Ctrl" FLOAT32_IEEE CU_ATV_YE2 1 100 0.0 0.0 ECU_ADDRESS 0x400228bc BYTE_ORDER MSB_FIRST /end MEASUREMENT
/begin COMPU_METHOD CU_ATV_YE2 "Conversion method for atv_ye2" RAT_FUNC "%10.3" "V" COEFFS 0.000000 1.000000 0.000000 0.000000 0.000000 1.000000 /end COMPU_METHOD
/* Scalar measurable for DDE 'atv_yg1'. */
/begin MEASUREMENT atv_yg1 "Stealth mode out" UBYTE CU_ATV_YG1 1 100 0.0 1.0 ECU_ADDRESS 0x40022963 BYTE_ORDER MSB_FIRST /end MEASUREMENT
/begin COMPU_METHOD CU_ATV_YG1 "Conversion method for atv_yg1" RAT_FUNC "%10.0" "one" COEFFS 0.000000 1.000000 0.000000 0.000000 0.000000 1.000000 /end COMPU_METHOD
/* Scalar measurable for DDE 'atv_yg2'. */
/begin MEASUREMENT atv_yg2 "RegMap Sel 0" UBYTE CU_ATV_YG2 1 100 0.0 1.0 ECU_ADDRESS 0x4002294c BYTE_ORDER MSB_FIRST /end MEASUREMENT
/begin COMPU_METHOD CU_ATV_YG2 "Conversion method for atv_yg2" RAT_FUNC "%10.0" "one" COEFFS 0.000000 1.000000 0.000000 0.000000 0.000000 1.000000 /end COMPU_METHOD
/* Scalar measurable for DDE 'atv_yg3_raw_ain'. */
/begin MEASUREMENT atv_yg3_raw_ain "Throttle Input V (Raw Voltage)" FLOAT32_IEEE CU_ATV_YG3_RAW_AIN 1 100 0.0 0.0 ECU_ADDRESS 0x40022890 BYTE_ORDER MSB_FIRST /end MEASUREMENT
/begin COMPU_METHOD CU_ATV_YG3_RAW_AIN "Conversion method for atv_yg3_raw_ain" RAT_FUNC "%10.3" "V" COEFFS 0.000000 1.000000 0.000000 0.000000 0.000000 1.000000 /end COMPU_METHOD
/* Scalar measurable for DDE 'atv_yh2'. */
/begin MEASUREMENT atv_yh2 "RegMap Sel 1" UBYTE CU_ATV_YH2 1 100 0.0 1.0 ECU_ADDRESS 0x4002294d BYTE_ORDER MSB_FIRST /end MEASUREMENT
/begin COMPU_METHOD CU_ATV_YH2 "Conversion method for atv_yh2" RAT_FUNC "%10.0" "one" COEFFS 0.000000 1.000000 0.000000 0.000000 0.000000 1.000000 /end COMPU_METHOD
/* Scalar measurable for DDE 'atv_yj2'. */
/begin MEASUREMENT atv_yj2 "RegMap Sel 2" UBYTE CU_ATV_YJ2 1 100 0.0 1.0 ECU_ADDRESS 0x4002294e BYTE_ORDER MSB_FIRST /end MEASUREMENT
/begin COMPU_METHOD CU_ATV_YJ2 "Conversion method for atv_yj2" RAT_FUNC "%10.0" "one" COEFFS 0.000000 1.000000 0.000000 0.000000 0.000000 1.000000 /end COMPU_METHOD
/* Scalar measurable for DDE 'atv_za2'. */
/begin MEASUREMENT atv_za2 "PumpB Fault" UBYTE CU_ATV_ZA2 1 100 0.0 1.0 ECU_ADDRESS 0x40022948 BYTE_ORDER MSB_FIRST /end MEASUREMENT
/begin COMPU_METHOD CU_ATV_ZA2 "Conversion method for atv_za2" RAT_FUNC "%10.0" "one" COEFFS 0.000000 1.000000 0.000000 0.000000 0.000000 1.000000 /end COMPU_METHOD
/* Scalar measurable for DDE 'atv_za3_StartBtn_din'. */
/begin MEASUREMENT atv_za3_StartBtn_din "Start Button Status (RAW)" UBYTE CU_ATV_ZA3_STARTBTN_DIN 1 100 0.0 1.0 ECU_ADDRESS 0x4002293e BYTE_ORDER MSB_FIRST /end MEASUREMENT
/begin COMPU_METHOD CU_ATV_ZA3_STARTBTN_DIN "Conversion method for atv_za3_StartBtn_din" RAT_FUNC "%10.0" "one" COEFFS 0.000000 1.000000 0.000000 0.000000 0.000000 1.000000 /end COMPU_METHOD
/* Scalar measurable for DDE 'atv_zb2'. */
/begin MEASUREMENT atv_zb2 "Generator Sel 1" UBYTE CU_ATV_ZB2 1 100 0.0 1.0 ECU_ADDRESS 0x4002294a BYTE_ORDER MSB_FIRST /end MEASUREMENT
/begin COMPU_METHOD CU_ATV_ZB2 "Conversion method for atv_zb2" RAT_FUNC "%10.0" "one" COEFFS 0.000000 1.000000 0.000000 0.000000 0.000000 1.000000 /end COMPU_METHOD
/* Scalar measurable for DDE 'atv_zb3'. */
/begin MEASUREMENT atv_zb3 "Generator Sel 2" UBYTE CU_ATV_ZB3 1 100 0.0 1.0 ECU_ADDRESS 0x4002294b BYTE_ORDER MSB_FIRST /end MEASUREMENT
/begin COMPU_METHOD CU_ATV_ZB3 "Conversion method for atv_zb3" RAT_FUNC "%10.0" "one" COEFFS 0.000000 1.000000 0.000000 0.000000 0.000000 1.000000 /end COMPU_METHOD
/* Scalar measurable for DDE 'atv_zc2'. */
/begin MEASUREMENT atv_zc2 "Power Mode Selector 58" UBYTE CU_ATV_ZC2 1 100 0.0 1.0 ECU_ADDRESS 0x4002293f BYTE_ORDER MSB_FIRST /end MEASUREMENT
/begin COMPU_METHOD CU_ATV_ZC2 "Conversion method for atv_zc2" RAT_FUNC "%10.0" "one" COEFFS 0.000000 1.000000 0.000000 0.000000 0.000000 1.000000 /end COMPU_METHOD
/* Scalar measurable for DDE 'atv_zc4'. */
/begin MEASUREMENT atv_zc4 "Power Mode Selector 56" UBYTE CU_ATV_ZC4 1 100 0.0 1.0 ECU_ADDRESS 0x40022940 BYTE_ORDER MSB_FIRST /end MEASUREMENT
/begin COMPU_METHOD CU_ATV_ZC4 "Conversion method for atv_zc4" RAT_FUNC "%10.0" "one" COEFFS 0.000000 1.000000 0.000000 0.000000 0.000000 1.000000 /end COMPU_METHOD
/* Scalar measurable for DDE 'atv_zd1_ain'. */
/begin MEASUREMENT atv_zd1_ain "12V level (Raw in)" FLOAT32_IEEE CU_ATV_ZD1_AIN 1 100 0.0 0.0 ECU_ADDRESS 0x40022888 BYTE_ORDER MSB_FIRST /end MEASUREMENT
/begin COMPU_METHOD CU_ATV_ZD1_AIN "Conversion method for atv_zd1_ain" RAT_FUNC "%10.3" "V" COEFFS 0.000000 1.000000 0.000000 0.000000 0.000000 1.000000 /end COMPU_METHOD
/* Scalar measurable for DDE 'atv_ze3'. */
/begin MEASUREMENT atv_ze3 "Power Mode Selector s54" FLOAT32_IEEE CU_ATV_ZE3 1 100 0.0 0.0 ECU_ADDRESS 0x400228b8 BYTE_ORDER MSB_FIRST /end MEASUREMENT
/begin COMPU_METHOD CU_ATV_ZE3 "Conversion method for atv_ze3" RAT_FUNC "%10.3" "V" COEFFS 0.000000 1.000000 0.000000 0.000000 0.000000 1.000000 /end COMPU_METHOD
/* Scalar measurable for DDE 'atv_ze4'. */
/begin MEASUREMENT atv_ze4 "Power Mode Selector 15a" FLOAT32_IEEE CU_ATV_ZE4 1 100 0.0 0.0 ECU_ADDRESS 0x400228b0 BYTE_ORDER MSB_FIRST /end MEASUREMENT
/begin COMPU_METHOD CU_ATV_ZE4 "Conversion method for atv_ze4" RAT_FUNC "%10.3" "V" COEFFS 0.000000 1.000000 0.000000 0.000000 0.000000 1.000000 /end COMPU_METHOD
/* Scalar measurable for DDE 'bms_pack_soc'. */
/begin MEASUREMENT bms_pack_soc "Battery SOC" UBYTE CU_BMS_PACK_SOC 1 100 0.0 0.0 ECU_ADDRESS 0x4002292f BYTE_ORDER MSB_FIRST /end MEASUREMENT
/begin COMPU_METHOD CU_BMS_PACK_SOC "Conversion method for bms_pack_soc" RAT_FUNC "%10.0" "%" COEFFS 0.000000 1.000000 0.000000 0.000000 0.000000 1.000000 /end COMPU_METHOD
/* Scalar measurable for DDE 'bms_pack_voltage'. */
/begin MEASUREMENT bms_pack_voltage "Battery Voltage" FLOAT32_IEEE CU_BMS_PACK_VOLTAGE 1 100 0.0 0.0 ECU_ADDRESS 0x4002286c BYTE_ORDER MSB_FIRST /end MEASUREMENT
/begin COMPU_METHOD CU_BMS_PACK_VOLTAGE "Conversion method for bms_pack_voltage" RAT_FUNC "%10.0" "V" COEFFS 0.000000 1.000000 0.000000 0.000000 0.000000 1.000000 /end COMPU_METHOD
/* Scalar measurable for DDE 'bms_rolling_counter'. */
/begin MEASUREMENT bms_rolling_counter "BMS Rolling counter" UBYTE CU_BMS_ROLLING_COUNTER 1 100 0.0 0.0 ECU_ADDRESS 0x40022930 BYTE_ORDER MSB_FIRST /end MEASUREMENT
/begin COMPU_METHOD CU_BMS_ROLLING_COUNTER "Conversion method for bms_rolling_counter" RAT_FUNC "%10.0" "one" COEFFS 0.000000 1.000000 0.000000 0.000000 0.000000 1.000000 /end COMPU_METHOD
/* Scalar measurable for DDE 'mpl_app_build_day'. */
/begin MEASUREMENT mpl_app_build_day "Date application was built in days." UWORD CU_MPL_APP_BUILD_DAY 1 100 0.0 65535.0 ECU_ADDRESS 0x10434ee BYTE_ORDER MSB_FIRST /end MEASUREMENT
/begin COMPU_METHOD CU_MPL_APP_BUILD_DAY "Conversion method for mpl_app_build_day" RAT_FUNC "%10.0" "(not defined)" COEFFS 0.000000 1.000000 0.000000 0.000000 0.000000 1.000000 /end COMPU_METHOD
/* Scalar measurable for DDE 'mpl_app_build_hour'. */
/begin MEASUREMENT mpl_app_build_hour "Time application was built in hours" UWORD CU_MPL_APP_BUILD_HOUR 1 100 0.0 65535.0 ECU_ADDRESS 0x10434f8 BYTE_ORDER MSB_FIRST /end MEASUREMENT
/begin COMPU_METHOD CU_MPL_APP_BUILD_HOUR "Conversion method for mpl_app_build_hour" RAT_FUNC "%10.0" "(not defined)" COEFFS 0.000000 1.000000 0.000000 0.000000 0.000000 1.000000 /end COMPU_METHOD
/* Scalar measurable for DDE 'mpl_app_build_min'. */
/begin MEASUREMENT mpl_app_build_min "Time application was built in minutes" UWORD CU_MPL_APP_BUILD_MIN 1 100 0.0 65535.0 ECU_ADDRESS 0x10434f6 BYTE_ORDER MSB_FIRST /end MEASUREMENT
/begin COMPU_METHOD CU_MPL_APP_BUILD_MIN "Conversion method for mpl_app_build_min" RAT_FUNC "%10.0" "(not defined)" COEFFS 0.000000 1.000000 0.000000 0.000000 0.000000 1.000000 /end COMPU_METHOD
/* Scalar measurable for DDE 'mpl_app_build_month'. */
/begin MEASUREMENT mpl_app_build_month "Date application was built in months." UWORD CU_MPL_APP_BUILD_MONTH 1 100 0.0 65535.0 ECU_ADDRESS 0x10434f0 BYTE_ORDER MSB_FIRST /end MEASUREMENT
/begin COMPU_METHOD CU_MPL_APP_BUILD_MONTH "Conversion method for mpl_app_build_month" RAT_FUNC "%10.0" "(not defined)" COEFFS 0.000000 1.000000 0.000000 0.000000 0.000000 1.000000 /end COMPU_METHOD
/* Scalar measurable for DDE 'mpl_app_build_sec'. */
/begin MEASUREMENT mpl_app_build_sec "Time application was built in seconds" UWORD CU_MPL_APP_BUILD_SEC 1 100 0.0 65535.0 ECU_ADDRESS 0x10434f4 BYTE_ORDER MSB_FIRST /end MEASUREMENT
/begin COMPU_METHOD CU_MPL_APP_BUILD_SEC "Conversion method for mpl_app_build_sec" RAT_FUNC "%10.0" "(not defined)" COEFFS 0.000000 1.000000 0.000000 0.000000 0.000000 1.000000 /end COMPU_METHOD
/* Scalar measurable for DDE 'mpl_app_build_year'. */
/begin MEASUREMENT mpl_app_build_year "Date application was built in years." UWORD CU_MPL_APP_BUILD_YEAR 1 100 0.0 65535.0 ECU_ADDRESS 0x10434f2 BYTE_ORDER MSB_FIRST /end MEASUREMENT
/begin COMPU_METHOD CU_MPL_APP_BUILD_YEAR "Conversion method for mpl_app_build_year" RAT_FUNC "%10.0" "(not defined)" COEFFS 0.000000 1.000000 0.000000 0.000000 0.000000 1.000000 /end COMPU_METHOD
/* Scalar measurable for DDE 'mpl_app_ver_major'. */
/begin MEASUREMENT mpl_app_ver_major "App major version number" UWORD CU_MPL_APP_VER_MAJOR 1 100 0.0 65535.0 ECU_ADDRESS 0x10008de BYTE_ORDER MSB_FIRST /end MEASUREMENT
/begin COMPU_METHOD CU_MPL_APP_VER_MAJOR "Conversion method for mpl_app_ver_major" RAT_FUNC "%10.0" "(not defined)" COEFFS 0.000000 1.000000 0.000000 0.000000 0.000000 1.000000 /end COMPU_METHOD
/* Scalar measurable for DDE 'mpl_app_ver_minor'. */
/begin MEASUREMENT mpl_app_ver_minor "App minor version number" UWORD CU_MPL_APP_VER_MINOR 1 100 0.0 65535.0 ECU_ADDRESS 0x10008e0 BYTE_ORDER MSB_FIRST /end MEASUREMENT
/begin COMPU_METHOD CU_MPL_APP_VER_MINOR "Conversion method for mpl_app_ver_minor" RAT_FUNC "%10.0" "(not defined)" COEFFS 0.000000 1.000000 0.000000 0.000000 0.000000 1.000000 /end COMPU_METHOD
/* Scalar measurable for DDE 'mpl_app_ver_sub'. */
/begin MEASUREMENT mpl_app_ver_sub "App sub-minor version number" UWORD CU_MPL_APP_VER_SUB 1 100 0.0 65535.0 ECU_ADDRESS 0x10008e2 BYTE_ORDER MSB_FIRST /end MEASUREMENT
/begin COMPU_METHOD CU_MPL_APP_VER_SUB "Conversion method for mpl_app_ver_sub" RAT_FUNC "%10.0" "(not defined)" COEFFS 0.000000 1.000000 0.000000 0.000000 0.000000 1.000000 /end COMPU_METHOD
/* Scalar measurable for DDE 'mpl_boot_build_day'. */
/begin MEASUREMENT mpl_boot_build_day "Boot build day" UWORD CU_MPL_BOOT_BUILD_DAY 1 100 0.0 65535.0 ECU_ADDRESS 0x40022a52 BYTE_ORDER MSB_FIRST /end MEASUREMENT
/begin COMPU_METHOD CU_MPL_BOOT_BUILD_DAY "Conversion method for mpl_boot_build_day" RAT_FUNC "%10.0" "(not defined)" COEFFS 0.000000 1.000000 0.000000 0.000000 0.000000 1.000000 /end COMPU_METHOD
/* Scalar measurable for DDE 'mpl_boot_build_month'. */
/begin MEASUREMENT mpl_boot_build_month "Boot build month" UWORD CU_MPL_BOOT_BUILD_MONTH 1 100 0.0 65535.0 ECU_ADDRESS 0x40022a54 BYTE_ORDER MSB_FIRST /end MEASUREMENT
/begin COMPU_METHOD CU_MPL_BOOT_BUILD_MONTH "Conversion method for mpl_boot_build_month" RAT_FUNC "%10.0" "(not defined)" COEFFS 0.000000 1.000000 0.000000 0.000000 0.000000 1.000000 /end COMPU_METHOD
/* Scalar measurable for DDE 'mpl_boot_build_year'. */
/begin MEASUREMENT mpl_boot_build_year "Boot build year" UWORD CU_MPL_BOOT_BUILD_YEAR 1 100 0.0 65535.0 ECU_ADDRESS 0x40022a56 BYTE_ORDER MSB_FIRST /end MEASUREMENT
/begin COMPU_METHOD CU_MPL_BOOT_BUILD_YEAR "Conversion method for mpl_boot_build_year" RAT_FUNC "%10.0" "(not defined)" COEFFS 0.000000 1.000000 0.000000 0.000000 0.000000 1.000000 /end COMPU_METHOD
/* Scalar measurable for DDE 'mpl_boot_part_num_group'. */
/begin MEASUREMENT mpl_boot_part_num_group "Boot Group ID number in the part number" UBYTE CU_MPL_BOOT_PART_NUM_GROUP 1 100 0.0 255.0 ECU_ADDRESS 0x40022a58 BYTE_ORDER MSB_FIRST /end MEASUREMENT
/begin COMPU_METHOD CU_MPL_BOOT_PART_NUM_GROUP "Conversion method for mpl_boot_part_num_group" RAT_FUNC "%10.0" "(not defined)" COEFFS 0.000000 1.000000 0.000000 0.000000 0.000000 1.000000 /end COMPU_METHOD
/* Scalar measurable for DDE 'mpl_boot_part_num_id'. */
/begin MEASUREMENT mpl_boot_part_num_id "Boot Part ID in the part number" ULONG CU_MPL_BOOT_PART_NUM_ID 1 100 0.0 4294967295.0 ECU_ADDRESS 0x40022a5c BYTE_ORDER MSB_FIRST /end MEASUREMENT
/begin COMPU_METHOD CU_MPL_BOOT_PART_NUM_ID "Conversion method for mpl_boot_part_num_id" RAT_FUNC "%10.0" "(not defined)" COEFFS 0.000000 1.000000 0.000000 0.000000 0.000000 1.000000 /end COMPU_METHOD
/* Scalar measurable for DDE 'mpl_boot_part_num_issue'. */
/begin MEASUREMENT mpl_boot_part_num_issue "Boot Issue Number in the part number" UWORD CU_MPL_BOOT_PART_NUM_ISSUE 1 100 0.0 65535.0 ECU_ADDRESS 0x40022a60 BYTE_ORDER MSB_FIRST /end MEASUREMENT
/begin COMPU_METHOD CU_MPL_BOOT_PART_NUM_ISSUE "Conversion method for mpl_boot_part_num_issue" RAT_FUNC "%10.0" "(not defined)" COEFFS 0.000000 1.000000 0.000000 0.000000 0.000000 1.000000 /end COMPU_METHOD
/* Scalar measurable for DDE 'mpl_boot_part_num_letter'. */
/begin MEASUREMENT mpl_boot_part_num_letter "Boot Group Letter in the part number" UBYTE CU_MPL_BOOT_PART_NUM_LETTER 1 100 0.0 255.0 ECU_ADDRESS 0x40022a59 BYTE_ORDER MSB_FIRST /end MEASUREMENT
/begin COMPU_METHOD CU_MPL_BOOT_PART_NUM_LETTER "Conversion method for mpl_boot_part_num_letter" RAT_FUNC "%10.0" "(not defined)" COEFFS 0.000000 1.000000 0.000000 0.000000 0.000000 1.000000 /end COMPU_METHOD
/* Scalar measurable for DDE 'mpl_boot_ver_major'. */
/begin MEASUREMENT mpl_boot_ver_major "Boot major version number" UWORD CU_MPL_BOOT_VER_MAJOR 1 100 0.0 65535.0 ECU_ADDRESS 0x40022a4c BYTE_ORDER MSB_FIRST /end MEASUREMENT
/begin COMPU_METHOD CU_MPL_BOOT_VER_MAJOR "Conversion method for mpl_boot_ver_major" RAT_FUNC "%10.0" "(not defined)" COEFFS 0.000000 1.000000 0.000000 0.000000 0.000000 1.000000 /end COMPU_METHOD
/* Scalar measurable for DDE 'mpl_boot_ver_minor'. */
/begin MEASUREMENT mpl_boot_ver_minor "Boot minor version number" UWORD CU_MPL_BOOT_VER_MINOR 1 100 0.0 65535.0 ECU_ADDRESS 0x40022a4e BYTE_ORDER MSB_FIRST /end MEASUREMENT
/begin COMPU_METHOD CU_MPL_BOOT_VER_MINOR "Conversion method for mpl_boot_ver_minor" RAT_FUNC "%10.0" "(not defined)" COEFFS 0.000000 1.000000 0.000000 0.000000 0.000000 1.000000 /end COMPU_METHOD
/* Scalar measurable for DDE 'mpl_boot_ver_sub'. */
/begin MEASUREMENT mpl_boot_ver_sub "Boot sub minor version number" UWORD CU_MPL_BOOT_VER_SUB 1 100 0.0 65535.0 ECU_ADDRESS 0x40022a50 BYTE_ORDER MSB_FIRST /end MEASUREMENT
/begin COMPU_METHOD CU_MPL_BOOT_VER_SUB "Conversion method for mpl_boot_ver_sub" RAT_FUNC "%10.0" "(not defined)" COEFFS 0.000000 1.000000 0.000000 0.000000 0.000000 1.000000 /end COMPU_METHOD
/* Scalar measurable for DDE 'mpl_cpu_loaded'. */
/begin MEASUREMENT mpl_cpu_loaded "CPU loading each 50ms" UBYTE CU_MPL_CPU_LOADED 1 100 0.0 255.0 ECU_ADDRESS 0x40022a44 BYTE_ORDER MSB_FIRST /end MEASUREMENT
/begin COMPU_METHOD CU_MPL_CPU_LOADED "Conversion method for mpl_cpu_loaded" RAT_FUNC "%10.0" "%" COEFFS 0.000000 1.000000 0.000000 0.000000 0.000000 1.000000 /end COMPU_METHOD
/* Scalar measurable for DDE 'mpl_cpu_loaded_1000ms'. */
/begin MEASUREMENT mpl_cpu_loaded_1000ms "CPU loading each second" UBYTE CU_MPL_CPU_LOADED_1000MS 1 100 0.0 255.0 ECU_ADDRESS 0x40022a45 BYTE_ORDER MSB_FIRST /end MEASUREMENT
/begin COMPU_METHOD CU_MPL_CPU_LOADED_1000MS "Conversion method for mpl_cpu_loaded_1000ms" RAT_FUNC "%10.0" "%" COEFFS 0.000000 1.000000 0.000000 0.000000 0.000000 1.000000 /end COMPU_METHOD
/* Scalar measurable for DDE 'mpl_cpu_loaded_50ms'. */
/begin MEASUREMENT mpl_cpu_loaded_50ms "CPU loading each 50ms" UBYTE CU_MPL_CPU_LOADED_50MS 1 100 0.0 255.0 ECU_ADDRESS 0x40022a44 BYTE_ORDER MSB_FIRST /end MEASUREMENT
/begin COMPU_METHOD CU_MPL_CPU_LOADED_50MS "Conversion method for mpl_cpu_loaded_50ms" RAT_FUNC "%10.0" "%" COEFFS 0.000000 1.000000 0.000000 0.000000 0.000000 1.000000 /end COMPU_METHOD
/* Scalar measurable for DDE 'mpl_ecc_flash_address'. */
/begin MEASUREMENT mpl_ecc_flash_address "Address of last Flash non-correctable ECC error, zero if no error has occurred." ULONG CU_MPL_ECC_FLASH_ADDRESS 1 100 0.0 4294967295.0 ECU_ADDRESS 0x40022c30 BYTE_ORDER MSB_FIRST /end MEASUREMENT
/begin COMPU_METHOD CU_MPL_ECC_FLASH_ADDRESS "Conversion method for mpl_ecc_flash_address" RAT_FUNC "%10.0" "addr" COEFFS 0.000000 1.000000 0.000000 0.000000 0.000000 1.000000 /end COMPU_METHOD
/* Scalar measurable for DDE 'mpl_ecc_ram_address'. */
/begin MEASUREMENT mpl_ecc_ram_address "Address of last RAM non-correctable ECC error, zero if no error has occurred." ULONG CU_MPL_ECC_RAM_ADDRESS 1 100 0.0 4294967295.0 ECU_ADDRESS 0x40022c2c BYTE_ORDER MSB_FIRST /end MEASUREMENT
/begin COMPU_METHOD CU_MPL_ECC_RAM_ADDRESS "Conversion method for mpl_ecc_ram_address" RAT_FUNC "%10.0" "addr" COEFFS 0.000000 1.000000 0.000000 0.000000 0.000000 1.000000 /end COMPU_METHOD
/* Scalar measurable for DDE 'mpl_flp_div_by_zero'. */
/begin MEASUREMENT mpl_flp_div_by_zero "Set if FLP division by zero has occurred since the last reset, clear otherwise." UBYTE CU_MPL_FLP_DIV_BY_ZERO 1 100 0.0 255.0 ECU_ADDRESS 0x40022ce6 BYTE_ORDER MSB_FIRST /end MEASUREMENT
/begin COMPU_METHOD CU_MPL_FLP_DIV_BY_ZERO "Conversion method for mpl_flp_div_by_zero" RAT_FUNC "%10.0" "flag" COEFFS 0.000000 1.000000 0.000000 0.000000 0.000000 1.000000 /end COMPU_METHOD
/* Scalar measurable for DDE 'mpl_flp_inexact'. */
/begin MEASUREMENT mpl_flp_inexact "Set if an inexact FLP result has occurred since the last reset, clear otherwise." UBYTE CU_MPL_FLP_INEXACT 1 100 0.0 255.0 ECU_ADDRESS 0x40022ce7 BYTE_ORDER MSB_FIRST /end MEASUREMENT
/begin COMPU_METHOD CU_MPL_FLP_INEXACT "Conversion method for mpl_flp_inexact" RAT_FUNC "%10.0" "flag" COEFFS 0.000000 1.000000 0.000000 0.000000 0.000000 1.000000 /end COMPU_METHOD
/* Scalar measurable for DDE 'mpl_flp_invalid'. */
/begin MEASUREMENT mpl_flp_invalid "Set if an invalid FLP result has occurred since the last reset, clear otherwise." UBYTE CU_MPL_FLP_INVALID 1 100 0.0 255.0 ECU_ADDRESS 0x40022ce8 BYTE_ORDER MSB_FIRST /end MEASUREMENT
/begin COMPU_METHOD CU_MPL_FLP_INVALID "Conversion method for mpl_flp_invalid" RAT_FUNC "%10.0" "flag" COEFFS 0.000000 1.000000 0.000000 0.000000 0.000000 1.000000 /end COMPU_METHOD
/* Scalar measurable for DDE 'mpl_flp_overflow'. */
/begin MEASUREMENT mpl_flp_overflow "Set if FLP overflow has occurred since the last reset, clear otherwise." UBYTE CU_MPL_FLP_OVERFLOW 1 100 0.0 255.0 ECU_ADDRESS 0x40022ce4 BYTE_ORDER MSB_FIRST /end MEASUREMENT
/begin COMPU_METHOD CU_MPL_FLP_OVERFLOW "Conversion method for mpl_flp_overflow" RAT_FUNC "%10.0" "flag" COEFFS 0.000000 1.000000 0.000000 0.000000 0.000000 1.000000 /end COMPU_METHOD
/* Scalar measurable for DDE 'mpl_flp_underflow'. */
/begin MEASUREMENT mpl_flp_underflow "Set if FLP underflow has occurred since the last reset, clear otherwise." UBYTE CU_MPL_FLP_UNDERFLOW 1 100 0.0 255.0 ECU_ADDRESS 0x40022ce5 BYTE_ORDER MSB_FIRST /end MEASUREMENT
/begin COMPU_METHOD CU_MPL_FLP_UNDERFLOW "Conversion method for mpl_flp_underflow" RAT_FUNC "%10.0" "flag" COEFFS 0.000000 1.000000 0.000000 0.000000 0.000000 1.000000 /end COMPU_METHOD
/* Scalar measurable for DDE 'mpl_max_cpu_loaded'. */
/begin MEASUREMENT mpl_max_cpu_loaded "Maximum CPU loading seen since startup" UBYTE CU_MPL_MAX_CPU_LOADED 1 100 0.0 255.0 ECU_ADDRESS 0x40022a48 BYTE_ORDER MSB_FIRST /end MEASUREMENT
/begin COMPU_METHOD CU_MPL_MAX_CPU_LOADED "Conversion method for mpl_max_cpu_loaded" RAT_FUNC "%10.0" "%" COEFFS 0.000000 1.000000 0.000000 0.000000 0.000000 1.000000 /end COMPU_METHOD
/* Scalar measurable for DDE 'mpl_max_cpu_loaded_1000ms'. */
/begin MEASUREMENT mpl_max_cpu_loaded_1000ms "Maximum CPU loading seen since startup" UBYTE CU_MPL_MAX_CPU_LOADED_1000MS 1 100 0.0 255.0 ECU_ADDRESS 0x40022a49 BYTE_ORDER MSB_FIRST /end MEASUREMENT
/begin COMPU_METHOD CU_MPL_MAX_CPU_LOADED_1000MS "Conversion method for mpl_max_cpu_loaded_1000ms" RAT_FUNC "%10.0" "%" COEFFS 0.000000 1.000000 0.000000 0.000000 0.000000 1.000000 /end COMPU_METHOD
/* Scalar measurable for DDE 'mpl_max_cpu_loaded_50ms'. */
/begin MEASUREMENT mpl_max_cpu_loaded_50ms "Maximum CPU loading seen since startup" UBYTE CU_MPL_MAX_CPU_LOADED_50MS 1 100 0.0 255.0 ECU_ADDRESS 0x40022a48 BYTE_ORDER MSB_FIRST /end MEASUREMENT
/begin COMPU_METHOD CU_MPL_MAX_CPU_LOADED_50MS "Conversion method for mpl_max_cpu_loaded_50ms" RAT_FUNC "%10.0" "%" COEFFS 0.000000 1.000000 0.000000 0.000000 0.000000 1.000000 /end COMPU_METHOD
/* Scalar measurable for DDE 'mpl_max_used_stack'. */
/begin MEASUREMENT mpl_max_used_stack "Amount of stack used during runtime so far." ULONG CU_MPL_MAX_USED_STACK 1 100 0.0 4294967295.0 ECU_ADDRESS 0x40022ab0 BYTE_ORDER MSB_FIRST /end MEASUREMENT
/begin COMPU_METHOD CU_MPL_MAX_USED_STACK "Conversion method for mpl_max_used_stack" RAT_FUNC "%10.0" "bytes" COEFFS 0.000000 1.000000 0.000000 0.000000 0.000000 1.000000 /end COMPU_METHOD
/* Scalar measurable for DDE 'mpl_mtt_pcp_client'. */
/begin MEASUREMENT mpl_mtt_pcp_client "Duration of library task: pcp_client" ULONG CU_MPL_MTT_PCP_CLIENT 1 100 0.0 4294967295.0 ECU_ADDRESS 0x40024a90 BYTE_ORDER MSB_FIRST /end MEASUREMENT
/begin COMPU_METHOD CU_MPL_MTT_PCP_CLIENT "Conversion method for mpl_mtt_pcp_client" RAT_FUNC "%10.0" "microseconds" COEFFS 0.000000 80.000000 0.000000 0.000000 0.000000 1.000000 /end COMPU_METHOD
/* Scalar measurable for DDE 'mpl_mtt_pcx_can_callback'. */
/begin MEASUREMENT mpl_mtt_pcx_can_callback "Duration of library task: pcx_can_callback" ULONG CU_MPL_MTT_PCX_CAN_CALLBACK 1 100 0.0 4294967295.0 ECU_ADDRESS 0x40024a4c BYTE_ORDER MSB_FIRST /end MEASUREMENT
/begin COMPU_METHOD CU_MPL_MTT_PCX_CAN_CALLBACK "Conversion method for mpl_mtt_pcx_can_callback" RAT_FUNC "%10.0" "microseconds" COEFFS 0.000000 80.000000 0.000000 0.000000 0.000000 1.000000 /end COMPU_METHOD
/* Scalar measurable for DDE 'mpl_mtt_pcx_periodic'. */
/begin MEASUREMENT mpl_mtt_pcx_periodic "Duration of library task: pcx_periodic" ULONG CU_MPL_MTT_PCX_PERIODIC 1 100 0.0 4294967295.0 ECU_ADDRESS 0x40024a84 BYTE_ORDER MSB_FIRST /end MEASUREMENT
/begin COMPU_METHOD CU_MPL_MTT_PCX_PERIODIC "Conversion method for mpl_mtt_pcx_periodic" RAT_FUNC "%10.0" "microseconds" COEFFS 0.000000 80.000000 0.000000 0.000000 0.000000 1.000000 /end COMPU_METHOD
/* Scalar measurable for DDE 'mpl_mtt_pcx_qemptier'. */
/begin MEASUREMENT mpl_mtt_pcx_qemptier "Duration of library task: pcx_qemptier" ULONG CU_MPL_MTT_PCX_QEMPTIER 1 100 0.0 4294967295.0 ECU_ADDRESS 0x40024a88 BYTE_ORDER MSB_FIRST /end MEASUREMENT
/begin COMPU_METHOD CU_MPL_MTT_PCX_QEMPTIER "Conversion method for mpl_mtt_pcx_qemptier" RAT_FUNC "%10.0" "microseconds" COEFFS 0.000000 80.000000 0.000000 0.000000 0.000000 1.000000 /end COMPU_METHOD
/* Scalar measurable for DDE 'mpl_mtt_pdg_client_task'. */
/begin MEASUREMENT mpl_mtt_pdg_client_task "Duration of library task: pdg_client_task" ULONG CU_MPL_MTT_PDG_CLIENT_TASK 1 100 0.0 4294967295.0 ECU_ADDRESS 0x40024a60 BYTE_ORDER MSB_FIRST /end MEASUREMENT
/begin COMPU_METHOD CU_MPL_MTT_PDG_CLIENT_TASK "Conversion method for mpl_mtt_pdg_client_task" RAT_FUNC "%10.0" "microseconds" COEFFS 0.000000 80.000000 0.000000 0.000000 0.000000 1.000000 /end COMPU_METHOD
/* Scalar measurable for DDE 'mpl_mtt_pdtc_client_task'. */
/begin MEASUREMENT mpl_mtt_pdtc_client_task "Duration of library task: pdtc_client_task" ULONG CU_MPL_MTT_PDTC_CLIENT_TASK 1 100 0.0 4294967295.0 ECU_ADDRESS 0x40024a80 BYTE_ORDER MSB_FIRST /end MEASUREMENT
/begin COMPU_METHOD CU_MPL_MTT_PDTC_CLIENT_TASK "Conversion method for mpl_mtt_pdtc_client_task" RAT_FUNC "%10.0" "microseconds" COEFFS 0.000000 80.000000 0.000000 0.000000 0.000000 1.000000 /end COMPU_METHOD
/* Scalar measurable for DDE 'mpl_mtt_pff_client'. */
/begin MEASUREMENT mpl_mtt_pff_client "Duration of library task: pff_client" ULONG CU_MPL_MTT_PFF_CLIENT 1 100 0.0 4294967295.0 ECU_ADDRESS 0x40024a54 BYTE_ORDER MSB_FIRST /end MEASUREMENT
/begin COMPU_METHOD CU_MPL_MTT_PFF_CLIENT "Conversion method for mpl_mtt_pff_client" RAT_FUNC "%10.0" "microseconds" COEFFS 0.000000 80.000000 0.000000 0.000000 0.000000 1.000000 /end COMPU_METHOD
/* Scalar measurable for DDE 'mpl_mtt_pfs_client'. */
/begin MEASUREMENT mpl_mtt_pfs_client "Duration of library task: pfs_client" ULONG CU_MPL_MTT_PFS_CLIENT 1 100 0.0 4294967295.0 ECU_ADDRESS 0x40024a58 BYTE_ORDER MSB_FIRST /end MEASUREMENT
/begin COMPU_METHOD CU_MPL_MTT_PFS_CLIENT "Conversion method for mpl_mtt_pfs_client" RAT_FUNC "%10.0" "microseconds" COEFFS 0.000000 80.000000 0.000000 0.000000 0.000000 1.000000 /end COMPU_METHOD
/* Scalar measurable for DDE 'mpl_mtt_pfsm_task'. */
/begin MEASUREMENT mpl_mtt_pfsm_task "Duration of library task: pfsm_task" ULONG CU_MPL_MTT_PFSM_TASK 1 100 0.0 4294967295.0 ECU_ADDRESS 0x40024a38 BYTE_ORDER MSB_FIRST /end MEASUREMENT
/begin COMPU_METHOD CU_MPL_MTT_PFSM_TASK "Conversion method for mpl_mtt_pfsm_task" RAT_FUNC "%10.0" "microseconds" COEFFS 0.000000 80.000000 0.000000 0.000000 0.000000 1.000000 /end COMPU_METHOD
/* Scalar measurable for DDE 'mpl_mtt_piso_client_task'. */
/begin MEASUREMENT mpl_mtt_piso_client_task "Duration of library task: piso_client_task" ULONG CU_MPL_MTT_PISO_CLIENT_TASK 1 100 0.0 4294967295.0 ECU_ADDRESS 0x40024a5c BYTE_ORDER MSB_FIRST /end MEASUREMENT
/begin COMPU_METHOD CU_MPL_MTT_PISO_CLIENT_TASK "Conversion method for mpl_mtt_piso_client_task" RAT_FUNC "%10.0" "microseconds" COEFFS 0.000000 80.000000 0.000000 0.000000 0.000000 1.000000 /end COMPU_METHOD
/* Scalar measurable for DDE 'mpl_mtt_pj1939_client'. */
/begin MEASUREMENT mpl_mtt_pj1939_client "Duration of library task: pj1939_client" ULONG CU_MPL_MTT_PJ1939_CLIENT 1 100 0.0 4294967295.0 ECU_ADDRESS 0x40024a50 BYTE_ORDER MSB_FIRST /end MEASUREMENT
/begin COMPU_METHOD CU_MPL_MTT_PJ1939_CLIENT "Conversion method for mpl_mtt_pj1939_client" RAT_FUNC "%10.0" "microseconds" COEFFS 0.000000 80.000000 0.000000 0.000000 0.000000 1.000000 /end COMPU_METHOD
/* Scalar measurable for DDE 'mpl_mtt_pmios_client_task'. */
/begin MEASUREMENT mpl_mtt_pmios_client_task "Duration of library task: pmios_client_task" ULONG CU_MPL_MTT_PMIOS_CLIENT_TASK 1 100 0.0 4294967295.0 ECU_ADDRESS 0x40024a64 BYTE_ORDER MSB_FIRST /end MEASUREMENT
/begin COMPU_METHOD CU_MPL_MTT_PMIOS_CLIENT_TASK "Conversion method for mpl_mtt_pmios_client_task" RAT_FUNC "%10.0" "microseconds" COEFFS 0.000000 80.000000 0.000000 0.000000 0.000000 1.000000 /end COMPU_METHOD
/* Scalar measurable for DDE 'mpl_mtt_ppm_task'. */
/begin MEASUREMENT mpl_mtt_ppm_task "Duration of library task: ppm_task" ULONG CU_MPL_MTT_PPM_TASK 1 100 0.0 4294967295.0 ECU_ADDRESS 0x40024a3c BYTE_ORDER MSB_FIRST /end MEASUREMENT
/begin COMPU_METHOD CU_MPL_MTT_PPM_TASK "Conversion method for mpl_mtt_ppm_task" RAT_FUNC "%10.0" "microseconds" COEFFS 0.000000 80.000000 0.000000 0.000000 0.000000 1.000000 /end COMPU_METHOD
/* Scalar measurable for DDE 'mpl_mtt_pqca_client'. */
/begin MEASUREMENT mpl_mtt_pqca_client "Duration of library task: pqca_client" ULONG CU_MPL_MTT_PQCA_CLIENT 1 100 0.0 4294967295.0 ECU_ADDRESS 0x40024a48 BYTE_ORDER MSB_FIRST /end MEASUREMENT
/begin COMPU_METHOD CU_MPL_MTT_PQCA_CLIENT "Conversion method for mpl_mtt_pqca_client" RAT_FUNC "%10.0" "microseconds" COEFFS 0.000000 80.000000 0.000000 0.000000 0.000000 1.000000 /end COMPU_METHOD
/* Scalar measurable for DDE 'mpl_mtt_psc_watchdog'. */
/begin MEASUREMENT mpl_mtt_psc_watchdog "Duration of library task: psc_watchdog" ULONG CU_MPL_MTT_PSC_WATCHDOG 1 100 0.0 4294967295.0 ECU_ADDRESS 0x40024a8c BYTE_ORDER MSB_FIRST /end MEASUREMENT
/begin COMPU_METHOD CU_MPL_MTT_PSC_WATCHDOG "Conversion method for mpl_mtt_psc_watchdog" RAT_FUNC "%10.0" "microseconds" COEFFS 0.000000 80.000000 0.000000 0.000000 0.000000 1.000000 /end COMPU_METHOD
/* Scalar measurable for DDE 'mpl_mtt_psp_receive'. */
/begin MEASUREMENT mpl_mtt_psp_receive "Duration of library task: psp_receive" ULONG CU_MPL_MTT_PSP_RECEIVE 1 100 0.0 4294967295.0 ECU_ADDRESS 0x40024a40 BYTE_ORDER MSB_FIRST /end MEASUREMENT
/begin COMPU_METHOD CU_MPL_MTT_PSP_RECEIVE "Conversion method for mpl_mtt_psp_receive" RAT_FUNC "%10.0" "microseconds" COEFFS 0.000000 80.000000 0.000000 0.000000 0.000000 1.000000 /end COMPU_METHOD
/* Scalar measurable for DDE 'mpl_mtt_puart_linflexd_periodic'. */
/begin MEASUREMENT mpl_mtt_puart_linflexd_periodic "Duration of library task: puart_linflexd_periodic" ULONG CU_MPL_MTT_PUART_LINFLEXD_PERI0 1 100 0.0 4294967295.0 ECU_ADDRESS 0x40024a68 BYTE_ORDER MSB_FIRST /end MEASUREMENT
/begin COMPU_METHOD CU_MPL_MTT_PUART_LINFLEXD_PERI0 "Conversion method for mpl_mtt_puart_linflexd_periodic" RAT_FUNC "%10.0" "microseconds" COEFFS 0.000000 80.000000 0.000000 0.000000 0.000000 1.000000 /end COMPU_METHOD
/* Scalar measurable for DDE 'mpl_mtt_pv2g_client'. */
/begin MEASUREMENT mpl_mtt_pv2g_client "Duration of library task: pv2g_client" ULONG CU_MPL_MTT_PV2G_CLIENT 1 100 0.0 4294967295.0 ECU_ADDRESS 0x40024a44 BYTE_ORDER MSB_FIRST /end MEASUREMENT
/begin COMPU_METHOD CU_MPL_MTT_PV2G_CLIENT "Conversion method for mpl_mtt_pv2g_client" RAT_FUNC "%10.0" "microseconds" COEFFS 0.000000 80.000000 0.000000 0.000000 0.000000 1.000000 /end COMPU_METHOD
/* Scalar measurable for DDE 'mpl_mtt_task_1000ms'. */
/begin MEASUREMENT mpl_mtt_task_1000ms "Duration of application task: task_1000ms" ULONG CU_MPL_MTT_TASK_1000MS 1 100 0.0 4294967295.0 ECU_ADDRESS 0x40024a7c BYTE_ORDER MSB_FIRST /end MEASUREMENT
/begin COMPU_METHOD CU_MPL_MTT_TASK_1000MS "Conversion method for mpl_mtt_task_1000ms" RAT_FUNC "%10.0" "microseconds" COEFFS 0.000000 80.000000 0.000000 0.000000 0.000000 1.000000 /end COMPU_METHOD
/* Scalar measurable for DDE 'mpl_mtt_task_100ms'. */
/begin MEASUREMENT mpl_mtt_task_100ms "Duration of application task: task_100ms" ULONG CU_MPL_MTT_TASK_100MS 1 100 0.0 4294967295.0 ECU_ADDRESS 0x40024a74 BYTE_ORDER MSB_FIRST /end MEASUREMENT
/begin COMPU_METHOD CU_MPL_MTT_TASK_100MS "Conversion method for mpl_mtt_task_100ms" RAT_FUNC "%10.0" "microseconds" COEFFS 0.000000 80.000000 0.000000 0.000000 0.000000 1.000000 /end COMPU_METHOD
/* Scalar measurable for DDE 'mpl_mtt_task_10ms'. */
/begin MEASUREMENT mpl_mtt_task_10ms "Duration of application task: task_10ms" ULONG CU_MPL_MTT_TASK_10MS 1 100 0.0 4294967295.0 ECU_ADDRESS 0x40024a6c BYTE_ORDER MSB_FIRST /end MEASUREMENT
/begin COMPU_METHOD CU_MPL_MTT_TASK_10MS "Conversion method for mpl_mtt_task_10ms" RAT_FUNC "%10.0" "microseconds" COEFFS 0.000000 80.000000 0.000000 0.000000 0.000000 1.000000 /end COMPU_METHOD
/* Scalar measurable for DDE 'mpl_mtt_task_20ms'. */
/begin MEASUREMENT mpl_mtt_task_20ms "Duration of application task: task_20ms" ULONG CU_MPL_MTT_TASK_20MS 1 100 0.0 4294967295.0 ECU_ADDRESS 0x40024a70 BYTE_ORDER MSB_FIRST /end MEASUREMENT
/begin COMPU_METHOD CU_MPL_MTT_TASK_20MS "Conversion method for mpl_mtt_task_20ms" RAT_FUNC "%10.0" "microseconds" COEFFS 0.000000 80.000000 0.000000 0.000000 0.000000 1.000000 /end COMPU_METHOD
/* Scalar measurable for DDE 'mpl_mtt_task_500ms'. */
/begin MEASUREMENT mpl_mtt_task_500ms "Duration of application task: task_500ms" ULONG CU_MPL_MTT_TASK_500MS 1 100 0.0 4294967295.0 ECU_ADDRESS 0x40024a78 BYTE_ORDER MSB_FIRST /end MEASUREMENT
/begin COMPU_METHOD CU_MPL_MTT_TASK_500MS "Conversion method for mpl_mtt_task_500ms" RAT_FUNC "%10.0" "microseconds" COEFFS 0.000000 80.000000 0.000000 0.000000 0.000000 1.000000 /end COMPU_METHOD
/* Scalar measurable for DDE 'mpl_ovrc_pcp_client'. */
/begin MEASUREMENT mpl_ovrc_pcp_client "Overrun count of library task: pcp_client" UBYTE CU_MPL_OVRC_PCP_CLIENT 1 100 0.0 255.0 ECU_ADDRESS 0x40025dd6 BYTE_ORDER MSB_FIRST /end MEASUREMENT
/begin COMPU_METHOD CU_MPL_OVRC_PCP_CLIENT "Conversion method for mpl_ovrc_pcp_client" RAT_FUNC "%10.0" "count" COEFFS 0.000000 1.000000 0.000000 0.000000 0.000000 1.000000 /end COMPU_METHOD
/* Scalar measurable for DDE 'mpl_ovrc_pcx_can_callback'. */
/begin MEASUREMENT mpl_ovrc_pcx_can_callback "Overrun count of library task: pcx_can_callback" UBYTE CU_MPL_OVRC_PCX_CAN_CALLBACK 1 100 0.0 255.0 ECU_ADDRESS 0x40025dc5 BYTE_ORDER MSB_FIRST /end MEASUREMENT
/begin COMPU_METHOD CU_MPL_OVRC_PCX_CAN_CALLBACK "Conversion method for mpl_ovrc_pcx_can_callback" RAT_FUNC "%10.0" "count" COEFFS 0.000000 1.000000 0.000000 0.000000 0.000000 1.000000 /end COMPU_METHOD
/* Scalar measurable for DDE 'mpl_ovrc_pcx_periodic'. */
/begin MEASUREMENT mpl_ovrc_pcx_periodic "Overrun count of library task: pcx_periodic" UBYTE CU_MPL_OVRC_PCX_PERIODIC 1 100 0.0 255.0 ECU_ADDRESS 0x40025dd3 BYTE_ORDER MSB_FIRST /end MEASUREMENT
/begin COMPU_METHOD CU_MPL_OVRC_PCX_PERIODIC "Conversion method for mpl_ovrc_pcx_periodic" RAT_FUNC "%10.0" "count" COEFFS 0.000000 1.000000 0.000000 0.000000 0.000000 1.000000 /end COMPU_METHOD
/* Scalar measurable for DDE 'mpl_ovrc_pcx_qemptier'. */
/begin MEASUREMENT mpl_ovrc_pcx_qemptier "Overrun count of library task: pcx_qemptier" UBYTE CU_MPL_OVRC_PCX_QEMPTIER 1 100 0.0 255.0 ECU_ADDRESS 0x40025dd4 BYTE_ORDER MSB_FIRST /end MEASUREMENT
/begin COMPU_METHOD CU_MPL_OVRC_PCX_QEMPTIER "Conversion method for mpl_ovrc_pcx_qemptier" RAT_FUNC "%10.0" "count" COEFFS 0.000000 1.000000 0.000000 0.000000 0.000000 1.000000 /end COMPU_METHOD
/* Scalar measurable for DDE 'mpl_ovrc_pdg_client_task'. */
/begin MEASUREMENT mpl_ovrc_pdg_client_task "Overrun count of library task: pdg_client_task" UBYTE CU_MPL_OVRC_PDG_CLIENT_TASK 1 100 0.0 255.0 ECU_ADDRESS 0x40025dca BYTE_ORDER MSB_FIRST /end MEASUREMENT
/begin COMPU_METHOD CU_MPL_OVRC_PDG_CLIENT_TASK "Conversion method for mpl_ovrc_pdg_client_task" RAT_FUNC "%10.0" "count" COEFFS 0.000000 1.000000 0.000000 0.000000 0.000000 1.000000 /end COMPU_METHOD
/* Scalar measurable for DDE 'mpl_ovrc_pdtc_client_task'. */
/begin MEASUREMENT mpl_ovrc_pdtc_client_task "Overrun count of library task: pdtc_client_task" UBYTE CU_MPL_OVRC_PDTC_CLIENT_TASK 1 100 0.0 255.0 ECU_ADDRESS 0x40025dd2 BYTE_ORDER MSB_FIRST /end MEASUREMENT
/begin COMPU_METHOD CU_MPL_OVRC_PDTC_CLIENT_TASK "Conversion method for mpl_ovrc_pdtc_client_task" RAT_FUNC "%10.0" "count" COEFFS 0.000000 1.000000 0.000000 0.000000 0.000000 1.000000 /end COMPU_METHOD
/* Scalar measurable for DDE 'mpl_ovrc_pff_client'. */
/begin MEASUREMENT mpl_ovrc_pff_client "Overrun count of library task: pff_client" UBYTE CU_MPL_OVRC_PFF_CLIENT 1 100 0.0 255.0 ECU_ADDRESS 0x40025dc7 BYTE_ORDER MSB_FIRST /end MEASUREMENT
/begin COMPU_METHOD CU_MPL_OVRC_PFF_CLIENT "Conversion method for mpl_ovrc_pff_client" RAT_FUNC "%10.0" "count" COEFFS 0.000000 1.000000 0.000000 0.000000 0.000000 1.000000 /end COMPU_METHOD
/* Scalar measurable for DDE 'mpl_ovrc_pfs_client'. */
/begin MEASUREMENT mpl_ovrc_pfs_client "Overrun count of library task: pfs_client" UBYTE CU_MPL_OVRC_PFS_CLIENT 1 100 0.0 255.0 ECU_ADDRESS 0x40025dc8 BYTE_ORDER MSB_FIRST /end MEASUREMENT
/begin COMPU_METHOD CU_MPL_OVRC_PFS_CLIENT "Conversion method for mpl_ovrc_pfs_client" RAT_FUNC "%10.0" "count" COEFFS 0.000000 1.000000 0.000000 0.000000 0.000000 1.000000 /end COMPU_METHOD
/* Scalar measurable for DDE 'mpl_ovrc_pfsm_task'. */
/begin MEASUREMENT mpl_ovrc_pfsm_task "Overrun count of library task: pfsm_task" UBYTE CU_MPL_OVRC_PFSM_TASK 1 100 0.0 255.0 ECU_ADDRESS 0x40025dc0 BYTE_ORDER MSB_FIRST /end MEASUREMENT
/begin COMPU_METHOD CU_MPL_OVRC_PFSM_TASK "Conversion method for mpl_ovrc_pfsm_task" RAT_FUNC "%10.0" "count" COEFFS 0.000000 1.000000 0.000000 0.000000 0.000000 1.000000 /end COMPU_METHOD
/* Scalar measurable for DDE 'mpl_ovrc_piso_client_task'. */
/begin MEASUREMENT mpl_ovrc_piso_client_task "Overrun count of library task: piso_client_task" UBYTE CU_MPL_OVRC_PISO_CLIENT_TASK 1 100 0.0 255.0 ECU_ADDRESS 0x40025dc9 BYTE_ORDER MSB_FIRST /end MEASUREMENT
/begin COMPU_METHOD CU_MPL_OVRC_PISO_CLIENT_TASK "Conversion method for mpl_ovrc_piso_client_task" RAT_FUNC "%10.0" "count" COEFFS 0.000000 1.000000 0.000000 0.000000 0.000000 1.000000 /end COMPU_METHOD
/* Scalar measurable for DDE 'mpl_ovrc_pj1939_client'. */
/begin MEASUREMENT mpl_ovrc_pj1939_client "Overrun count of library task: pj1939_client" UBYTE CU_MPL_OVRC_PJ1939_CLIENT 1 100 0.0 255.0 ECU_ADDRESS 0x40025dc6 BYTE_ORDER MSB_FIRST /end MEASUREMENT
/begin COMPU_METHOD CU_MPL_OVRC_PJ1939_CLIENT "Conversion method for mpl_ovrc_pj1939_client" RAT_FUNC "%10.0" "count" COEFFS 0.000000 1.000000 0.000000 0.000000 0.000000 1.000000 /end COMPU_METHOD
/* Scalar measurable for DDE 'mpl_ovrc_pmios_client_task'. */
/begin MEASUREMENT mpl_ovrc_pmios_client_task "Overrun count of library task: pmios_client_task" UBYTE CU_MPL_OVRC_PMIOS_CLIENT_TASK 1 100 0.0 255.0 ECU_ADDRESS 0x40025dcb BYTE_ORDER MSB_FIRST /end MEASUREMENT
/begin COMPU_METHOD CU_MPL_OVRC_PMIOS_CLIENT_TASK "Conversion method for mpl_ovrc_pmios_client_task" RAT_FUNC "%10.0" "count" COEFFS 0.000000 1.000000 0.000000 0.000000 0.000000 1.000000 /end COMPU_METHOD
/* Scalar measurable for DDE 'mpl_ovrc_ppm_task'. */
/begin MEASUREMENT mpl_ovrc_ppm_task "Overrun count of library task: ppm_task" UBYTE CU_MPL_OVRC_PPM_TASK 1 100 0.0 255.0 ECU_ADDRESS 0x40025dc1 BYTE_ORDER MSB_FIRST /end MEASUREMENT
/begin COMPU_METHOD CU_MPL_OVRC_PPM_TASK "Conversion method for mpl_ovrc_ppm_task" RAT_FUNC "%10.0" "count" COEFFS 0.000000 1.000000 0.000000 0.000000 0.000000 1.000000 /end COMPU_METHOD
/* Scalar measurable for DDE 'mpl_ovrc_pqca_client'. */
/begin MEASUREMENT mpl_ovrc_pqca_client "Overrun count of library task: pqca_client" UBYTE CU_MPL_OVRC_PQCA_CLIENT 1 100 0.0 255.0 ECU_ADDRESS 0x40025dc4 BYTE_ORDER MSB_FIRST /end MEASUREMENT
/begin COMPU_METHOD CU_MPL_OVRC_PQCA_CLIENT "Conversion method for mpl_ovrc_pqca_client" RAT_FUNC "%10.0" "count" COEFFS 0.000000 1.000000 0.000000 0.000000 0.000000 1.000000 /end COMPU_METHOD
/* Scalar measurable for DDE 'mpl_ovrc_psc_watchdog'. */
/begin MEASUREMENT mpl_ovrc_psc_watchdog "Overrun count of library task: psc_watchdog" UBYTE CU_MPL_OVRC_PSC_WATCHDOG 1 100 0.0 255.0 ECU_ADDRESS 0x40025dd5 BYTE_ORDER MSB_FIRST /end MEASUREMENT
/begin COMPU_METHOD CU_MPL_OVRC_PSC_WATCHDOG "Conversion method for mpl_ovrc_psc_watchdog" RAT_FUNC "%10.0" "count" COEFFS 0.000000 1.000000 0.000000 0.000000 0.000000 1.000000 /end COMPU_METHOD
/* Scalar measurable for DDE 'mpl_ovrc_psp_receive'. */
/begin MEASUREMENT mpl_ovrc_psp_receive "Overrun count of library task: psp_receive" UBYTE CU_MPL_OVRC_PSP_RECEIVE 1 100 0.0 255.0 ECU_ADDRESS 0x40025dc2 BYTE_ORDER MSB_FIRST /end MEASUREMENT
/begin COMPU_METHOD CU_MPL_OVRC_PSP_RECEIVE "Conversion method for mpl_ovrc_psp_receive" RAT_FUNC "%10.0" "count" COEFFS 0.000000 1.000000 0.000000 0.000000 0.000000 1.000000 /end COMPU_METHOD
/* Scalar measurable for DDE 'mpl_ovrc_puart_linflexd_periodic'. */
/begin MEASUREMENT mpl_ovrc_puart_linflexd_period0 "Overrun count of library task: puart_linflexd_periodic" UBYTE CU_MPL_OVRC_PUART_LINFLEXD_PER0 1 100 0.0 255.0 ECU_ADDRESS 0x40025dcc BYTE_ORDER MSB_FIRST /end MEASUREMENT
/begin COMPU_METHOD CU_MPL_OVRC_PUART_LINFLEXD_PER0 "Conversion method for mpl_ovrc_puart_linflexd_periodic" RAT_FUNC "%10.0" "count" COEFFS 0.000000 1.000000 0.000000 0.000000 0.000000 1.000000 /end COMPU_METHOD
/* Scalar measurable for DDE 'mpl_ovrc_pv2g_client'. */
/begin MEASUREMENT mpl_ovrc_pv2g_client "Overrun count of library task: pv2g_client" UBYTE CU_MPL_OVRC_PV2G_CLIENT 1 100 0.0 255.0 ECU_ADDRESS 0x40025dc3 BYTE_ORDER MSB_FIRST /end MEASUREMENT
/begin COMPU_METHOD CU_MPL_OVRC_PV2G_CLIENT "Conversion method for mpl_ovrc_pv2g_client" RAT_FUNC "%10.0" "count" COEFFS 0.000000 1.000000 0.000000 0.000000 0.000000 1.000000 /end COMPU_METHOD
/* Scalar measurable for DDE 'mpl_ovrc_task_1000ms'. */
/begin MEASUREMENT mpl_ovrc_task_1000ms "Overrun count of application task: task_1000ms" UBYTE CU_MPL_OVRC_TASK_1000MS 1 100 0.0 255.0 ECU_ADDRESS 0x40025dd1 BYTE_ORDER MSB_FIRST /end MEASUREMENT
/begin COMPU_METHOD CU_MPL_OVRC_TASK_1000MS "Conversion method for mpl_ovrc_task_1000ms" RAT_FUNC "%10.0" "count" COEFFS 0.000000 1.000000 0.000000 0.000000 0.000000 1.000000 /end COMPU_METHOD
/* Scalar measurable for DDE 'mpl_ovrc_task_100ms'. */
/begin MEASUREMENT mpl_ovrc_task_100ms "Overrun count of application task: task_100ms" UBYTE CU_MPL_OVRC_TASK_100MS 1 100 0.0 255.0 ECU_ADDRESS 0x40025dcf BYTE_ORDER MSB_FIRST /end MEASUREMENT
/begin COMPU_METHOD CU_MPL_OVRC_TASK_100MS "Conversion method for mpl_ovrc_task_100ms" RAT_FUNC "%10.0" "count" COEFFS 0.000000 1.000000 0.000000 0.000000 0.000000 1.000000 /end COMPU_METHOD
/* Scalar measurable for DDE 'mpl_ovrc_task_10ms'. */
/begin MEASUREMENT mpl_ovrc_task_10ms "Overrun count of application task: task_10ms" UBYTE CU_MPL_OVRC_TASK_10MS 1 100 0.0 255.0 ECU_ADDRESS 0x40025dcd BYTE_ORDER MSB_FIRST /end MEASUREMENT
/begin COMPU_METHOD CU_MPL_OVRC_TASK_10MS "Conversion method for mpl_ovrc_task_10ms" RAT_FUNC "%10.0" "count" COEFFS 0.000000 1.000000 0.000000 0.000000 0.000000 1.000000 /end COMPU_METHOD
/* Scalar measurable for DDE 'mpl_ovrc_task_20ms'. */
/begin MEASUREMENT mpl_ovrc_task_20ms "Overrun count of application task: task_20ms" UBYTE CU_MPL_OVRC_TASK_20MS 1 100 0.0 255.0 ECU_ADDRESS 0x40025dce BYTE_ORDER MSB_FIRST /end MEASUREMENT
/begin COMPU_METHOD CU_MPL_OVRC_TASK_20MS "Conversion method for mpl_ovrc_task_20ms" RAT_FUNC "%10.0" "count" COEFFS 0.000000 1.000000 0.000000 0.000000 0.000000 1.000000 /end COMPU_METHOD
/* Scalar measurable for DDE 'mpl_ovrc_task_500ms'. */
/begin MEASUREMENT mpl_ovrc_task_500ms "Overrun count of application task: task_500ms" UBYTE CU_MPL_OVRC_TASK_500MS 1 100 0.0 255.0 ECU_ADDRESS 0x40025dd0 BYTE_ORDER MSB_FIRST /end MEASUREMENT
/begin COMPU_METHOD CU_MPL_OVRC_TASK_500MS "Conversion method for mpl_ovrc_task_500ms" RAT_FUNC "%10.0" "count" COEFFS 0.000000 1.000000 0.000000 0.000000 0.000000 1.000000 /end COMPU_METHOD
/* Scalar measurable for DDE 'mpl_plat_build_day'. */
/begin MEASUREMENT mpl_plat_build_day "Platform build day" UWORD CU_MPL_PLAT_BUILD_DAY 1 100 0.0 65535.0 ECU_ADDRESS 0x40022a7c BYTE_ORDER MSB_FIRST /end MEASUREMENT
/begin COMPU_METHOD CU_MPL_PLAT_BUILD_DAY "Conversion method for mpl_plat_build_day" RAT_FUNC "%10.0" "(not defined)" COEFFS 0.000000 1.000000 0.000000 0.000000 0.000000 1.000000 /end COMPU_METHOD
/* Scalar measurable for DDE 'mpl_plat_build_month'. */
/begin MEASUREMENT mpl_plat_build_month "Platform build month" UWORD CU_MPL_PLAT_BUILD_MONTH 1 100 0.0 65535.0 ECU_ADDRESS 0x40022a7e BYTE_ORDER MSB_FIRST /end MEASUREMENT
/begin COMPU_METHOD CU_MPL_PLAT_BUILD_MONTH "Conversion method for mpl_plat_build_month" RAT_FUNC "%10.0" "(not defined)" COEFFS 0.000000 1.000000 0.000000 0.000000 0.000000 1.000000 /end COMPU_METHOD
/* Scalar measurable for DDE 'mpl_plat_build_year'. */
/begin MEASUREMENT mpl_plat_build_year "Platform build year" UWORD CU_MPL_PLAT_BUILD_YEAR 1 100 0.0 65535.0 ECU_ADDRESS 0x40022a80 BYTE_ORDER MSB_FIRST /end MEASUREMENT
/begin COMPU_METHOD CU_MPL_PLAT_BUILD_YEAR "Conversion method for mpl_plat_build_year" RAT_FUNC "%10.0" "(not defined)" COEFFS 0.000000 1.000000 0.000000 0.000000 0.000000 1.000000 /end COMPU_METHOD
/* Scalar measurable for DDE 'mpl_plat_part_num_group'. */
/begin MEASUREMENT mpl_plat_part_num_group "Platform Group ID number of the part number" UBYTE CU_MPL_PLAT_PART_NUM_GROUP 1 100 0.0 255.0 ECU_ADDRESS 0x40022a82 BYTE_ORDER MSB_FIRST /end MEASUREMENT
/begin COMPU_METHOD CU_MPL_PLAT_PART_NUM_GROUP "Conversion method for mpl_plat_part_num_group" RAT_FUNC "%10.0" "(not defined)" COEFFS 0.000000 1.000000 0.000000 0.000000 0.000000 1.000000 /end COMPU_METHOD
/* Scalar measurable for DDE 'mpl_plat_part_num_id'. */
/begin MEASUREMENT mpl_plat_part_num_id "Platform Part ID of the part number" ULONG CU_MPL_PLAT_PART_NUM_ID 1 100 0.0 4294967295.0 ECU_ADDRESS 0x40022a84 BYTE_ORDER MSB_FIRST /end MEASUREMENT
/begin COMPU_METHOD CU_MPL_PLAT_PART_NUM_ID "Conversion method for mpl_plat_part_num_id" RAT_FUNC "%10.0" "(not defined)" COEFFS 0.000000 1.000000 0.000000 0.000000 0.000000 1.000000 /end COMPU_METHOD
/* Scalar measurable for DDE 'mpl_plat_part_num_issue'. */
/begin MEASUREMENT mpl_plat_part_num_issue "Platform Issue number of the part number" UWORD CU_MPL_PLAT_PART_NUM_ISSUE 1 100 0.0 65535.0 ECU_ADDRESS 0x40022a88 BYTE_ORDER MSB_FIRST /end MEASUREMENT
/begin COMPU_METHOD CU_MPL_PLAT_PART_NUM_ISSUE "Conversion method for mpl_plat_part_num_issue" RAT_FUNC "%10.0" "(not defined)" COEFFS 0.000000 1.000000 0.000000 0.000000 0.000000 1.000000 /end COMPU_METHOD
/* Scalar measurable for DDE 'mpl_plat_part_num_letter'. */
/begin MEASUREMENT mpl_plat_part_num_letter "Platform Group Letter of the part number" UBYTE CU_MPL_PLAT_PART_NUM_LETTER 1 100 0.0 255.0 ECU_ADDRESS 0x40022a83 BYTE_ORDER MSB_FIRST /end MEASUREMENT
/begin COMPU_METHOD CU_MPL_PLAT_PART_NUM_LETTER "Conversion method for mpl_plat_part_num_letter" RAT_FUNC "%10.0" "(not defined)" COEFFS 0.000000 1.000000 0.000000 0.000000 0.000000 1.000000 /end COMPU_METHOD
/* Scalar measurable for DDE 'mpl_plat_ver_major'. */
/begin MEASUREMENT mpl_plat_ver_major "Platform major version number" UWORD CU_MPL_PLAT_VER_MAJOR 1 100 0.0 65535.0 ECU_ADDRESS 0x40022a76 BYTE_ORDER MSB_FIRST /end MEASUREMENT
/begin COMPU_METHOD CU_MPL_PLAT_VER_MAJOR "Conversion method for mpl_plat_ver_major" RAT_FUNC "%10.0" "(not defined)" COEFFS 0.000000 1.000000 0.000000 0.000000 0.000000 1.000000 /end COMPU_METHOD
/* Scalar measurable for DDE 'mpl_plat_ver_minor'. */
/begin MEASUREMENT mpl_plat_ver_minor "Platform minor version number" UWORD CU_MPL_PLAT_VER_MINOR 1 100 0.0 65535.0 ECU_ADDRESS 0x40022a78 BYTE_ORDER MSB_FIRST /end MEASUREMENT
/begin COMPU_METHOD CU_MPL_PLAT_VER_MINOR "Conversion method for mpl_plat_ver_minor" RAT_FUNC "%10.0" "(not defined)" COEFFS 0.000000 1.000000 0.000000 0.000000 0.000000 1.000000 /end COMPU_METHOD
/* Scalar measurable for DDE 'mpl_plat_ver_sub'. */
/begin MEASUREMENT mpl_plat_ver_sub "Platform sub minor version number" UWORD CU_MPL_PLAT_VER_SUB 1 100 0.0 65535.0 ECU_ADDRESS 0x40022a7a BYTE_ORDER MSB_FIRST /end MEASUREMENT
/begin COMPU_METHOD CU_MPL_PLAT_VER_SUB "Conversion method for mpl_plat_ver_sub" RAT_FUNC "%10.0" "(not defined)" COEFFS 0.000000 1.000000 0.000000 0.000000 0.000000 1.000000 /end COMPU_METHOD
/* Scalar measurable for DDE 'mpl_prg_build_day'. */
/begin MEASUREMENT mpl_prg_build_day "PRG build day" UWORD CU_MPL_PRG_BUILD_DAY 1 100 0.0 65535.0 ECU_ADDRESS 0x40022a68 BYTE_ORDER MSB_FIRST /end MEASUREMENT
/begin COMPU_METHOD CU_MPL_PRG_BUILD_DAY "Conversion method for mpl_prg_build_day" RAT_FUNC "%10.0" "(not defined)" COEFFS 0.000000 1.000000 0.000000 0.000000 0.000000 1.000000 /end COMPU_METHOD
/* Scalar measurable for DDE 'mpl_prg_build_month'. */
/begin MEASUREMENT mpl_prg_build_month "PRG build month" UWORD CU_MPL_PRG_BUILD_MONTH 1 100 0.0 65535.0 ECU_ADDRESS 0x40022a6a BYTE_ORDER MSB_FIRST /end MEASUREMENT
/begin COMPU_METHOD CU_MPL_PRG_BUILD_MONTH "Conversion method for mpl_prg_build_month" RAT_FUNC "%10.0" "(not defined)" COEFFS 0.000000 1.000000 0.000000 0.000000 0.000000 1.000000 /end COMPU_METHOD
/* Scalar measurable for DDE 'mpl_prg_build_year'. */
/begin MEASUREMENT mpl_prg_build_year "PRG build year" UWORD CU_MPL_PRG_BUILD_YEAR 1 100 0.0 65535.0 ECU_ADDRESS 0x40022a6c BYTE_ORDER MSB_FIRST /end MEASUREMENT
/begin COMPU_METHOD CU_MPL_PRG_BUILD_YEAR "Conversion method for mpl_prg_build_year" RAT_FUNC "%10.0" "(not defined)" COEFFS 0.000000 1.000000 0.000000 0.000000 0.000000 1.000000 /end COMPU_METHOD
/* Scalar measurable for DDE 'mpl_prg_part_num_group'. */
/begin MEASUREMENT mpl_prg_part_num_group "PRG Group ID number in the part number" UBYTE CU_MPL_PRG_PART_NUM_GROUP 1 100 0.0 255.0 ECU_ADDRESS 0x40022a6e BYTE_ORDER MSB_FIRST /end MEASUREMENT
/begin COMPU_METHOD CU_MPL_PRG_PART_NUM_GROUP "Conversion method for mpl_prg_part_num_group" RAT_FUNC "%10.0" "(not defined)" COEFFS 0.000000 1.000000 0.000000 0.000000 0.000000 1.000000 /end COMPU_METHOD
/* Scalar measurable for DDE 'mpl_prg_part_num_id'. */
/begin MEASUREMENT mpl_prg_part_num_id "PRG Part ID in the part number" ULONG CU_MPL_PRG_PART_NUM_ID 1 100 0.0 4294967295.0 ECU_ADDRESS 0x40022a70 BYTE_ORDER MSB_FIRST /end MEASUREMENT
/begin COMPU_METHOD CU_MPL_PRG_PART_NUM_ID "Conversion method for mpl_prg_part_num_id" RAT_FUNC "%10.0" "(not defined)" COEFFS 0.000000 1.000000 0.000000 0.000000 0.000000 1.000000 /end COMPU_METHOD
/* Scalar measurable for DDE 'mpl_prg_part_num_issue'. */
/begin MEASUREMENT mpl_prg_part_num_issue "PRG Issue number in the part number" UWORD CU_MPL_PRG_PART_NUM_ISSUE 1 100 0.0 65535.0 ECU_ADDRESS 0x40022a74 BYTE_ORDER MSB_FIRST /end MEASUREMENT
/begin COMPU_METHOD CU_MPL_PRG_PART_NUM_ISSUE "Conversion method for mpl_prg_part_num_issue" RAT_FUNC "%10.0" "(not defined)" COEFFS 0.000000 1.000000 0.000000 0.000000 0.000000 1.000000 /end COMPU_METHOD
/* Scalar measurable for DDE 'mpl_prg_part_num_letter'. */
/begin MEASUREMENT mpl_prg_part_num_letter "PRG Group Letter in the part number" UBYTE CU_MPL_PRG_PART_NUM_LETTER 1 100 0.0 255.0 ECU_ADDRESS 0x40022a6f BYTE_ORDER MSB_FIRST /end MEASUREMENT
/begin COMPU_METHOD CU_MPL_PRG_PART_NUM_LETTER "Conversion method for mpl_prg_part_num_letter" RAT_FUNC "%10.0" "(not defined)" COEFFS 0.000000 1.000000 0.000000 0.000000 0.000000 1.000000 /end COMPU_METHOD
/* Scalar measurable for DDE 'mpl_prg_ver_major'. */
/begin MEASUREMENT mpl_prg_ver_major "PRG major version number" UWORD CU_MPL_PRG_VER_MAJOR 1 100 0.0 65535.0 ECU_ADDRESS 0x40022a62 BYTE_ORDER MSB_FIRST /end MEASUREMENT
/begin COMPU_METHOD CU_MPL_PRG_VER_MAJOR "Conversion method for mpl_prg_ver_major" RAT_FUNC "%10.0" "(not defined)" COEFFS 0.000000 1.000000 0.000000 0.000000 0.000000 1.000000 /end COMPU_METHOD
/* Scalar measurable for DDE 'mpl_prg_ver_minor'. */
/begin MEASUREMENT mpl_prg_ver_minor "PRG minor version number" UWORD CU_MPL_PRG_VER_MINOR 1 100 0.0 65535.0 ECU_ADDRESS 0x40022a64 BYTE_ORDER MSB_FIRST /end MEASUREMENT
/begin COMPU_METHOD CU_MPL_PRG_VER_MINOR "Conversion method for mpl_prg_ver_minor" RAT_FUNC "%10.0" "(not defined)" COEFFS 0.000000 1.000000 0.000000 0.000000 0.000000 1.000000 /end COMPU_METHOD
/* Scalar measurable for DDE 'mpl_prg_ver_sub'. */
/begin MEASUREMENT mpl_prg_ver_sub "PRG sub minor version number" UWORD CU_MPL_PRG_VER_SUB 1 100 0.0 65535.0 ECU_ADDRESS 0x40022a66 BYTE_ORDER MSB_FIRST /end MEASUREMENT
/begin COMPU_METHOD CU_MPL_PRG_VER_SUB "Conversion method for mpl_prg_ver_sub" RAT_FUNC "%10.0" "(not defined)" COEFFS 0.000000 1.000000 0.000000 0.000000 0.000000 1.000000 /end COMPU_METHOD
/* Scalar measurable for DDE 'mpl_reset_count'. */
/begin MEASUREMENT mpl_reset_count "Number of resets since power-up." ULONG CU_MPL_RESET_COUNT 1 100 0.0 4294967295.0 ECU_ADDRESS 0x40022a9c BYTE_ORDER MSB_FIRST /end MEASUREMENT
/begin COMPU_METHOD CU_MPL_RESET_COUNT "Conversion method for mpl_reset_count" RAT_FUNC "%10.0" "events" COEFFS 0.000000 1.000000 0.000000 0.000000 0.000000 1.000000 /end COMPU_METHOD
/* Scalar measurable for DDE 'mpl_run_time'. */
/begin MEASUREMENT mpl_run_time "Time since startup" ULONG CU_MPL_RUN_TIME 1 100 0.0 4294967295.0 ECU_ADDRESS 0x40022aac BYTE_ORDER MSB_FIRST /end MEASUREMENT
/begin COMPU_METHOD CU_MPL_RUN_TIME "Conversion method for mpl_run_time" RAT_FUNC "%10.0" "seconds" COEFFS 0.000000 1.000000 0.000000 0.000000 0.000000 1.000000 /end COMPU_METHOD
/* Scalar measurable for DDE 'mpl_skipc_pcp_client'. */
/begin MEASUREMENT mpl_skipc_pcp_client "Skip count of library task: pcp_client" UBYTE CU_MPL_SKIPC_PCP_CLIENT 1 100 0.0 255.0 ECU_ADDRESS 0x40025d66 BYTE_ORDER MSB_FIRST /end MEASUREMENT
/begin COMPU_METHOD CU_MPL_SKIPC_PCP_CLIENT "Conversion method for mpl_skipc_pcp_client" RAT_FUNC "%10.0" "count" COEFFS 0.000000 1.000000 0.000000 0.000000 0.000000 1.000000 /end COMPU_METHOD
/* Scalar measurable for DDE 'mpl_skipc_pcx_can_callback'. */
/begin MEASUREMENT mpl_skipc_pcx_can_callback "Skip count of library task: pcx_can_callback" UBYTE CU_MPL_SKIPC_PCX_CAN_CALLBACK 1 100 0.0 255.0 ECU_ADDRESS 0x40025d55 BYTE_ORDER MSB_FIRST /end MEASUREMENT
/begin COMPU_METHOD CU_MPL_SKIPC_PCX_CAN_CALLBACK "Conversion method for mpl_skipc_pcx_can_callback" RAT_FUNC "%10.0" "count" COEFFS 0.000000 1.000000 0.000000 0.000000 0.000000 1.000000 /end COMPU_METHOD
/* Scalar measurable for DDE 'mpl_skipc_pcx_periodic'. */
/begin MEASUREMENT mpl_skipc_pcx_periodic "Skip count of library task: pcx_periodic" UBYTE CU_MPL_SKIPC_PCX_PERIODIC 1 100 0.0 255.0 ECU_ADDRESS 0x40025d63 BYTE_ORDER MSB_FIRST /end MEASUREMENT
/begin COMPU_METHOD CU_MPL_SKIPC_PCX_PERIODIC "Conversion method for mpl_skipc_pcx_periodic" RAT_FUNC "%10.0" "count" COEFFS 0.000000 1.000000 0.000000 0.000000 0.000000 1.000000 /end COMPU_METHOD
/* Scalar measurable for DDE 'mpl_skipc_pcx_qemptier'. */
/begin MEASUREMENT mpl_skipc_pcx_qemptier "Skip count of library task: pcx_qemptier" UBYTE CU_MPL_SKIPC_PCX_QEMPTIER 1 100 0.0 255.0 ECU_ADDRESS 0x40025d64 BYTE_ORDER MSB_FIRST /end MEASUREMENT
/begin COMPU_METHOD CU_MPL_SKIPC_PCX_QEMPTIER "Conversion method for mpl_skipc_pcx_qemptier" RAT_FUNC "%10.0" "count" COEFFS 0.000000 1.000000 0.000000 0.000000 0.000000 1.000000 /end COMPU_METHOD
/* Scalar measurable for DDE 'mpl_skipc_pdg_client_task'. */
/begin MEASUREMENT mpl_skipc_pdg_client_task "Skip count of library task: pdg_client_task" UBYTE CU_MPL_SKIPC_PDG_CLIENT_TASK 1 100 0.0 255.0 ECU_ADDRESS 0x40025d5a BYTE_ORDER MSB_FIRST /end MEASUREMENT
/begin COMPU_METHOD CU_MPL_SKIPC_PDG_CLIENT_TASK "Conversion method for mpl_skipc_pdg_client_task" RAT_FUNC "%10.0" "count" COEFFS 0.000000 1.000000 0.000000 0.000000 0.000000 1.000000 /end COMPU_METHOD
/* Scalar measurable for DDE 'mpl_skipc_pdtc_client_task'. */
/begin MEASUREMENT mpl_skipc_pdtc_client_task "Skip count of library task: pdtc_client_task" UBYTE CU_MPL_SKIPC_PDTC_CLIENT_TASK 1 100 0.0 255.0 ECU_ADDRESS 0x40025d62 BYTE_ORDER MSB_FIRST /end MEASUREMENT
/begin COMPU_METHOD CU_MPL_SKIPC_PDTC_CLIENT_TASK "Conversion method for mpl_skipc_pdtc_client_task" RAT_FUNC "%10.0" "count" COEFFS 0.000000 1.000000 0.000000 0.000000 0.000000 1.000000 /end COMPU_METHOD
/* Scalar measurable for DDE 'mpl_skipc_pff_client'. */
/begin MEASUREMENT mpl_skipc_pff_client "Skip count of library task: pff_client" UBYTE CU_MPL_SKIPC_PFF_CLIENT 1 100 0.0 255.0 ECU_ADDRESS 0x40025d57 BYTE_ORDER MSB_FIRST /end MEASUREMENT
/begin COMPU_METHOD CU_MPL_SKIPC_PFF_CLIENT "Conversion method for mpl_skipc_pff_client" RAT_FUNC "%10.0" "count" COEFFS 0.000000 1.000000 0.000000 0.000000 0.000000 1.000000 /end COMPU_METHOD
/* Scalar measurable for DDE 'mpl_skipc_pfs_client'. */
/begin MEASUREMENT mpl_skipc_pfs_client "Skip count of library task: pfs_client" UBYTE CU_MPL_SKIPC_PFS_CLIENT 1 100 0.0 255.0 ECU_ADDRESS 0x40025d58 BYTE_ORDER MSB_FIRST /end MEASUREMENT
/begin COMPU_METHOD CU_MPL_SKIPC_PFS_CLIENT "Conversion method for mpl_skipc_pfs_client" RAT_FUNC "%10.0" "count" COEFFS 0.000000 1.000000 0.000000 0.000000 0.000000 1.000000 /end COMPU_METHOD
/* Scalar measurable for DDE 'mpl_skipc_pfsm_task'. */
/begin MEASUREMENT mpl_skipc_pfsm_task "Skip count of library task: pfsm_task" UBYTE CU_MPL_SKIPC_PFSM_TASK 1 100 0.0 255.0 ECU_ADDRESS 0x40025d50 BYTE_ORDER MSB_FIRST /end MEASUREMENT
/begin COMPU_METHOD CU_MPL_SKIPC_PFSM_TASK "Conversion method for mpl_skipc_pfsm_task" RAT_FUNC "%10.0" "count" COEFFS 0.000000 1.000000 0.000000 0.000000 0.000000 1.000000 /end COMPU_METHOD
/* Scalar measurable for DDE 'mpl_skipc_piso_client_task'. */
/begin MEASUREMENT mpl_skipc_piso_client_task "Skip count of library task: piso_client_task" UBYTE CU_MPL_SKIPC_PISO_CLIENT_TASK 1 100 0.0 255.0 ECU_ADDRESS 0x40025d59 BYTE_ORDER MSB_FIRST /end MEASUREMENT
/begin COMPU_METHOD CU_MPL_SKIPC_PISO_CLIENT_TASK "Conversion method for mpl_skipc_piso_client_task" RAT_FUNC "%10.0" "count" COEFFS 0.000000 1.000000 0.000000 0.000000 0.000000 1.000000 /end COMPU_METHOD
/* Scalar measurable for DDE 'mpl_skipc_pj1939_client'. */
/begin MEASUREMENT mpl_skipc_pj1939_client "Skip count of library task: pj1939_client" UBYTE CU_MPL_SKIPC_PJ1939_CLIENT 1 100 0.0 255.0 ECU_ADDRESS 0x40025d56 BYTE_ORDER MSB_FIRST /end MEASUREMENT
/begin COMPU_METHOD CU_MPL_SKIPC_PJ1939_CLIENT "Conversion method for mpl_skipc_pj1939_client" RAT_FUNC "%10.0" "count" COEFFS 0.000000 1.000000 0.000000 0.000000 0.000000 1.000000 /end COMPU_METHOD
/* Scalar measurable for DDE 'mpl_skipc_pmios_client_task'. */
/begin MEASUREMENT mpl_skipc_pmios_client_task "Skip count of library task: pmios_client_task" UBYTE CU_MPL_SKIPC_PMIOS_CLIENT_TASK 1 100 0.0 255.0 ECU_ADDRESS 0x40025d5b BYTE_ORDER MSB_FIRST /end MEASUREMENT
/begin COMPU_METHOD CU_MPL_SKIPC_PMIOS_CLIENT_TASK "Conversion method for mpl_skipc_pmios_client_task" RAT_FUNC "%10.0" "count" COEFFS 0.000000 1.000000 0.000000 0.000000 0.000000 1.000000 /end COMPU_METHOD
/* Scalar measurable for DDE 'mpl_skipc_ppm_task'. */
/begin MEASUREMENT mpl_skipc_ppm_task "Skip count of library task: ppm_task" UBYTE CU_MPL_SKIPC_PPM_TASK 1 100 0.0 255.0 ECU_ADDRESS 0x40025d51 BYTE_ORDER MSB_FIRST /end MEASUREMENT
/begin COMPU_METHOD CU_MPL_SKIPC_PPM_TASK "Conversion method for mpl_skipc_ppm_task" RAT_FUNC "%10.0" "count" COEFFS 0.000000 1.000000 0.000000 0.000000 0.000000 1.000000 /end COMPU_METHOD
/* Scalar measurable for DDE 'mpl_skipc_pqca_client'. */
/begin MEASUREMENT mpl_skipc_pqca_client "Skip count of library task: pqca_client" UBYTE CU_MPL_SKIPC_PQCA_CLIENT 1 100 0.0 255.0 ECU_ADDRESS 0x40025d54 BYTE_ORDER MSB_FIRST /end MEASUREMENT
/begin COMPU_METHOD CU_MPL_SKIPC_PQCA_CLIENT "Conversion method for mpl_skipc_pqca_client" RAT_FUNC "%10.0" "count" COEFFS 0.000000 1.000000 0.000000 0.000000 0.000000 1.000000 /end COMPU_METHOD
/* Scalar measurable for DDE 'mpl_skipc_psc_watchdog'. */
/begin MEASUREMENT mpl_skipc_psc_watchdog "Skip count of library task: psc_watchdog" UBYTE CU_MPL_SKIPC_PSC_WATCHDOG 1 100 0.0 255.0 ECU_ADDRESS 0x40025d65 BYTE_ORDER MSB_FIRST /end MEASUREMENT
/begin COMPU_METHOD CU_MPL_SKIPC_PSC_WATCHDOG "Conversion method for mpl_skipc_psc_watchdog" RAT_FUNC "%10.0" "count" COEFFS 0.000000 1.000000 0.000000 0.000000 0.000000 1.000000 /end COMPU_METHOD
/* Scalar measurable for DDE 'mpl_skipc_psp_receive'. */
/begin MEASUREMENT mpl_skipc_psp_receive "Skip count of library task: psp_receive" UBYTE CU_MPL_SKIPC_PSP_RECEIVE 1 100 0.0 255.0 ECU_ADDRESS 0x40025d52 BYTE_ORDER MSB_FIRST /end MEASUREMENT
/begin COMPU_METHOD CU_MPL_SKIPC_PSP_RECEIVE "Conversion method for mpl_skipc_psp_receive" RAT_FUNC "%10.0" "count" COEFFS 0.000000 1.000000 0.000000 0.000000 0.000000 1.000000 /end COMPU_METHOD
/* Scalar measurable for DDE 'mpl_skipc_puart_linflexd_periodic'. */
/begin MEASUREMENT mpl_skipc_puart_linflexd_perio0 "Skip count of library task: puart_linflexd_periodic" UBYTE CU_MPL_SKIPC_PUART_LINFLEXD_PE0 1 100 0.0 255.0 ECU_ADDRESS 0x40025d5c BYTE_ORDER MSB_FIRST /end MEASUREMENT
/begin COMPU_METHOD CU_MPL_SKIPC_PUART_LINFLEXD_PE0 "Conversion method for mpl_skipc_puart_linflexd_periodic" RAT_FUNC "%10.0" "count" COEFFS 0.000000 1.000000 0.000000 0.000000 0.000000 1.000000 /end COMPU_METHOD
/* Scalar measurable for DDE 'mpl_skipc_pv2g_client'. */
/begin MEASUREMENT mpl_skipc_pv2g_client "Skip count of library task: pv2g_client" UBYTE CU_MPL_SKIPC_PV2G_CLIENT 1 100 0.0 255.0 ECU_ADDRESS 0x40025d53 BYTE_ORDER MSB_FIRST /end MEASUREMENT
/begin COMPU_METHOD CU_MPL_SKIPC_PV2G_CLIENT "Conversion method for mpl_skipc_pv2g_client" RAT_FUNC "%10.0" "count" COEFFS 0.000000 1.000000 0.000000 0.000000 0.000000 1.000000 /end COMPU_METHOD
/* Scalar measurable for DDE 'mpl_skipc_task_1000ms'. */
/begin MEASUREMENT mpl_skipc_task_1000ms "Skip count of application task: task_1000ms" UBYTE CU_MPL_SKIPC_TASK_1000MS 1 100 0.0 255.0 ECU_ADDRESS 0x40025d61 BYTE_ORDER MSB_FIRST /end MEASUREMENT
/begin COMPU_METHOD CU_MPL_SKIPC_TASK_1000MS "Conversion method for mpl_skipc_task_1000ms" RAT_FUNC "%10.0" "count" COEFFS 0.000000 1.000000 0.000000 0.000000 0.000000 1.000000 /end COMPU_METHOD
/* Scalar measurable for DDE 'mpl_skipc_task_100ms'. */
/begin MEASUREMENT mpl_skipc_task_100ms "Skip count of application task: task_100ms" UBYTE CU_MPL_SKIPC_TASK_100MS 1 100 0.0 255.0 ECU_ADDRESS 0x40025d5f BYTE_ORDER MSB_FIRST /end MEASUREMENT
/begin COMPU_METHOD CU_MPL_SKIPC_TASK_100MS "Conversion method for mpl_skipc_task_100ms" RAT_FUNC "%10.0" "count" COEFFS 0.000000 1.000000 0.000000 0.000000 0.000000 1.000000 /end COMPU_METHOD
/* Scalar measurable for DDE 'mpl_skipc_task_10ms'. */
/begin MEASUREMENT mpl_skipc_task_10ms "Skip count of application task: task_10ms" UBYTE CU_MPL_SKIPC_TASK_10MS 1 100 0.0 255.0 ECU_ADDRESS 0x40025d5d BYTE_ORDER MSB_FIRST /end MEASUREMENT
/begin COMPU_METHOD CU_MPL_SKIPC_TASK_10MS "Conversion method for mpl_skipc_task_10ms" RAT_FUNC "%10.0" "count" COEFFS 0.000000 1.000000 0.000000 0.000000 0.000000 1.000000 /end COMPU_METHOD
/* Scalar measurable for DDE 'mpl_skipc_task_20ms'. */
/begin MEASUREMENT mpl_skipc_task_20ms "Skip count of application task: task_20ms" UBYTE CU_MPL_SKIPC_TASK_20MS 1 100 0.0 255.0 ECU_ADDRESS 0x40025d5e BYTE_ORDER MSB_FIRST /end MEASUREMENT
/begin COMPU_METHOD CU_MPL_SKIPC_TASK_20MS "Conversion method for mpl_skipc_task_20ms" RAT_FUNC "%10.0" "count" COEFFS 0.000000 1.000000 0.000000 0.000000 0.000000 1.000000 /end COMPU_METHOD
/* Scalar measurable for DDE 'mpl_skipc_task_500ms'. */
/begin MEASUREMENT mpl_skipc_task_500ms "Skip count of application task: task_500ms" UBYTE CU_MPL_SKIPC_TASK_500MS 1 100 0.0 255.0 ECU_ADDRESS 0x40025d60 BYTE_ORDER MSB_FIRST /end MEASUREMENT
/begin COMPU_METHOD CU_MPL_SKIPC_TASK_500MS "Conversion method for mpl_skipc_task_500ms" RAT_FUNC "%10.0" "count" COEFFS 0.000000 1.000000 0.000000 0.000000 0.000000 1.000000 /end COMPU_METHOD
/* Scalar measurable for DDE 'mpl_stack_limit_data_addr'. */
/begin MEASUREMENT mpl_stack_limit_data_addr "Set to the address of the data access causing the stack limit error, clear otherwise." ULONG CU_MPL_STACK_LIMIT_DATA_ADDR 1 100 0.0 4294967295.0 ECU_ADDRESS 0x40022aa8 BYTE_ORDER MSB_FIRST /end MEASUREMENT
/begin COMPU_METHOD CU_MPL_STACK_LIMIT_DATA_ADDR "Conversion method for mpl_stack_limit_data_addr" RAT_FUNC "%10.0" "flag" COEFFS 0.000000 1.000000 0.000000 0.000000 0.000000 1.000000 /end COMPU_METHOD
/* Scalar measurable for DDE 'mpl_stack_limit_error'. */
/begin MEASUREMENT mpl_stack_limit_error "Set if a stack limit error is detected since the last reset, clear otherwise." UBYTE CU_MPL_STACK_LIMIT_ERROR 1 100 0.0 255.0 ECU_ADDRESS 0x40022aa1 BYTE_ORDER MSB_FIRST /end MEASUREMENT
/begin COMPU_METHOD CU_MPL_STACK_LIMIT_ERROR "Conversion method for mpl_stack_limit_error" RAT_FUNC "%10.0" "flag" COEFFS 0.000000 1.000000 0.000000 0.000000 0.000000 1.000000 /end COMPU_METHOD
/* Scalar measurable for DDE 'mpl_stack_limit_inst_addr'. */
/begin MEASUREMENT mpl_stack_limit_inst_addr "Set to the address of the instruction causing the stack limit error, clear otherwise." ULONG CU_MPL_STACK_LIMIT_INST_ADDR 1 100 0.0 4294967295.0 ECU_ADDRESS 0x40022aa4 BYTE_ORDER MSB_FIRST /end MEASUREMENT
/begin COMPU_METHOD CU_MPL_STACK_LIMIT_INST_ADDR "Conversion method for mpl_stack_limit_inst_addr" RAT_FUNC "%10.0" "flag" COEFFS 0.000000 1.000000 0.000000 0.000000 0.000000 1.000000 /end COMPU_METHOD
/* Scalar measurable for DDE 'mpl_tt_pcp_client'. */
/begin MEASUREMENT mpl_tt_pcp_client "Duration of library task: pcp_client" ULONG CU_MPL_TT_PCP_CLIENT 1 100 0.0 4294967295.0 ECU_ADDRESS 0x40024a30 BYTE_ORDER MSB_FIRST /end MEASUREMENT
/begin COMPU_METHOD CU_MPL_TT_PCP_CLIENT "Conversion method for mpl_tt_pcp_client" RAT_FUNC "%10.0" "microseconds" COEFFS 0.000000 80.000000 0.000000 0.000000 0.000000 1.000000 /end COMPU_METHOD
/* Scalar measurable for DDE 'mpl_tt_pcx_can_callback'. */
/begin MEASUREMENT mpl_tt_pcx_can_callback "Duration of library task: pcx_can_callback" ULONG CU_MPL_TT_PCX_CAN_CALLBACK 1 100 0.0 4294967295.0 ECU_ADDRESS 0x400249ec BYTE_ORDER MSB_FIRST /end MEASUREMENT
/begin COMPU_METHOD CU_MPL_TT_PCX_CAN_CALLBACK "Conversion method for mpl_tt_pcx_can_callback" RAT_FUNC "%10.0" "microseconds" COEFFS 0.000000 80.000000 0.000000 0.000000 0.000000 1.000000 /end COMPU_METHOD
/* Scalar measurable for DDE 'mpl_tt_pcx_periodic'. */
/begin MEASUREMENT mpl_tt_pcx_periodic "Duration of library task: pcx_periodic" ULONG CU_MPL_TT_PCX_PERIODIC 1 100 0.0 4294967295.0 ECU_ADDRESS 0x40024a24 BYTE_ORDER MSB_FIRST /end MEASUREMENT
/begin COMPU_METHOD CU_MPL_TT_PCX_PERIODIC "Conversion method for mpl_tt_pcx_periodic" RAT_FUNC "%10.0" "microseconds" COEFFS 0.000000 80.000000 0.000000 0.000000 0.000000 1.000000 /end COMPU_METHOD
/* Scalar measurable for DDE 'mpl_tt_pcx_qemptier'. */
/begin MEASUREMENT mpl_tt_pcx_qemptier "Duration of library task: pcx_qemptier" ULONG CU_MPL_TT_PCX_QEMPTIER 1 100 0.0 4294967295.0 ECU_ADDRESS 0x40024a28 BYTE_ORDER MSB_FIRST /end MEASUREMENT
/begin COMPU_METHOD CU_MPL_TT_PCX_QEMPTIER "Conversion method for mpl_tt_pcx_qemptier" RAT_FUNC "%10.0" "microseconds" COEFFS 0.000000 80.000000 0.000000 0.000000 0.000000 1.000000 /end COMPU_METHOD
/* Scalar measurable for DDE 'mpl_tt_pdg_client_task'. */
/begin MEASUREMENT mpl_tt_pdg_client_task "Duration of library task: pdg_client_task" ULONG CU_MPL_TT_PDG_CLIENT_TASK 1 100 0.0 4294967295.0 ECU_ADDRESS 0x40024a00 BYTE_ORDER MSB_FIRST /end MEASUREMENT
/begin COMPU_METHOD CU_MPL_TT_PDG_CLIENT_TASK "Conversion method for mpl_tt_pdg_client_task" RAT_FUNC "%10.0" "microseconds" COEFFS 0.000000 80.000000 0.000000 0.000000 0.000000 1.000000 /end COMPU_METHOD
/* Scalar measurable for DDE 'mpl_tt_pdtc_client_task'. */
/begin MEASUREMENT mpl_tt_pdtc_client_task "Duration of library task: pdtc_client_task" ULONG CU_MPL_TT_PDTC_CLIENT_TASK 1 100 0.0 4294967295.0 ECU_ADDRESS 0x40024a20 BYTE_ORDER MSB_FIRST /end MEASUREMENT
/begin COMPU_METHOD CU_MPL_TT_PDTC_CLIENT_TASK "Conversion method for mpl_tt_pdtc_client_task" RAT_FUNC "%10.0" "microseconds" COEFFS 0.000000 80.000000 0.000000 0.000000 0.000000 1.000000 /end COMPU_METHOD
/* Scalar measurable for DDE 'mpl_tt_pff_client'. */
/begin MEASUREMENT mpl_tt_pff_client "Duration of library task: pff_client" ULONG CU_MPL_TT_PFF_CLIENT 1 100 0.0 4294967295.0 ECU_ADDRESS 0x400249f4 BYTE_ORDER MSB_FIRST /end MEASUREMENT
/begin COMPU_METHOD CU_MPL_TT_PFF_CLIENT "Conversion method for mpl_tt_pff_client" RAT_FUNC "%10.0" "microseconds" COEFFS 0.000000 80.000000 0.000000 0.000000 0.000000 1.000000 /end COMPU_METHOD
/* Scalar measurable for DDE 'mpl_tt_pfs_client'. */
/begin MEASUREMENT mpl_tt_pfs_client "Duration of library task: pfs_client" ULONG CU_MPL_TT_PFS_CLIENT 1 100 0.0 4294967295.0 ECU_ADDRESS 0x400249f8 BYTE_ORDER MSB_FIRST /end MEASUREMENT
/begin COMPU_METHOD CU_MPL_TT_PFS_CLIENT "Conversion method for mpl_tt_pfs_client" RAT_FUNC "%10.0" "microseconds" COEFFS 0.000000 80.000000 0.000000 0.000000 0.000000 1.000000 /end COMPU_METHOD
/* Scalar measurable for DDE 'mpl_tt_pfsm_task'. */
/begin MEASUREMENT mpl_tt_pfsm_task "Duration of library task: pfsm_task" ULONG CU_MPL_TT_PFSM_TASK 1 100 0.0 4294967295.0 ECU_ADDRESS 0x400249d8 BYTE_ORDER MSB_FIRST /end MEASUREMENT
/begin COMPU_METHOD CU_MPL_TT_PFSM_TASK "Conversion method for mpl_tt_pfsm_task" RAT_FUNC "%10.0" "microseconds" COEFFS 0.000000 80.000000 0.000000 0.000000 0.000000 1.000000 /end COMPU_METHOD
/* Scalar measurable for DDE 'mpl_tt_piso_client_task'. */
/begin MEASUREMENT mpl_tt_piso_client_task "Duration of library task: piso_client_task" ULONG CU_MPL_TT_PISO_CLIENT_TASK 1 100 0.0 4294967295.0 ECU_ADDRESS 0x400249fc BYTE_ORDER MSB_FIRST /end MEASUREMENT
/begin COMPU_METHOD CU_MPL_TT_PISO_CLIENT_TASK "Conversion method for mpl_tt_piso_client_task" RAT_FUNC "%10.0" "microseconds" COEFFS 0.000000 80.000000 0.000000 0.000000 0.000000 1.000000 /end COMPU_METHOD
/* Scalar measurable for DDE 'mpl_tt_pj1939_client'. */
/begin MEASUREMENT mpl_tt_pj1939_client "Duration of library task: pj1939_client" ULONG CU_MPL_TT_PJ1939_CLIENT 1 100 0.0 4294967295.0 ECU_ADDRESS 0x400249f0 BYTE_ORDER MSB_FIRST /end MEASUREMENT
/begin COMPU_METHOD CU_MPL_TT_PJ1939_CLIENT "Conversion method for mpl_tt_pj1939_client" RAT_FUNC "%10.0" "microseconds" COEFFS 0.000000 80.000000 0.000000 0.000000 0.000000 1.000000 /end COMPU_METHOD
/* Scalar measurable for DDE 'mpl_tt_pmios_client_task'. */
/begin MEASUREMENT mpl_tt_pmios_client_task "Duration of library task: pmios_client_task" ULONG CU_MPL_TT_PMIOS_CLIENT_TASK 1 100 0.0 4294967295.0 ECU_ADDRESS 0x40024a04 BYTE_ORDER MSB_FIRST /end MEASUREMENT
/begin COMPU_METHOD CU_MPL_TT_PMIOS_CLIENT_TASK "Conversion method for mpl_tt_pmios_client_task" RAT_FUNC "%10.0" "microseconds" COEFFS 0.000000 80.000000 0.000000 0.000000 0.000000 1.000000 /end COMPU_METHOD
/* Scalar measurable for DDE 'mpl_tt_ppm_task'. */
/begin MEASUREMENT mpl_tt_ppm_task "Duration of library task: ppm_task" ULONG CU_MPL_TT_PPM_TASK 1 100 0.0 4294967295.0 ECU_ADDRESS 0x400249dc BYTE_ORDER MSB_FIRST /end MEASUREMENT
/begin COMPU_METHOD CU_MPL_TT_PPM_TASK "Conversion method for mpl_tt_ppm_task" RAT_FUNC "%10.0" "microseconds" COEFFS 0.000000 80.000000 0.000000 0.000000 0.000000 1.000000 /end COMPU_METHOD
/* Scalar measurable for DDE 'mpl_tt_pqca_client'. */
/begin MEASUREMENT mpl_tt_pqca_client "Duration of library task: pqca_client" ULONG CU_MPL_TT_PQCA_CLIENT 1 100 0.0 4294967295.0 ECU_ADDRESS 0x400249e8 BYTE_ORDER MSB_FIRST /end MEASUREMENT
/begin COMPU_METHOD CU_MPL_TT_PQCA_CLIENT "Conversion method for mpl_tt_pqca_client" RAT_FUNC "%10.0" "microseconds" COEFFS 0.000000 80.000000 0.000000 0.000000 0.000000 1.000000 /end COMPU_METHOD
/* Scalar measurable for DDE 'mpl_tt_psc_watchdog'. */
/begin MEASUREMENT mpl_tt_psc_watchdog "Duration of library task: psc_watchdog" ULONG CU_MPL_TT_PSC_WATCHDOG 1 100 0.0 4294967295.0 ECU_ADDRESS 0x40024a2c BYTE_ORDER MSB_FIRST /end MEASUREMENT
/begin COMPU_METHOD CU_MPL_TT_PSC_WATCHDOG "Conversion method for mpl_tt_psc_watchdog" RAT_FUNC "%10.0" "microseconds" COEFFS 0.000000 80.000000 0.000000 0.000000 0.000000 1.000000 /end COMPU_METHOD
/* Scalar measurable for DDE 'mpl_tt_psp_receive'. */
/begin MEASUREMENT mpl_tt_psp_receive "Duration of library task: psp_receive" ULONG CU_MPL_TT_PSP_RECEIVE 1 100 0.0 4294967295.0 ECU_ADDRESS 0x400249e0 BYTE_ORDER MSB_FIRST /end MEASUREMENT
/begin COMPU_METHOD CU_MPL_TT_PSP_RECEIVE "Conversion method for mpl_tt_psp_receive" RAT_FUNC "%10.0" "microseconds" COEFFS 0.000000 80.000000 0.000000 0.000000 0.000000 1.000000 /end COMPU_METHOD
/* Scalar measurable for DDE 'mpl_tt_puart_linflexd_periodic'. */
/begin MEASUREMENT mpl_tt_puart_linflexd_periodic "Duration of library task: puart_linflexd_periodic" ULONG CU_MPL_TT_PUART_LINFLEXD_PERIO0 1 100 0.0 4294967295.0 ECU_ADDRESS 0x40024a08 BYTE_ORDER MSB_FIRST /end MEASUREMENT
/begin COMPU_METHOD CU_MPL_TT_PUART_LINFLEXD_PERIO0 "Conversion method for mpl_tt_puart_linflexd_periodic" RAT_FUNC "%10.0" "microseconds" COEFFS 0.000000 80.000000 0.000000 0.000000 0.000000 1.000000 /end COMPU_METHOD
/* Scalar measurable for DDE 'mpl_tt_pv2g_client'. */
/begin MEASUREMENT mpl_tt_pv2g_client "Duration of library task: pv2g_client" ULONG CU_MPL_TT_PV2G_CLIENT 1 100 0.0 4294967295.0 ECU_ADDRESS 0x400249e4 BYTE_ORDER MSB_FIRST /end MEASUREMENT
/begin COMPU_METHOD CU_MPL_TT_PV2G_CLIENT "Conversion method for mpl_tt_pv2g_client" RAT_FUNC "%10.0" "microseconds" COEFFS 0.000000 80.000000 0.000000 0.000000 0.000000 1.000000 /end COMPU_METHOD
/* Scalar measurable for DDE 'mpl_tt_task_1000ms'. */
/begin MEASUREMENT mpl_tt_task_1000ms "Duration of application task: task_1000ms" ULONG CU_MPL_TT_TASK_1000MS 1 100 0.0 4294967295.0 ECU_ADDRESS 0x40024a1c BYTE_ORDER MSB_FIRST /end MEASUREMENT
/begin COMPU_METHOD CU_MPL_TT_TASK_1000MS "Conversion method for mpl_tt_task_1000ms" RAT_FUNC "%10.0" "microseconds" COEFFS 0.000000 80.000000 0.000000 0.000000 0.000000 1.000000 /end COMPU_METHOD
/* Scalar measurable for DDE 'mpl_tt_task_100ms'. */
/begin MEASUREMENT mpl_tt_task_100ms "Duration of application task: task_100ms" ULONG CU_MPL_TT_TASK_100MS 1 100 0.0 4294967295.0 ECU_ADDRESS 0x40024a14 BYTE_ORDER MSB_FIRST /end MEASUREMENT
/begin COMPU_METHOD CU_MPL_TT_TASK_100MS "Conversion method for mpl_tt_task_100ms" RAT_FUNC "%10.0" "microseconds" COEFFS 0.000000 80.000000 0.000000 0.000000 0.000000 1.000000 /end COMPU_METHOD
/* Scalar measurable for DDE 'mpl_tt_task_10ms'. */
/begin MEASUREMENT mpl_tt_task_10ms "Duration of application task: task_10ms" ULONG CU_MPL_TT_TASK_10MS 1 100 0.0 4294967295.0 ECU_ADDRESS 0x40024a0c BYTE_ORDER MSB_FIRST /end MEASUREMENT
/begin COMPU_METHOD CU_MPL_TT_TASK_10MS "Conversion method for mpl_tt_task_10ms" RAT_FUNC "%10.0" "microseconds" COEFFS 0.000000 80.000000 0.000000 0.000000 0.000000 1.000000 /end COMPU_METHOD
/* Scalar measurable for DDE 'mpl_tt_task_20ms'. */
/begin MEASUREMENT mpl_tt_task_20ms "Duration of application task: task_20ms" ULONG CU_MPL_TT_TASK_20MS 1 100 0.0 4294967295.0 ECU_ADDRESS 0x40024a10 BYTE_ORDER MSB_FIRST /end MEASUREMENT
/begin COMPU_METHOD CU_MPL_TT_TASK_20MS "Conversion method for mpl_tt_task_20ms" RAT_FUNC "%10.0" "microseconds" COEFFS 0.000000 80.000000 0.000000 0.000000 0.000000 1.000000 /end COMPU_METHOD
/* Scalar measurable for DDE 'mpl_tt_task_500ms'. */
/begin MEASUREMENT mpl_tt_task_500ms "Duration of application task: task_500ms" ULONG CU_MPL_TT_TASK_500MS 1 100 0.0 4294967295.0 ECU_ADDRESS 0x40024a18 BYTE_ORDER MSB_FIRST /end MEASUREMENT
/begin COMPU_METHOD CU_MPL_TT_TASK_500MS "Conversion method for mpl_tt_task_500ms" RAT_FUNC "%10.0" "microseconds" COEFFS 0.000000 80.000000 0.000000 0.000000 0.000000 1.000000 /end COMPU_METHOD
/* Scalar measurable for DDE 'mpl_unstable_reset_count'. */
/begin MEASUREMENT mpl_unstable_reset_count "Number of resets since power-up, or since the application was last stable." ULONG CU_MPL_UNSTABLE_RESET_COUNT 1 100 0.0 4294967295.0 ECU_ADDRESS 0x40022a98 BYTE_ORDER MSB_FIRST /end MEASUREMENT
/begin COMPU_METHOD CU_MPL_UNSTABLE_RESET_COUNT "Conversion method for mpl_unstable_reset_count" RAT_FUNC "%10.0" "events" COEFFS 0.000000 1.000000 0.000000 0.000000 0.000000 1.000000 /end COMPU_METHOD
/begin FUNCTION atv "Group /ByDataDictionaryPrefix/atv"
 /begin LOC_MEASUREMENT atv_12v atv_4wd_din atv_GenCurrentSetPoint atv_GenSelProcessed atv_HandBrakePos atv_HandBrakeStatus atv_ICE_Start_Timer atv_ICE_Start_Timer_Valid atv_IceFault atv_IceKey_out atv_IceOn atv_IceRG atv_IceSM atv_IceShutdown_out atv_PumpAFault atv_PumpBFault atv_RPM_Gen atv_RegMapSelProcessed atv_TRad_in atv_TRad_out atv_T_Air atv_T_ICE atv_app_code_day atv_app_code_major_ver atv_app_code_minor_ver atv_app_code_month atv_app_code_subminor_ver atv_app_code_year atv_apu_req_in atv_bmsMaxChgCurr atv_bmsMaxDisCurr atv_boot_code_day atv_boot_code_major_ver atv_boot_code_minor_ver atv_boot_code_month atv_boot_code_subminor_ver atv_boot_code_year atv_brake2epedal_split_actual atv_brake_pedalX1000 atv_brake_pedal_digital_in atv_can_wakeup atv_chg_present atv_cpu_loading atv_cpu_loading_max atv_dbg_pumpA_out atv_dbg_pumpB_out atv_en_dcdc_out atv_fmot_run_timer atv_footBrake_X1000_out atv_fs1_in atv_fs1_out atv_fuel_level atv_fuel_qty atv_fuel_reserve atv_ice_rpm_req atv_ice_run_timer atv_map atv_max_cell atv_min_cell atv_motoring_x1000_front atv_motoring_x1000_front_final atv_motoring_x1000_rear atv_motoring_x1000_rear_final atv_mtr_current_limit atv_odometer atv_platform_code_day atv_platform_code_major_ver atv_platform_code_minor_ver atv_platform_code_month atv_platform_code_subminor_ver atv_platform_code_year atv_pm_0 atv_pm_1 atv_pm_2 atv_pm_Electric atv_pm_Hybrid atv_pm_PreOp atv_pm_Stealth atv_pm_g atv_pm_s1 atv_pm_s2 atv_pm_s3 atv_prg_code_day atv_prg_code_major_ver atv_prg_code_minor_ver atv_prg_code_month atv_prg_code_subminor_ver atv_prg_code_year atv_reg_current_limit atv_regen_x1000_front atv_regen_x1000_rear atv_regmap atv_rmot_run_timer atv_runLed_out atv_stack_used atv_startBtnArmed atv_startConditions atv_state_out atv_sub_state_out atv_task_duration_1s atv_task_duration_1s_max atv_throttleGen_X1000_out atv_throttleX1000 atv_v_dbg_chg_req atv_v_dbg_heater_req atv_vehicle_SOC atv_wakelock_out atv_xa1_ain_throttle_raw atv_xa3_brake_pedal_raw_ain atv_xc1_raw_ain atv_xc4_raw_ain atv_xd1_key_ain atv_xd2 atv_xd3_raw_ain atv_xe2_raw_ain atv_xe3_ain atv_xe4_raw_ain atv_xf4 atv_yb3_raw_ain atv_ye2 atv_yg1 atv_yg2 atv_yg3_raw_ain atv_yh2 atv_yj2 atv_za2 atv_za3_StartBtn_din atv_zb2 atv_zb3 atv_zc2 atv_zc4 atv_zd1_ain atv_ze3 atv_ze4 /end LOC_MEASUREMENT
 /begin REF_CHARACTERISTIC atvc_ChargeOverride atvc_EndWarmUpTemp atvc_ErrTempInv atvc_ErrTempMot atvc_GenCurrent0 atvc_GenCurrent1 atvc_GenCurrent2 atvc_GenWarmUpCurrent atvc_GenWarmUpRPM atvc_HeatingMat_thr atvc_ICE_ReserveFuel atvc_ICE_Tank_Volume atvc_ICE_dragging_time atvc_IceMaxSOC atvc_IceMaxTemp atvc_IceOffTh atvc_IceOnTh atvc_IceStartRetry atvc_IceStartSOC atvc_IceStopSOC atvc_OverrideFan atvc_OverridePumpA atvc_OverridePumpB atvc_StartThrottleIce atvc_an_in_sel_his atvc_an_in_sel_th atvc_brake2epedal_split_0 atvc_brake2epedal_split_1 atvc_brake2epedal_split_2 atvc_brake2epedal_split_3 atvc_brakePedalHis atvc_brakePedalOn atvc_brake_pedal_gain atvc_brake_pedal_zero atvc_cell_ot atvc_cell_ov atvc_cell_ut atvc_cell_uv atvc_chg_complete atvc_chg_target_v atvc_dcMinFan atvc_fmot_run_timer atvc_fmot_run_timer_reset atvc_footBrakeIce atvc_footBrakeWarmUp atvc_force_inv_preop atvc_fs1_throttle_coherency atvc_gear_ratio atvc_gen_PWM_Override atvc_gen_TEST_PWM atvc_gen_ramp_up atvc_gen_start_PID_KI atvc_gen_start_PID_KP atvc_gen_start_rpm atvc_ice_run_timer atvc_ice_run_timer_reset atvc_maxDischCurr atvc_maxRegenCurr atvc_maxTempInv atvc_maxTempMotor atvc_max_footbrake_trq atvc_max_gen_neutral_trq atvc_max_gen_reg_trq atvc_max_gen_trq atvc_max_neutralbrake_trq atvc_max_soc atvc_max_trq_front atvc_max_trq_rear atvc_minTempInv atvc_minTempMotor atvc_min_soc atvc_odometer atvc_odometer_reset atvc_rmot_run_timer atvc_rmot_run_timer_reset atvc_tempSwitchOffFan atvc_tempSwitchOnFan atvc_throttleFull atvc_throttleNeutralPoint atvc_throttleZero atvc_velocityLimitFwd atvc_velocityLimitRwd atvc_wheel_radius atvca_fmot_run_timer atvca_ice_run_timer atvca_odometer atvca_rmot_run_timer atvm_currentfromrpm_x atvm_currentfromrpm_z atvm_rpmfromcurrent_x atvm_rpmfromcurrent_z atvv_map atvva_map /end REF_CHARACTERISTIC
/end FUNCTION
/begin FUNCTION bms "Group /ByDataDictionaryPrefix/bms" /begin LOC_MEASUREMENT bms_pack_soc bms_pack_voltage bms_rolling_counter /end LOC_MEASUREMENT /end FUNCTION
/begin FUNCTION ByDataDictionaryPrefix "Group /ByDataDictionaryPrefix" /begin SUB_FUNCTION atv bms /end SUB_FUNCTION /end FUNCTION
/begin FUNCTION Atomic_Subsystem1 "Group /ByModelHeirarchy/ATV/Atomic Subsystem1" /begin LOC_MEASUREMENT atv_pm_Electric atv_pm_Hybrid atv_pm_PreOp atv_pm_Stealth /end LOC_MEASUREMENT /end FUNCTION
/begin FUNCTION CANBUS_Output_Processing "Group /ByModelHeirarchy/ATV/CANBUS_Output_Processing"
 /begin REF_CHARACTERISTIC atvc_gen_ramp_up atvc_maxDischCurr atvc_maxRegenCurr atvc_max_footbrake_trq atvc_max_gen_neutral_trq atvc_max_gen_reg_trq atvc_max_gen_trq atvc_max_neutralbrake_trq atvc_max_trq_front atvc_max_trq_rear /end REF_CHARACTERISTIC
/end FUNCTION
/begin FUNCTION CANBUS_Reception_BMS "Group /ByModelHeirarchy/ATV/CANBUS_Reception_BMS" /begin LOC_MEASUREMENT bms_pack_soc bms_pack_voltage bms_rolling_counter /end LOC_MEASUREMENT /end FUNCTION
/begin FUNCTION CANBUS_Reception_BMS_CELL_V "Group /ByModelHeirarchy/ATV/CANBUS_Reception_BMS_CELL_V" /begin LOC_MEASUREMENT atv_max_cell atv_min_cell /end LOC_MEASUREMENT /end FUNCTION
/begin FUNCTION CANBUS_Reception_C_MONITOR "Group /ByModelHeirarchy/ATV/CANBUS_Reception_C_MONITOR" /begin LOC_MEASUREMENT atv_can_wakeup atv_chg_present /end LOC_MEASUREMENT /end FUNCTION
/begin FUNCTION If_Action_Subsystem1 "Group /ByModelHeirarchy/ATV/CANBUS_Reception_D_STATUS2_REAR1/Triggered Subsystem/Switch Case Action Subsystem/If Action Subsystem/If Action Subsystem" /begin REF_CHARACTERISTIC atvv_map atvva_map /end REF_CHARACTERISTIC /end FUNCTION
/begin FUNCTION If_Action_Subsystem "Group /ByModelHeirarchy/ATV/CANBUS_Reception_D_STATUS2_REAR1/Triggered Subsystem/Switch Case Action Subsystem/If Action Subsystem" /begin SUB_FUNCTION If_Action_Subsystem1 /end SUB_FUNCTION /end FUNCTION
/begin FUNCTION If_Action_Subsystem1 "Group /ByModelHeirarchy/ATV/CANBUS_Reception_D_STATUS2_REAR1/Triggered Subsystem/Switch Case Action Subsystem/If Action Subsystem1" /begin REF_CHARACTERISTIC atvv_map atvva_map /end REF_CHARACTERISTIC /end FUNCTION
/begin FUNCTION Switch_Case_Action_Subsystem "Group /ByModelHeirarchy/ATV/CANBUS_Reception_D_STATUS2_REAR1/Triggered Subsystem/Switch Case Action Subsystem" /begin SUB_FUNCTION If_Action_Subsystem If_Action_Subsystem1 /end SUB_FUNCTION /end FUNCTION
/begin FUNCTION Triggered_Subsystem "Group /ByModelHeirarchy/ATV/CANBUS_Reception_D_STATUS2_REAR1/Triggered Subsystem" /begin SUB_FUNCTION Switch_Case_Action_Subsystem /end SUB_FUNCTION /end FUNCTION
/begin FUNCTION CANBUS_Reception_D_STATUS2_REA0 "Group /ByModelHeirarchy/ATV/CANBUS_Reception_D_STATUS2_REAR1" /begin SUB_FUNCTION Triggered_Subsystem /end SUB_FUNCTION /end FUNCTION
/begin FUNCTION CANBUS_Reception_V_DBG_CTRL "Group /ByModelHeirarchy/ATV/CANBUS_Reception_V_DBG_CTRL" /begin LOC_MEASUREMENT atv_v_dbg_chg_req atv_v_dbg_heater_req /end LOC_MEASUREMENT /end FUNCTION
/begin FUNCTION CHARGER_CONTROL "Group /ByModelHeirarchy/ATV/CHARGER_CONTROL" /begin REF_CHARACTERISTIC atvc_chg_target_v /end REF_CHARACTERISTIC /end FUNCTION
/begin FUNCTION Inverter "Group /ByModelHeirarchy/ATV/CheckTempMotori/unnamed/Inverter"
 /begin REF_CHARACTERISTIC atvc_ErrTempInv atvc_ErrTempMot atvc_maxTempInv atvc_maxTempMotor /end REF_CHARACTERISTIC
/end FUNCTION
/begin FUNCTION unnamed "Group /ByModelHeirarchy/ATV/CheckTempMotori/unnamed" /begin SUB_FUNCTION Inverter /end SUB_FUNCTION /end FUNCTION
/begin FUNCTION CheckTempMotori "Group /ByModelHeirarchy/ATV/CheckTempMotori" /begin SUB_FUNCTION unnamed /end SUB_FUNCTION /end FUNCTION
/begin FUNCTION Digital_Output_Processing "Group /ByModelHeirarchy/ATV/Digital_Output_Processing" /begin LOC_MEASUREMENT atv_dbg_pumpA_out atv_dbg_pumpB_out atv_ye2 atv_yg1 /end LOC_MEASUREMENT /end FUNCTION
/begin FUNCTION ErrBattery "Group /ByModelHeirarchy/ATV/ErrBattery" /begin REF_CHARACTERISTIC atvc_cell_ot atvc_cell_ov atvc_cell_ut atvc_cell_uv /end REF_CHARACTERISTIC /end FUNCTION
/begin FUNCTION INPUT_ANALOGICI1 "Group /ByModelHeirarchy/ATV/Input_Processing/INPUT ANALOGICI1" /begin LOC_MEASUREMENT atv_T_Air /end LOC_MEASUREMENT /end FUNCTION
/begin FUNCTION Throttle_validation "Group /ByModelHeirarchy/ATV/Input_Processing/Throttle_validation" /begin REF_CHARACTERISTIC atvc_throttleFull atvc_throttleZero /end REF_CHARACTERISTIC /end FUNCTION
/begin FUNCTION Throttle_validation1 "Group /ByModelHeirarchy/ATV/Input_Processing/Throttle_validation1" /begin REF_CHARACTERISTIC atvc_brake_pedal_gain atvc_brake_pedal_zero /end REF_CHARACTERISTIC /end FUNCTION
/begin FUNCTION Input_Processing "Group /ByModelHeirarchy/ATV/Input_Processing" /begin SUB_FUNCTION INPUT_ANALOGICI1 Throttle_validation Throttle_validation1 /end SUB_FUNCTION
 /begin LOC_MEASUREMENT atv_12v atv_4wd_din atv_GenSelProcessed atv_HandBrakePos atv_HandBrakeStatus atv_RegMapSelProcessed atv_TRad_in atv_TRad_out atv_apu_req_in atv_brake_pedalX1000 atv_brake_pedal_digital_in atv_fs1_in atv_throttleX1000 atv_xa1_ain_throttle_raw atv_xa3_brake_pedal_raw_ain atv_xc1_raw_ain atv_xc4_raw_ain atv_xd1_key_ain atv_xd2 atv_xd3_raw_ain atv_xe2_raw_ain atv_xe3_ain atv_xe4_raw_ain atv_xf4 atv_yb3_raw_ain atv_yg2 atv_yg3_raw_ain atv_yh2 atv_yj2 atv_za2 atv_za3_StartBtn_din atv_zb2 atv_zb3 atv_zc2 atv_zc4 atv_zd1_ain atv_ze3 atv_ze4 /end LOC_MEASUREMENT
/end FUNCTION
/begin FUNCTION Subsystem1 "Group /ByModelHeirarchy/ATV/Subsystem1" /begin LOC_MEASUREMENT atv_mtr_current_limit atv_reg_current_limit /end LOC_MEASUREMENT /end FUNCTION
/begin FUNCTION Subsystem2 "Group /ByModelHeirarchy/ATV/Subsystem2" /begin LOC_MEASUREMENT atv_vehicle_SOC /end LOC_MEASUREMENT /begin REF_CHARACTERISTIC atvc_max_soc atvc_min_soc /end REF_CHARACTERISTIC /end FUNCTION
/begin FUNCTION Subsystem3 "Group /ByModelHeirarchy/ATV/Subsystem3" /begin LOC_MEASUREMENT atv_ICE_Start_Timer atv_ICE_Start_Timer_Valid /end LOC_MEASUREMENT /begin REF_CHARACTERISTIC atvc_IceStartSOC /end REF_CHARACTERISTIC /end FUNCTION
/begin FUNCTION CPU_Status "Group /ByModelHeirarchy/ATV/config_and_status/ECU_Status/CPU_Status"
 /begin LOC_MEASUREMENT atv_cpu_loading atv_cpu_loading_max atv_stack_used atv_task_duration_1s atv_task_duration_1s_max /end LOC_MEASUREMENT
/end FUNCTION
/begin FUNCTION ECU_SW_Ver_AppCode "Group /ByModelHeirarchy/ATV/config_and_status/ECU_Status/ECU_SW_Ver_AppCode"
 /begin LOC_MEASUREMENT atv_app_code_day atv_app_code_major_ver atv_app_code_minor_ver atv_app_code_month atv_app_code_subminor_ver atv_app_code_year /end LOC_MEASUREMENT
/end FUNCTION
/begin FUNCTION ECU_SW_Ver_Boot_Code "Group /ByModelHeirarchy/ATV/config_and_status/ECU_Status/ECU_SW_Ver_Boot_Code"
 /begin LOC_MEASUREMENT atv_boot_code_day atv_boot_code_major_ver atv_boot_code_minor_ver atv_boot_code_month atv_boot_code_subminor_ver atv_boot_code_year /end LOC_MEASUREMENT
/end FUNCTION
/begin FUNCTION ECU_SW_Ver_Platform_Lib_Code "Group /ByModelHeirarchy/ATV/config_and_status/ECU_Status/ECU_SW_Ver_Platform_Lib_Code"
 /begin LOC_MEASUREMENT atv_prg_code_day atv_prg_code_major_ver atv_prg_code_minor_ver atv_prg_code_month atv_prg_code_subminor_ver atv_prg_code_year /end LOC_MEASUREMENT
/end FUNCTION
/begin FUNCTION ECU_SW_Ver_Reprogramming_Code "Group /ByModelHeirarchy/ATV/config_and_status/ECU_Status/ECU_SW_Ver_Reprogramming_Code"
 /begin LOC_MEASUREMENT atv_platform_code_day atv_platform_code_major_ver atv_platform_code_minor_ver atv_platform_code_month atv_platform_code_subminor_ver atv_platform_code_year /end LOC_MEASUREMENT
/end FUNCTION
/begin FUNCTION ECU_Status "Group /ByModelHeirarchy/ATV/config_and_status/ECU_Status"
 /begin SUB_FUNCTION CPU_Status ECU_SW_Ver_AppCode ECU_SW_Ver_Boot_Code ECU_SW_Ver_Platform_Lib_Code ECU_SW_Ver_Reprogramming_Code /end SUB_FUNCTION
/end FUNCTION
/begin FUNCTION config_and_status "Group /ByModelHeirarchy/ATV/config_and_status" /begin SUB_FUNCTION ECU_Status /end SUB_FUNCTION /end FUNCTION
/begin FUNCTION FAN_MANAGEMENT "Group /ByModelHeirarchy/ATV/loop_10ms/ COOLING SYSTEM/GestioneImpiantoRaffreddamento/FAN MANAGEMENT" /begin REF_CHARACTERISTIC atvc_dcMinFan atvc_tempSwitchOffFan atvc_tempSwitchOnFan /end REF_CHARACTERISTIC /end FUNCTION
/begin FUNCTION GestioneImpiantoRaffreddamento "Group /ByModelHeirarchy/ATV/loop_10ms/ COOLING SYSTEM/GestioneImpiantoRaffreddamento" /begin SUB_FUNCTION FAN_MANAGEMENT /end SUB_FUNCTION
 /begin REF_CHARACTERISTIC atvc_OverrideFan atvc_OverridePumpA atvc_OverridePumpB atvc_dcMinFan atvc_tempSwitchOnFan /end REF_CHARACTERISTIC
/end FUNCTION
/begin FUNCTION _COOLING_SYSTEM "Group /ByModelHeirarchy/ATV/loop_10ms/ COOLING SYSTEM" /begin SUB_FUNCTION GestioneImpiantoRaffreddamento /end SUB_FUNCTION
 /begin REF_CHARACTERISTIC atvc_maxTempInv atvc_maxTempMotor atvc_minTempInv atvc_minTempMotor /end REF_CHARACTERISTIC
/end FUNCTION
/begin FUNCTION DRIVE_BY_WIRE "Group /ByModelHeirarchy/ATV/loop_10ms/DRIVE BY WIRE"
 /begin LOC_MEASUREMENT atv_brake2epedal_split_actual atv_map atv_motoring_x1000_front atv_motoring_x1000_front_final atv_motoring_x1000_rear atv_motoring_x1000_rear_final atv_regmap /end LOC_MEASUREMENT
 /begin REF_CHARACTERISTIC atvc_brake2epedal_split_0 atvc_brake2epedal_split_1 atvc_brake2epedal_split_2 atvc_brake2epedal_split_3 atvc_force_inv_preop atvc_fs1_throttle_coherency atvc_throttleNeutralPoint atvv_map atvva_map /end REF_CHARACTERISTIC
/end FUNCTION
/begin FUNCTION FMOT_TIMER "Group /ByModelHeirarchy/ATV/loop_10ms/FMOT_TIMER" /begin LOC_MEASUREMENT atv_fmot_run_timer /end LOC_MEASUREMENT
 /begin REF_CHARACTERISTIC atvc_fmot_run_timer atvc_fmot_run_timer_reset atvca_fmot_run_timer /end REF_CHARACTERISTIC
/end FUNCTION
/begin FUNCTION IceSM.speed_pid_ice "Group /ByModelHeirarchy/ATV/loop_10ms/HYBRID MANAGEMENT_Rev1_1/VSMGestioneIbrido/IceSM.speed_pid_ice"
 /begin REF_CHARACTERISTIC atvc_gen_start_PID_KI atvc_gen_start_PID_KP atvc_gen_start_rpm /end REF_CHARACTERISTIC
/end FUNCTION
/begin FUNCTION VSMGestioneIbrido "Group /ByModelHeirarchy/ATV/loop_10ms/HYBRID MANAGEMENT_Rev1_1/VSMGestioneIbrido" /begin SUB_FUNCTION IceSM.speed_pid_ice /end SUB_FUNCTION /end FUNCTION
/begin FUNCTION HYBRID_MANAGEMENT_Rev1_1 "Group /ByModelHeirarchy/ATV/loop_10ms/HYBRID MANAGEMENT_Rev1_1" /begin SUB_FUNCTION VSMGestioneIbrido /end SUB_FUNCTION /begin LOC_MEASUREMENT atv_T_ICE atv_fuel_qty /end LOC_MEASUREMENT
 /begin REF_CHARACTERISTIC atvc_EndWarmUpTemp atvc_GenWarmUpCurrent atvc_GenWarmUpRPM atvc_ICE_ReserveFuel atvc_ICE_Tank_Volume atvc_IceMaxTemp atvc_gen_PWM_Override atvc_gen_TEST_PWM atvm_currentfromrpm_x atvm_currentfromrpm_z atvm_rpmfromcurrent_x atvm_rpmfromcurrent_z /end REF_CHARACTERISTIC
/end FUNCTION
/begin FUNCTION ICE_TIMER "Group /ByModelHeirarchy/ATV/loop_10ms/ICE_TIMER" /begin LOC_MEASUREMENT atv_ice_run_timer /end LOC_MEASUREMENT
 /begin REF_CHARACTERISTIC atvc_ice_run_timer atvc_ice_run_timer_reset atvca_ice_run_timer /end REF_CHARACTERISTIC
/end FUNCTION
/begin FUNCTION ODOMETER "Group /ByModelHeirarchy/ATV/loop_10ms/ODOMETER"
 /begin REF_CHARACTERISTIC atvc_gear_ratio atvc_odometer atvc_odometer_reset atvc_wheel_radius atvca_odometer /end REF_CHARACTERISTIC
/end FUNCTION
/begin FUNCTION RMOT_TIMER "Group /ByModelHeirarchy/ATV/loop_10ms/RMOT_TIMER" /begin LOC_MEASUREMENT atv_rmot_run_timer /end LOC_MEASUREMENT
 /begin REF_CHARACTERISTIC atvc_rmot_run_timer atvc_rmot_run_timer_reset atvca_rmot_run_timer /end REF_CHARACTERISTIC
/end FUNCTION
/begin FUNCTION SPEED_LIMITER "Group /ByModelHeirarchy/ATV/loop_10ms/SPEED LIMITER" /begin REF_CHARACTERISTIC atvc_wheel_radius /end REF_CHARACTERISTIC /end FUNCTION
/begin FUNCTION VSM "Group /ByModelHeirarchy/ATV/loop_10ms/VSM" /begin LOC_MEASUREMENT atv_wakelock_out /end LOC_MEASUREMENT /begin REF_CHARACTERISTIC atvc_HeatingMat_thr /end REF_CHARACTERISTIC /end FUNCTION
/begin FUNCTION loop_10ms "Group /ByModelHeirarchy/ATV/loop_10ms"
 /begin SUB_FUNCTION _COOLING_SYSTEM DRIVE_BY_WIRE FMOT_TIMER HYBRID_MANAGEMENT_Rev1_1 ICE_TIMER ODOMETER RMOT_TIMER SPEED_LIMITER VSM /end SUB_FUNCTION
 /begin LOC_MEASUREMENT atv_GenCurrentSetPoint atv_IceFault atv_IceKey_out atv_IceOn atv_IceRG atv_IceSM atv_IceShutdown_out atv_PumpAFault atv_PumpBFault atv_RPM_Gen atv_en_dcdc_out atv_footBrake_X1000_out atv_fs1_in atv_fs1_out atv_fuel_reserve atv_ice_rpm_req atv_motoring_x1000_front_final atv_motoring_x1000_rear_final atv_odometer atv_regen_x1000_front atv_regen_x1000_rear atv_runLed_out atv_startBtnArmed atv_startConditions atv_state_out atv_sub_state_out atv_throttleGen_X1000_out atv_throttleX1000 atv_wakelock_out /end LOC_MEASUREMENT
 /begin REF_CHARACTERISTIC atvc_GenCurrent0 atvc_GenCurrent1 atvc_GenCurrent2 atvc_IceMaxSOC atvc_IceStartSOC atvc_IceStopSOC atvc_force_inv_preop atvc_velocityLimitFwd atvc_velocityLimitRwd /end REF_CHARACTERISTIC
/end FUNCTION
/begin FUNCTION ATV "Group /ByModelHeirarchy/ATV"
 /begin SUB_FUNCTION Atomic_Subsystem1 CANBUS_Output_Processing CANBUS_Reception_BMS CANBUS_Reception_BMS_CELL_V CANBUS_Reception_C_MONITOR CANBUS_Reception_D_STATUS2_REA0 CANBUS_Reception_V_DBG_CTRL CHARGER_CONTROL CheckTempMotori Digital_Output_Processing ErrBattery Input_Processing Subsystem1 Subsystem2 Subsystem3 config_and_status loop_10ms /end SUB_FUNCTION
 /begin LOC_MEASUREMENT atv_bmsMaxChgCurr atv_bmsMaxDisCurr atv_fuel_level atv_pm_0 atv_pm_1 atv_pm_2 atv_pm_g atv_pm_s1 atv_pm_s2 atv_pm_s3 /end LOC_MEASUREMENT
 /begin REF_CHARACTERISTIC atvc_ChargeOverride atvc_chg_complete /end REF_CHARACTERISTIC
/end FUNCTION
/begin FUNCTION ByModelHeirarchy "Group /ByModelHeirarchy" /begin SUB_FUNCTION ATV /end SUB_FUNCTION /end FUNCTION
/begin FUNCTION Adaptives "Group /ByType/Adaptives"
 /begin REF_CHARACTERISTIC atvc_fmot_run_timer atvc_ice_run_timer atvc_odometer atvc_rmot_run_timer atvca_fmot_run_timer atvca_ice_run_timer atvca_odometer atvca_rmot_run_timer atvv_map atvva_map /end REF_CHARACTERISTIC
/end FUNCTION
/begin FUNCTION Automatic "Group /ByType/Automatic"
 /begin LOC_MEASUREMENT mpl_app_build_day mpl_app_build_hour mpl_app_build_min mpl_app_build_month mpl_app_build_sec mpl_app_build_year mpl_app_ver_major mpl_app_ver_minor mpl_app_ver_sub mpl_boot_build_day mpl_boot_build_month mpl_boot_build_year mpl_boot_part_num_group mpl_boot_part_num_id mpl_boot_part_num_issue mpl_boot_part_num_letter mpl_boot_ver_major mpl_boot_ver_minor mpl_boot_ver_sub mpl_cpu_loaded mpl_cpu_loaded_1000ms mpl_cpu_loaded_50ms mpl_ecc_flash_address mpl_ecc_ram_address mpl_flp_div_by_zero mpl_flp_inexact mpl_flp_invalid mpl_flp_overflow mpl_flp_underflow mpl_max_cpu_loaded mpl_max_cpu_loaded_1000ms mpl_max_cpu_loaded_50ms mpl_max_used_stack mpl_mtt_pcp_client mpl_mtt_pcx_can_callback mpl_mtt_pcx_periodic mpl_mtt_pcx_qemptier mpl_mtt_pdg_client_task mpl_mtt_pdtc_client_task mpl_mtt_pff_client mpl_mtt_pfs_client mpl_mtt_pfsm_task mpl_mtt_piso_client_task mpl_mtt_pj1939_client mpl_mtt_pmios_client_task mpl_mtt_ppm_task mpl_mtt_pqca_client mpl_mtt_psc_watchdog mpl_mtt_psp_receive mpl_mtt_puart_linflexd_periodic mpl_mtt_pv2g_client mpl_mtt_task_1000ms mpl_mtt_task_100ms mpl_mtt_task_10ms mpl_mtt_task_20ms mpl_mtt_task_500ms mpl_ovrc_pcp_client mpl_ovrc_pcx_can_callback mpl_ovrc_pcx_periodic mpl_ovrc_pcx_qemptier mpl_ovrc_pdg_client_task mpl_ovrc_pdtc_client_task mpl_ovrc_pff_client mpl_ovrc_pfs_client mpl_ovrc_pfsm_task mpl_ovrc_piso_client_task mpl_ovrc_pj1939_client mpl_ovrc_pmios_client_task mpl_ovrc_ppm_task mpl_ovrc_pqca_client mpl_ovrc_psc_watchdog mpl_ovrc_psp_receive mpl_ovrc_puart_linflexd_period0 mpl_ovrc_pv2g_client mpl_ovrc_task_1000ms mpl_ovrc_task_100ms mpl_ovrc_task_10ms mpl_ovrc_task_20ms mpl_ovrc_task_500ms mpl_plat_build_day mpl_plat_build_month mpl_plat_build_year mpl_plat_part_num_group mpl_plat_part_num_id mpl_plat_part_num_issue mpl_plat_part_num_letter mpl_plat_ver_major mpl_plat_ver_minor mpl_plat_ver_sub mpl_prg_build_day mpl_prg_build_month mpl_prg_build_year mpl_prg_part_num_group mpl_prg_part_num_id mpl_prg_part_num_issue mpl_prg_part_num_letter mpl_prg_ver_major mpl_prg_ver_minor mpl_prg_ver_sub mpl_reset_count mpl_run_time mpl_skipc_pcp_client mpl_skipc_pcx_can_callback mpl_skipc_pcx_periodic mpl_skipc_pcx_qemptier mpl_skipc_pdg_client_task mpl_skipc_pdtc_client_task mpl_skipc_pff_client mpl_skipc_pfs_client mpl_skipc_pfsm_task mpl_skipc_piso_client_task mpl_skipc_pj1939_client mpl_skipc_pmios_client_task mpl_skipc_ppm_task mpl_skipc_pqca_client mpl_skipc_psc_watchdog mpl_skipc_psp_receive mpl_skipc_puart_linflexd_perio0 mpl_skipc_pv2g_client mpl_skipc_task_1000ms mpl_skipc_task_100ms mpl_skipc_task_10ms mpl_skipc_task_20ms mpl_skipc_task_500ms mpl_stack_limit_data_addr mpl_stack_limit_error mpl_stack_limit_inst_addr mpl_tt_pcp_client mpl_tt_pcx_can_callback mpl_tt_pcx_periodic mpl_tt_pcx_qemptier mpl_tt_pdg_client_task mpl_tt_pdtc_client_task mpl_tt_pff_client mpl_tt_pfs_client mpl_tt_pfsm_task mpl_tt_piso_client_task mpl_tt_pj1939_client mpl_tt_pmios_client_task mpl_tt_ppm_task mpl_tt_pqca_client mpl_tt_psc_watchdog mpl_tt_psp_receive mpl_tt_puart_linflexd_periodic mpl_tt_pv2g_client mpl_tt_task_1000ms mpl_tt_task_100ms mpl_tt_task_10ms mpl_tt_task_20ms mpl_tt_task_500ms mpl_unstable_reset_count /end LOC_MEASUREMENT
 /begin REF_CHARACTERISTIC isoc_emissions_report_min_sev isoc_override_service_03 isoc_override_service_07 isoc_override_service_0a isoc_uds_dtc_format_id mpls_app_build_time mpls_app_copyright mpls_app_description mpls_app_name mpls_app_version mpls_plat_build_time mpls_plat_copyright mpls_plat_target mpls_plat_version pj1939c_node_addr_0 /end REF_CHARACTERISTIC
/end FUNCTION
/end MODULE
/end PROJECT
