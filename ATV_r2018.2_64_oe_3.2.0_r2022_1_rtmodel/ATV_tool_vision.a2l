ASAP2_VERSION 1 31
/begin PROJECT New_model_v1.8.2_M560_000 "(none)"
/begin HEADER "(none)" VERSION "1_8_2" /end HEADER
/begin MODULE OpenECU_M560_000 ""
/* Scalar measurable for DDE 'atv_12v'. */
/begin MEASUREMENT atv_12v "12V level (V)" FLOAT32_IEEE CU_ATV_12V 1 100 0.0 0.0 ECU_ADDRESS 0x4002288c BYTE_ORDER MSB_FIRST /end MEASUREMENT
/begin COMPU_METHOD CU_ATV_12V "Conversion method for atv_12v" RAT_FUNC "%10.3" "V" COEFFS 0.000000 1.000000 0.000000 0.000000 0.000000 1.000000 /end COMPU_METHOD
/* Scalar measurable for DDE 'atv_4wd_din'. */
/begin MEASUREMENT atv_4wd_din "2WD/4WD Selector" UBYTE CU_ATV_4WD_DIN 1 100 0.0 1.0 ECU_ADDRESS 0x40022955 BYTE_ORDER MSB_FIRST /end MEASUREMENT
/begin COMPU_METHOD CU_ATV_4WD_DIN "Conversion method for atv_4wd_din" RAT_FUNC "%10.0" "one" COEFFS 0.000000 1.000000 0.000000 0.000000 0.000000 1.000000 /end COMPU_METHOD
/* Scalar measurable for DDE 'atv_GenCurrentSetPoint'. */
/begin MEASUREMENT atv_GenCurrentSetPoint "Generator Current Set Point" SWORD CU_ATV_GENCURRENTSETPOINT 1 100 0.0 0.0 ECU_ADDRESS 0x40022928 BYTE_ORDER MSB_FIRST /end MEASUREMENT
/begin COMPU_METHOD CU_ATV_GENCURRENTSETPOINT "Conversion method for atv_GenCurrentSetPoint" RAT_FUNC "%10.0" "A" COEFFS 0.000000 1.000000 0.000000 0.000000 0.000000 1.000000 /end COMPU_METHOD
/* Scalar measurable for DDE 'atv_GenSelProcessed'. */
/begin MEASUREMENT atv_GenSelProcessed "Generator Selector Position" UBYTE CU_ATV_GENSELPROCESSED 1 100 0.0 0.0 ECU_ADDRESS 0x4002292e BYTE_ORDER MSB_FIRST /end MEASUREMENT
/begin COMPU_METHOD CU_ATV_GENSELPROCESSED "Conversion method for atv_GenSelProcessed" RAT_FUNC "%10.0" "one" COEFFS 0.000000 1.000000 0.000000 0.000000 0.000000 1.000000 /end COMPU_METHOD
/* Scalar measurable for DDE 'atv_HandBrakePos'. */
/begin MEASUREMENT atv_HandBrakePos "Hand Brake Lock Position" FLOAT32_IEEE CU_ATV_HANDBRAKEPOS 1 100 0.0 0.0 ECU_ADDRESS 0x40022880 BYTE_ORDER MSB_FIRST /end MEASUREMENT
/begin COMPU_METHOD CU_ATV_HANDBRAKEPOS "Conversion method for atv_HandBrakePos" RAT_FUNC "%10.3" "V" COEFFS 0.000000 1.000000 0.000000 0.000000 0.000000 1.000000 /end COMPU_METHOD
/* Scalar measurable for DDE 'atv_HandBrakeStatus'. */
/begin MEASUREMENT atv_HandBrakeStatus "Hand Brake Status" UBYTE CU_ATV_HANDBRAKESTATUS 1 100 0.0 1.0 ECU_ADDRESS 0x40022954 BYTE_ORDER MSB_FIRST /end MEASUREMENT
/begin COMPU_METHOD CU_ATV_HANDBRAKESTATUS "Conversion method for atv_HandBrakeStatus" RAT_FUNC "%10.0" "one" COEFFS 0.000000 1.000000 0.000000 0.000000 0.000000 1.000000 /end COMPU_METHOD
/* Scalar measurable for DDE 'atv_ICE_Start_Timer'. */
/begin MEASUREMENT atv_ICE_Start_Timer "ICE restart Timer [s]" SLONG CU_ATV_ICE_START_TIMER 1 100 0.0 0.0 ECU_ADDRESS 0x400228c8 BYTE_ORDER MSB_FIRST /end MEASUREMENT
/begin COMPU_METHOD CU_ATV_ICE_START_TIMER "Conversion method for atv_ICE_Start_Timer" RAT_FUNC "%10.0" "sec" COEFFS 0.000000 1.000000 0.000000 0.000000 0.000000 1.000000 /end COMPU_METHOD
/* Scalar measurable for DDE 'atv_ICE_Start_Timer_Valid'. */
/begin MEASUREMENT atv_ICE_Start_Timer_Valid "ICE restart Timer Valid (Boolean)" UBYTE CU_ATV_ICE_START_TIMER_VALID 1 100 0.0 1.0 ECU_ADDRESS 0x40022958 BYTE_ORDER MSB_FIRST /end MEASUREMENT
/begin COMPU_METHOD CU_ATV_ICE_START_TIMER_VALID "Conversion method for atv_ICE_Start_Timer_Valid" RAT_FUNC "%10.0" "one" COEFFS 0.000000 1.000000 0.000000 0.000000 0.000000 1.000000 /end COMPU_METHOD
/* Scalar measurable for DDE 'atv_IceFault'. */
/begin MEASUREMENT atv_IceFault "Ice Fault  (Boolean)" UBYTE CU_ATV_ICEFAULT 1 100 0.0 1.0 ECU_ADDRESS 0x4002295f BYTE_ORDER MSB_FIRST /end MEASUREMENT
/begin COMPU_METHOD CU_ATV_ICEFAULT "Conversion method for atv_IceFault" RAT_FUNC "%10.0" "one" COEFFS 0.000000 1.000000 0.000000 0.000000 0.000000 1.000000 /end COMPU_METHOD
/* Scalar measurable for DDE 'atv_IceKey_out'. */
/begin MEASUREMENT atv_IceKey_out "Ice Ignition  (Boolean)" UBYTE CU_ATV_ICEKEY_OUT 1 100 0.0 1.0 ECU_ADDRESS 0x4002295c BYTE_ORDER MSB_FIRST /end MEASUREMENT
/begin COMPU_METHOD CU_ATV_ICEKEY_OUT "Conversion method for atv_IceKey_out" RAT_FUNC "%10.0" "one" COEFFS 0.000000 1.000000 0.000000 0.000000 0.000000 1.000000 /end COMPU_METHOD
/* Scalar measurable for DDE 'atv_IceOn'. */
/begin MEASUREMENT atv_IceOn "Ice Status  (Boolean)" UBYTE CU_ATV_ICEON 1 100 0.0 1.0 ECU_ADDRESS 0x4002295e BYTE_ORDER MSB_FIRST /end MEASUREMENT
/begin COMPU_METHOD CU_ATV_ICEON "Conversion method for atv_IceOn" RAT_FUNC "%10.0" "one" COEFFS 0.000000 1.000000 0.000000 0.000000 0.000000 1.000000 /end COMPU_METHOD
/* Scalar measurable for DDE 'atv_IceRG'. */
/begin MEASUREMENT atv_IceRG "Debug Reg Ice" UBYTE CU_ATV_ICERG 1 100 0.0 0.0 ECU_ADDRESS 0x4002293b BYTE_ORDER MSB_FIRST /end MEASUREMENT
/begin COMPU_METHOD CU_ATV_ICERG "Conversion method for atv_IceRG" RAT_FUNC "%10.0" "one" COEFFS 0.000000 1.000000 0.000000 0.000000 0.000000 1.000000 /end COMPU_METHOD
/* Scalar measurable for DDE 'atv_IceSM'. */
/begin MEASUREMENT atv_IceSM "Debug Start Ice" UBYTE CU_ATV_ICESM 1 100 0.0 0.0 ECU_ADDRESS 0x4002293a BYTE_ORDER MSB_FIRST /end MEASUREMENT
/begin COMPU_METHOD CU_ATV_ICESM "Conversion method for atv_IceSM" RAT_FUNC "%10.0" "one" COEFFS 0.000000 1.000000 0.000000 0.000000 0.000000 1.000000 /end COMPU_METHOD
/* Scalar measurable for DDE 'atv_IceShutdown_out'. */
/begin MEASUREMENT atv_IceShutdown_out "Ice Status  (Boolean)" UBYTE CU_ATV_ICESHUTDOWN_OUT 1 100 0.0 1.0 ECU_ADDRESS 0x4002295d BYTE_ORDER MSB_FIRST /end MEASUREMENT
/begin COMPU_METHOD CU_ATV_ICESHUTDOWN_OUT "Conversion method for atv_IceShutdown_out" RAT_FUNC "%10.0" "one" COEFFS 0.000000 1.000000 0.000000 0.000000 0.000000 1.000000 /end COMPU_METHOD
/* Scalar measurable for DDE 'atv_PumpAFault'. */
/begin MEASUREMENT atv_PumpAFault "Pump A Disabled" UBYTE CU_ATV_PUMPAFAULT 1 100 0.0 1.0 ECU_ADDRESS 0x40022961 BYTE_ORDER MSB_FIRST /end MEASUREMENT
/begin COMPU_METHOD CU_ATV_PUMPAFAULT "Conversion method for atv_PumpAFault" RAT_FUNC "%10.0" "one" COEFFS 0.000000 1.000000 0.000000 0.000000 0.000000 1.000000 /end COMPU_METHOD
/* Scalar measurable for DDE 'atv_PumpBFault'. */
/begin MEASUREMENT atv_PumpBFault "Pump B Disabled" UBYTE CU_ATV_PUMPBFAULT 1 100 0.0 1.0 ECU_ADDRESS 0x40022960 BYTE_ORDER MSB_FIRST /end MEASUREMENT
/begin COMPU_METHOD CU_ATV_PUMPBFAULT "Conversion method for atv_PumpBFault" RAT_FUNC "%10.0" "one" COEFFS 0.000000 1.000000 0.000000 0.000000 0.000000 1.000000 /end COMPU_METHOD
/* Scalar measurable for DDE 'atv_RPM_Gen'. */
/begin MEASUREMENT atv_RPM_Gen "Generator Speed [RPM]" SWORD CU_ATV_RPM_GEN 1 100 0.0 0.0 ECU_ADDRESS 0x4002291a BYTE_ORDER MSB_FIRST /end MEASUREMENT
/begin COMPU_METHOD CU_ATV_RPM_GEN "Conversion method for atv_RPM_Gen" RAT_FUNC "%10.0" "RPM" COEFFS 0.000000 1.000000 0.000000 0.000000 0.000000 1.000000 /end COMPU_METHOD
/* Scalar measurable for DDE 'atv_RegMapSelProcessed'. */
/begin MEASUREMENT atv_RegMapSelProcessed "Regen Map Selector Position" UBYTE CU_ATV_REGMAPSELPROCESSED 1 100 0.0 0.0 ECU_ADDRESS 0x40022932 BYTE_ORDER MSB_FIRST /end MEASUREMENT
/begin COMPU_METHOD CU_ATV_REGMAPSELPROCESSED "Conversion method for atv_RegMapSelProcessed" RAT_FUNC "%10.0" "one" COEFFS 0.000000 1.000000 0.000000 0.000000 0.000000 1.000000 /end COMPU_METHOD
/* Scalar measurable for DDE 'atv_TRad_in'. */
/begin MEASUREMENT atv_TRad_in "Radiator Temperature" SWORD CU_ATV_TRAD_IN 1 100 0.0 0.0 ECU_ADDRESS 0x40022922 BYTE_ORDER MSB_FIRST /end MEASUREMENT
/begin COMPU_METHOD CU_ATV_TRAD_IN "Conversion method for atv_TRad_in" RAT_FUNC "%10.0" "degree_Celsius" COEFFS 0.000000 1.000000 0.000000 0.000000 0.000000 1.000000 /end COMPU_METHOD
/* Scalar measurable for DDE 'atv_TRad_out'. */
/begin MEASUREMENT atv_TRad_out "Radiator Temperature" SWORD CU_ATV_TRAD_OUT 1 100 0.0 0.0 ECU_ADDRESS 0x4002291e BYTE_ORDER MSB_FIRST /end MEASUREMENT
/begin COMPU_METHOD CU_ATV_TRAD_OUT "Conversion method for atv_TRad_out" RAT_FUNC "%10.0" "degree_Celsius" COEFFS 0.000000 1.000000 0.000000 0.000000 0.000000 1.000000 /end COMPU_METHOD
/* Scalar measurable for DDE 'atv_T_Air'. */
/begin MEASUREMENT atv_T_Air "Air Temperature" SWORD CU_ATV_T_AIR 1 100 0.0 0.0 ECU_ADDRESS 0x40022918 BYTE_ORDER MSB_FIRST /end MEASUREMENT
/begin COMPU_METHOD CU_ATV_T_AIR "Conversion method for atv_T_Air" RAT_FUNC "%10.0" "degree_Celsius" COEFFS 0.000000 1.000000 0.000000 0.000000 0.000000 1.000000 /end COMPU_METHOD
/* Scalar measurable for DDE 'atv_T_ICE'. */
/begin MEASUREMENT atv_T_ICE "Generator Motor Temperature [°C]" SWORD CU_ATV_T_ICE 1 100 0.0 0.0 ECU_ADDRESS 0x4002291c BYTE_ORDER MSB_FIRST /end MEASUREMENT
/begin COMPU_METHOD CU_ATV_T_ICE "Conversion method for atv_T_ICE" RAT_FUNC "%10.0" "degree_Celsius" COEFFS 0.000000 1.000000 0.000000 0.000000 0.000000 1.000000 /end COMPU_METHOD
/* Scalar measurable for DDE 'atv_app_code_day'. */
/begin MEASUREMENT atv_app_code_day "Day the application code was built." UWORD CU_ATV_APP_CODE_DAY 1 100 0.0 0.0 ECU_ADDRESS 0x400228e8 BYTE_ORDER MSB_FIRST /end MEASUREMENT
/begin COMPU_METHOD CU_ATV_APP_CODE_DAY "Conversion method for atv_app_code_day" RAT_FUNC "%10.0" "one" COEFFS 0.000000 1.000000 0.000000 0.000000 0.000000 1.000000 /end COMPU_METHOD
/* Scalar measurable for DDE 'atv_app_code_major_ver'. */
/begin MEASUREMENT atv_app_code_major_ver "Major version of the application code." UWORD CU_ATV_APP_CODE_MAJOR_VER 1 100 0.0 0.0 ECU_ADDRESS 0x400228ea BYTE_ORDER MSB_FIRST /end MEASUREMENT
/begin COMPU_METHOD CU_ATV_APP_CODE_MAJOR_VER "Conversion method for atv_app_code_major_ver" RAT_FUNC "%10.0" "one" COEFFS 0.000000 1.000000 0.000000 0.000000 0.000000 1.000000 /end COMPU_METHOD
/* Scalar measurable for DDE 'atv_app_code_minor_ver'. */
/begin MEASUREMENT atv_app_code_minor_ver "Minor version of the application code." UWORD CU_ATV_APP_CODE_MINOR_VER 1 100 0.0 0.0 ECU_ADDRESS 0x400228ec BYTE_ORDER MSB_FIRST /end MEASUREMENT
/begin COMPU_METHOD CU_ATV_APP_CODE_MINOR_VER "Conversion method for atv_app_code_minor_ver" RAT_FUNC "%10.0" "one" COEFFS 0.000000 1.000000 0.000000 0.000000 0.000000 1.000000 /end COMPU_METHOD
/* Scalar measurable for DDE 'atv_app_code_month'. */
/begin MEASUREMENT atv_app_code_month "Month the application code was built." UWORD CU_ATV_APP_CODE_MONTH 1 100 0.0 0.0 ECU_ADDRESS 0x400228e6 BYTE_ORDER MSB_FIRST /end MEASUREMENT
/begin COMPU_METHOD CU_ATV_APP_CODE_MONTH "Conversion method for atv_app_code_month" RAT_FUNC "%10.0" "one" COEFFS 0.000000 1.000000 0.000000 0.000000 0.000000 1.000000 /end COMPU_METHOD
/* Scalar measurable for DDE 'atv_app_code_subminor_ver'. */
/begin MEASUREMENT atv_app_code_subminor_ver "Sub-minor version of the application code." UWORD CU_ATV_APP_CODE_SUBMINOR_VER 1 100 0.0 0.0 ECU_ADDRESS 0x400228ee BYTE_ORDER MSB_FIRST /end MEASUREMENT
/begin COMPU_METHOD CU_ATV_APP_CODE_SUBMINOR_VER "Conversion method for atv_app_code_subminor_ver" RAT_FUNC "%10.0" "one" COEFFS 0.000000 1.000000 0.000000 0.000000 0.000000 1.000000 /end COMPU_METHOD
/* Scalar measurable for DDE 'atv_app_code_year'. */
/begin MEASUREMENT atv_app_code_year "Year the application code was built." UWORD CU_ATV_APP_CODE_YEAR 1 100 0.0 0.0 ECU_ADDRESS 0x400228e4 BYTE_ORDER MSB_FIRST /end MEASUREMENT
/begin COMPU_METHOD CU_ATV_APP_CODE_YEAR "Conversion method for atv_app_code_year" RAT_FUNC "%10.0" "one" COEFFS 0.000000 1.000000 0.000000 0.000000 0.000000 1.000000 /end COMPU_METHOD
/* Scalar measurable for DDE 'atv_apu_req_in'. */
/begin MEASUREMENT atv_apu_req_in "APU Button (Boolean)" UBYTE CU_ATV_APU_REQ_IN 1 100 0.0 1.0 ECU_ADDRESS 0x40022945 BYTE_ORDER MSB_FIRST /end MEASUREMENT
/begin COMPU_METHOD CU_ATV_APU_REQ_IN "Conversion method for atv_apu_req_in" RAT_FUNC "%10.0" "one" COEFFS 0.000000 1.000000 0.000000 0.000000 0.000000 1.000000 /end COMPU_METHOD
/* Scalar measurable for DDE 'atv_bmsMaxChgCurr'. */
/begin MEASUREMENT atv_bmsMaxChgCurr "BMS Max allowed charge current" SWORD CU_ATV_BMSMAXCHGCURR 1 100 0.0 0.0 ECU_ADDRESS 0x40022926 BYTE_ORDER MSB_FIRST /end MEASUREMENT
/begin COMPU_METHOD CU_ATV_BMSMAXCHGCURR "Conversion method for atv_bmsMaxChgCurr" RAT_FUNC "%10.0" "A" COEFFS 0.000000 1.000000 0.000000 0.000000 0.000000 1.000000 /end COMPU_METHOD
/* Scalar measurable for DDE 'atv_bmsMaxDisCurr'. */
/begin MEASUREMENT atv_bmsMaxDisCurr "BMS Max allowed discharge current" SWORD CU_ATV_BMSMAXDISCURR 1 100 0.0 0.0 ECU_ADDRESS 0x4002292c BYTE_ORDER MSB_FIRST /end MEASUREMENT
/begin COMPU_METHOD CU_ATV_BMSMAXDISCURR "Conversion method for atv_bmsMaxDisCurr" RAT_FUNC "%10.0" "A" COEFFS 0.000000 1.000000 0.000000 0.000000 0.000000 1.000000 /end COMPU_METHOD
/* Scalar measurable for DDE 'atv_boot_code_day'. */
/begin MEASUREMENT atv_boot_code_day "Day the boot code was built." UWORD CU_ATV_BOOT_CODE_DAY 1 100 0.0 0.0 ECU_ADDRESS 0x400228f4 BYTE_ORDER MSB_FIRST /end MEASUREMENT
/begin COMPU_METHOD CU_ATV_BOOT_CODE_DAY "Conversion method for atv_boot_code_day" RAT_FUNC "%10.0" "one" COEFFS 0.000000 1.000000 0.000000 0.000000 0.000000 1.000000 /end COMPU_METHOD
/* Scalar measurable for DDE 'atv_boot_code_major_ver'. */
/begin MEASUREMENT atv_boot_code_major_ver "Major version of the boot code." UWORD CU_ATV_BOOT_CODE_MAJOR_VER 1 100 0.0 0.0 ECU_ADDRESS 0x400228f6 BYTE_ORDER MSB_FIRST /end MEASUREMENT
/begin COMPU_METHOD CU_ATV_BOOT_CODE_MAJOR_VER "Conversion method for atv_boot_code_major_ver" RAT_FUNC "%10.0" "one" COEFFS 0.000000 1.000000 0.000000 0.000000 0.000000 1.000000 /end COMPU_METHOD
/* Scalar measurable for DDE 'atv_boot_code_minor_ver'. */
/begin MEASUREMENT atv_boot_code_minor_ver "Minor version of the boot code." UWORD CU_ATV_BOOT_CODE_MINOR_VER 1 100 0.0 0.0 ECU_ADDRESS 0x400228f8 BYTE_ORDER MSB_FIRST /end MEASUREMENT
/begin COMPU_METHOD CU_ATV_BOOT_CODE_MINOR_VER "Conversion method for atv_boot_code_minor_ver" RAT_FUNC "%10.0" "one" COEFFS 0.000000 1.000000 0.000000 0.000000 0.000000 1.000000 /end COMPU_METHOD
/* Scalar measurable for DDE 'atv_boot_code_month'. */
/begin MEASUREMENT atv_boot_code_month "Month the boot code was built." UWORD CU_ATV_BOOT_CODE_MONTH 1 100 0.0 0.0 ECU_ADDRESS 0x400228f2 BYTE_ORDER MSB_FIRST /end MEASUREMENT
/begin COMPU_METHOD CU_ATV_BOOT_CODE_MONTH "Conversion method for atv_boot_code_month" RAT_FUNC "%10.0" "one" COEFFS 0.000000 1.000000 0.000000 0.000000 0.000000 1.000000 /end COMPU_METHOD
/* Scalar measurable for DDE 'atv_boot_code_subminor_ver'. */
/begin MEASUREMENT atv_boot_code_subminor_ver "Sub-minor version of the boot code." UWORD CU_ATV_BOOT_CODE_SUBMINOR_VER 1 100 0.0 0.0 ECU_ADDRESS 0x400228fa BYTE_ORDER MSB_FIRST /end MEASUREMENT
/begin COMPU_METHOD CU_ATV_BOOT_CODE_SUBMINOR_VER "Conversion method for atv_boot_code_subminor_ver" RAT_FUNC "%10.0" "one" COEFFS 0.000000 1.000000 0.000000 0.000000 0.000000 1.000000 /end COMPU_METHOD
/* Scalar measurable for DDE 'atv_boot_code_year'. */
/begin MEASUREMENT atv_boot_code_year "Year the boot code was built." UWORD CU_ATV_BOOT_CODE_YEAR 1 100 0.0 0.0 ECU_ADDRESS 0x400228f0 BYTE_ORDER MSB_FIRST /end MEASUREMENT
/begin COMPU_METHOD CU_ATV_BOOT_CODE_YEAR "Conversion method for atv_boot_code_year" RAT_FUNC "%10.0" "one" COEFFS 0.000000 1.000000 0.000000 0.000000 0.000000 1.000000 /end COMPU_METHOD
/* Scalar measurable for DDE 'atv_brake2epedal_split_actual'. */
/begin MEASUREMENT atv_brake2epedal_split_actual "Actual epedal split (map based)" SWORD CU_ATV_BRAKE2EPEDAL_SPLIT_ACTU0 1 100 0.0 0.0 ECU_ADDRESS 0x40022924 BYTE_ORDER MSB_FIRST /end MEASUREMENT
/begin COMPU_METHOD CU_ATV_BRAKE2EPEDAL_SPLIT_ACTU0 "Conversion method for atv_brake2epedal_split_actual" RAT_FUNC "%10.0" "one" COEFFS 0.000000 1.000000 0.000000 0.000000 0.000000 1.000000 /end COMPU_METHOD
/* Scalar measurable for DDE 'atv_brake_pedalX1000'. */
/begin MEASUREMENT atv_brake_pedalX1000 "Brake Input 0-1000" UWORD CU_ATV_BRAKE_PEDALX1000 1 100 0.0 0.0 ECU_ADDRESS 0x400228cc BYTE_ORDER MSB_FIRST /end MEASUREMENT
/begin COMPU_METHOD CU_ATV_BRAKE_PEDALX1000 "Conversion method for atv_brake_pedalX1000" RAT_FUNC "%10.0" "V" COEFFS 0.000000 1.000000 0.000000 0.000000 0.000000 1.000000 /end COMPU_METHOD
/* Scalar measurable for DDE 'atv_brake_pedal_digital_in'. */
/begin MEASUREMENT atv_brake_pedal_digital_in "Brake Pedal In Digital" UBYTE CU_ATV_BRAKE_PEDAL_DIGITAL_IN 1 100 0.0 1.0 ECU_ADDRESS 0x40022943 BYTE_ORDER MSB_FIRST /end MEASUREMENT
/begin COMPU_METHOD CU_ATV_BRAKE_PEDAL_DIGITAL_IN "Conversion method for atv_brake_pedal_digital_in" RAT_FUNC "%10.0" "one" COEFFS 0.000000 1.000000 0.000000 0.000000 0.000000 1.000000 /end COMPU_METHOD
/* Scalar measurable for DDE 'atv_can_wakeup'. */
/begin MEASUREMENT atv_can_wakeup "Wake On Can" UBYTE CU_ATV_CAN_WAKEUP 1 100 0.0 1.0 ECU_ADDRESS 0x40022950 BYTE_ORDER MSB_FIRST /end MEASUREMENT
/begin COMPU_METHOD CU_ATV_CAN_WAKEUP "Conversion method for atv_can_wakeup" RAT_FUNC "%10.0" "one" COEFFS 0.000000 1.000000 0.000000 0.000000 0.000000 1.000000 /end COMPU_METHOD
/* Scalar measurable for DDE 'atv_chg_present'. */
/begin MEASUREMENT atv_chg_present "Battery Charger Detected" UBYTE CU_ATV_CHG_PRESENT 1 100 0.0 1.0 ECU_ADDRESS 0x4002294f BYTE_ORDER MSB_FIRST /end MEASUREMENT
/begin COMPU_METHOD CU_ATV_CHG_PRESENT "Conversion method for atv_chg_present" RAT_FUNC "%10.0" "one" COEFFS 0.000000 1.000000 0.000000 0.000000 0.000000 1.000000 /end COMPU_METHOD
/* Scalar measurable for DDE 'atv_cpu_loading'. */
/begin MEASUREMENT atv_cpu_loading "CPU loading seen in last 50ms" UBYTE CU_ATV_CPU_LOADING 1 100 0.0 0.0 ECU_ADDRESS 0x40022935 BYTE_ORDER MSB_FIRST /end MEASUREMENT
/begin COMPU_METHOD CU_ATV_CPU_LOADING "Conversion method for atv_cpu_loading" RAT_FUNC "%10.0" "%" COEFFS 0.000000 1.000000 0.000000 0.000000 0.000000 1.000000 /end COMPU_METHOD
/* Scalar measurable for DDE 'atv_cpu_loading_max'. */
/begin MEASUREMENT atv_cpu_loading_max "Maximum CPU loading seen in any 50ms period" UBYTE CU_ATV_CPU_LOADING_MAX 1 100 0.0 0.0 ECU_ADDRESS 0x40022936 BYTE_ORDER MSB_FIRST /end MEASUREMENT
/begin COMPU_METHOD CU_ATV_CPU_LOADING_MAX "Conversion method for atv_cpu_loading_max" RAT_FUNC "%10.0" "%" COEFFS 0.000000 1.000000 0.000000 0.000000 0.000000 1.000000 /end COMPU_METHOD
/* Scalar measurable for DDE 'atv_dbg_pumpA_out'. */
/begin MEASUREMENT atv_dbg_pumpA_out "Pump A (Debug Signal)" UBYTE CU_ATV_DBG_PUMPA_OUT 1 100 0.0 1.0 ECU_ADDRESS 0x40022947 BYTE_ORDER MSB_FIRST /end MEASUREMENT
/begin COMPU_METHOD CU_ATV_DBG_PUMPA_OUT "Conversion method for atv_dbg_pumpA_out" RAT_FUNC "%10.0" "one" COEFFS 0.000000 1.000000 0.000000 0.000000 0.000000 1.000000 /end COMPU_METHOD
/* Scalar measurable for DDE 'atv_dbg_pumpB_out'. */
/begin MEASUREMENT atv_dbg_pumpB_out "Pump A (Debug Signal)" UBYTE CU_ATV_DBG_PUMPB_OUT 1 100 0.0 1.0 ECU_ADDRESS 0x40022962 BYTE_ORDER MSB_FIRST /end MEASUREMENT
/begin COMPU_METHOD CU_ATV_DBG_PUMPB_OUT "Conversion method for atv_dbg_pumpB_out" RAT_FUNC "%10.0" "one" COEFFS 0.000000 1.000000 0.000000 0.000000 0.000000 1.000000 /end COMPU_METHOD
/* Scalar measurable for DDE 'atv_en_dcdc_out'. */
/begin MEASUREMENT atv_en_dcdc_out "RUN LED Status" UBYTE CU_ATV_EN_DCDC_OUT 1 100 0.0 1.0 ECU_ADDRESS 0x4002295a BYTE_ORDER MSB_FIRST /end MEASUREMENT
/begin COMPU_METHOD CU_ATV_EN_DCDC_OUT "Conversion method for atv_en_dcdc_out" RAT_FUNC "%10.0" "one" COEFFS 0.000000 1.000000 0.000000 0.000000 0.000000 1.000000 /end COMPU_METHOD
/* Scalar measurable for DDE 'atv_fmot_run_timer'. */
/begin MEASUREMENT atv_fmot_run_timer "ICE Run Timer [sec]" ULONG CU_ATV_FMOT_RUN_TIMER 1 100 0.0 2000000000.0 ECU_ADDRESS 0x40022894 BYTE_ORDER MSB_FIRST /end MEASUREMENT
/begin COMPU_METHOD CU_ATV_FMOT_RUN_TIMER "Conversion method for atv_fmot_run_timer" RAT_FUNC "%10.0" "m" COEFFS 0.000000 1.000000 0.000000 0.000000 0.000000 1.000000 /end COMPU_METHOD
/* Scalar measurable for DDE 'atv_footBrake_X1000_out'. */
/begin MEASUREMENT atv_footBrake_X1000_out "footbrake Gen Out [0.1%]" UWORD CU_ATV_FOOTBRAKE_X1000_OUT 1 100 0.0 0.0 ECU_ADDRESS 0x400228e2 BYTE_ORDER MSB_FIRST /end MEASUREMENT
/begin COMPU_METHOD CU_ATV_FOOTBRAKE_X1000_OUT "Conversion method for atv_footBrake_X1000_out" RAT_FUNC "%10.0" "one" COEFFS 0.000000 1.000000 0.000000 0.000000 0.000000 1.000000 /end COMPU_METHOD
/* Scalar measurable for DDE 'atv_fs1_in'. */
/begin MEASUREMENT atv_fs1_in "Foot Pedal FS1 Switch Status input" UBYTE CU_ATV_FS1_IN 1 100 0.0 1.0 ECU_ADDRESS 0x40022953 BYTE_ORDER MSB_FIRST /end MEASUREMENT
/begin COMPU_METHOD CU_ATV_FS1_IN "Conversion method for atv_fs1_in" RAT_FUNC "%10.0" "one" COEFFS 0.000000 1.000000 0.000000 0.000000 0.000000 1.000000 /end COMPU_METHOD
/* Scalar measurable for DDE 'atv_fs1_out'. */
/begin MEASUREMENT atv_fs1_out "Foot Pedal FS1 Switch Status output" UBYTE CU_ATV_FS1_OUT 1 100 0.0 1.0 ECU_ADDRESS 0x40022956 BYTE_ORDER MSB_FIRST /end MEASUREMENT
/begin COMPU_METHOD CU_ATV_FS1_OUT "Conversion method for atv_fs1_out" RAT_FUNC "%10.0" "one" COEFFS 0.000000 1.000000 0.000000 0.000000 0.000000 1.000000 /end COMPU_METHOD
/* Scalar measurable for DDE 'atv_fuel_level'. */
/begin MEASUREMENT atv_fuel_level "Fuel Level [%]" UBYTE CU_ATV_FUEL_LEVEL 1 100 0.0 0.0 ECU_ADDRESS 0x40022931 BYTE_ORDER MSB_FIRST /end MEASUREMENT
/begin COMPU_METHOD CU_ATV_FUEL_LEVEL "Conversion method for atv_fuel_level" RAT_FUNC "%10.0" "one" COEFFS 0.000000 1.000000 0.000000 0.000000 0.000000 1.000000 /end COMPU_METHOD
/* Scalar measurable for DDE 'atv_fuel_qty'. */
/begin MEASUREMENT atv_fuel_qty "Fuel Quantity [liters]" FLOAT32_IEEE CU_ATV_FUEL_QTY 1 100 0.0 0.0 ECU_ADDRESS 0x400228c0 BYTE_ORDER MSB_FIRST /end MEASUREMENT
/begin COMPU_METHOD CU_ATV_FUEL_QTY "Conversion method for atv_fuel_qty" RAT_FUNC "%10.3" "l" COEFFS 0.000000 1.000000 0.000000 0.000000 0.000000 1.000000 /end COMPU_METHOD
/* Scalar measurable for DDE 'atv_fuel_reserve'. */
/begin MEASUREMENT atv_fuel_reserve "Fuel Reserve  (Boolean)" UBYTE CU_ATV_FUEL_RESERVE 1 100 0.0 1.0 ECU_ADDRESS 0x40022957 BYTE_ORDER MSB_FIRST /end MEASUREMENT
/begin COMPU_METHOD CU_ATV_FUEL_RESERVE "Conversion method for atv_fuel_reserve" RAT_FUNC "%10.0" "one" COEFFS 0.000000 1.000000 0.000000 0.000000 0.000000 1.000000 /end COMPU_METHOD
/* Scalar measurable for DDE 'atv_ice_rpm_req'. */
/begin MEASUREMENT atv_ice_rpm_req "ICE PWM RPM request [%]" SWORD CU_ATV_ICE_RPM_REQ 1 100 0.0 0.0 ECU_ADDRESS 0x4002292a BYTE_ORDER MSB_FIRST /end MEASUREMENT
/begin COMPU_METHOD CU_ATV_ICE_RPM_REQ "Conversion method for atv_ice_rpm_req" RAT_FUNC "%10.0" "rpm" COEFFS 0.000000 1.000000 0.000000 0.000000 0.000000 1.000000 /end COMPU_METHOD
/* Scalar measurable for DDE 'atv_ice_run_timer'. */
/begin MEASUREMENT atv_ice_run_timer "ICE Run Timer [sec]" ULONG CU_ATV_ICE_RUN_TIMER 1 100 0.0 2000000000.0 ECU_ADDRESS 0x40022898 BYTE_ORDER MSB_FIRST /end MEASUREMENT
/begin COMPU_METHOD CU_ATV_ICE_RUN_TIMER "Conversion method for atv_ice_run_timer" RAT_FUNC "%10.0" "m" COEFFS 0.000000 1.000000 0.000000 0.000000 0.000000 1.000000 /end COMPU_METHOD
/* Scalar measurable for DDE 'atv_map'. */
/begin MEASUREMENT atv_map "Actual map" UBYTE CU_ATV_MAP 1 100 0.0 0.0 ECU_ADDRESS 0x40022934 BYTE_ORDER MSB_FIRST /end MEASUREMENT
/begin COMPU_METHOD CU_ATV_MAP "Conversion method for atv_map" RAT_FUNC "%10.0" "one" COEFFS 0.000000 1.000000 0.000000 0.000000 0.000000 1.000000 /end COMPU_METHOD
/* Scalar measurable for DDE 'atv_max_cell'. */
/begin MEASUREMENT atv_max_cell "Max Cell" UWORD CU_ATV_MAX_CELL 1 100 0.0 0.0 ECU_ADDRESS 0x400228ce BYTE_ORDER MSB_FIRST /end MEASUREMENT
/begin COMPU_METHOD CU_ATV_MAX_CELL "Conversion method for atv_max_cell" RAT_FUNC "%10.0" "one" COEFFS 0.000000 1.000000 0.000000 0.000000 0.000000 1.000000 /end COMPU_METHOD
/* Scalar measurable for DDE 'atv_min_cell'. */
/begin MEASUREMENT atv_min_cell "Max Cell" UWORD CU_ATV_MIN_CELL 1 100 0.0 0.0 ECU_ADDRESS 0x400228d0 BYTE_ORDER MSB_FIRST /end MEASUREMENT
/begin COMPU_METHOD CU_ATV_MIN_CELL "Conversion method for atv_min_cell" RAT_FUNC "%10.0" "one" COEFFS 0.000000 1.000000 0.000000 0.000000 0.000000 1.000000 /end COMPU_METHOD
/* Scalar measurable for DDE 'atv_motoring_x1000_front'. */
/begin MEASUREMENT atv_motoring_x1000_front "Throttle output front positive torque 0-1000" UWORD CU_ATV_MOTORING_X1000_FRONT 1 100 0.0 0.0 ECU_ADDRESS 0x400228d6 BYTE_ORDER MSB_FIRST /end MEASUREMENT
/begin COMPU_METHOD CU_ATV_MOTORING_X1000_FRONT "Conversion method for atv_motoring_x1000_front" RAT_FUNC "%10.0" "V" COEFFS 0.000000 1.000000 0.000000 0.000000 0.000000 1.000000 /end COMPU_METHOD
/* Scalar measurable for DDE 'atv_motoring_x1000_front_final'. */
/begin MEASUREMENT atv_motoring_x1000_front_final "Throttle output front positive torque limited 0-1000" UWORD CU_ATV_MOTORING_X1000_FRONT_FI0 1 100 0.0 0.0 ECU_ADDRESS 0x400228d8 BYTE_ORDER MSB_FIRST /end MEASUREMENT
/begin COMPU_METHOD CU_ATV_MOTORING_X1000_FRONT_FI0 "Conversion method for atv_motoring_x1000_front_final" RAT_FUNC "%10.0" "V" COEFFS 0.000000 1.000000 0.000000 0.000000 0.000000 1.000000 /end COMPU_METHOD
/* Scalar measurable for DDE 'atv_motoring_x1000_rear'. */
/begin MEASUREMENT atv_motoring_x1000_rear "Throttle output rear positive torque 0-1000" UWORD CU_ATV_MOTORING_X1000_REAR 1 100 0.0 0.0 ECU_ADDRESS 0x400228d4 BYTE_ORDER MSB_FIRST /end MEASUREMENT
/begin COMPU_METHOD CU_ATV_MOTORING_X1000_REAR "Conversion method for atv_motoring_x1000_rear" RAT_FUNC "%10.0" "V" COEFFS 0.000000 1.000000 0.000000 0.000000 0.000000 1.000000 /end COMPU_METHOD
/* Scalar measurable for DDE 'atv_motoring_x1000_rear_final'. */
/begin MEASUREMENT atv_motoring_x1000_rear_final "Throttle output rear positive torque limited 0-1000" UWORD CU_ATV_MOTORING_X1000_REAR_FIN0 1 100 0.0 0.0 ECU_ADDRESS 0x400228da BYTE_ORDER MSB_FIRST /end MEASUREMENT
/begin COMPU_METHOD CU_ATV_MOTORING_X1000_REAR_FIN0 "Conversion method for atv_motoring_x1000_rear_final" RAT_FUNC "%10.0" "V" COEFFS 0.000000 1.000000 0.000000 0.000000 0.000000 1.000000 /end COMPU_METHOD
/* Scalar measurable for DDE 'atv_mtr_current_limit'. */
/begin MEASUREMENT atv_mtr_current_limit "Motoring Current Limit" UWORD CU_ATV_MTR_CURRENT_LIMIT 1 100 0.0 0.0 ECU_ADDRESS 0x40022916 BYTE_ORDER MSB_FIRST /end MEASUREMENT
/begin COMPU_METHOD CU_ATV_MTR_CURRENT_LIMIT "Conversion method for atv_mtr_current_limit" RAT_FUNC "%10.0" "A" COEFFS 0.000000 1.000000 0.000000 0.000000 0.000000 1.000000 /end COMPU_METHOD
/* Scalar measurable for DDE 'atv_odometer'. */
/begin MEASUREMENT atv_odometer "Odometer [m*100]" ULONG CU_ATV_ODOMETER 1 100 0.0 0.0 ECU_ADDRESS 0x4002289c BYTE_ORDER MSB_FIRST /end MEASUREMENT
/begin COMPU_METHOD CU_ATV_ODOMETER "Conversion method for atv_odometer" RAT_FUNC "%10.0" "m" COEFFS 0.000000 1.000000 0.000000 0.000000 0.000000 1.000000 /end COMPU_METHOD
/* Scalar measurable for DDE 'atv_platform_code_day'. */
/begin MEASUREMENT atv_platform_code_day "Day the platform library code was built." UWORD CU_ATV_PLATFORM_CODE_DAY 1 100 0.0 0.0 ECU_ADDRESS 0x4002290c BYTE_ORDER MSB_FIRST /end MEASUREMENT
/begin COMPU_METHOD CU_ATV_PLATFORM_CODE_DAY "Conversion method for atv_platform_code_day" RAT_FUNC "%10.0" "one" COEFFS 0.000000 1.000000 0.000000 0.000000 0.000000 1.000000 /end COMPU_METHOD
/* Scalar measurable for DDE 'atv_platform_code_major_ver'. */
/begin MEASUREMENT atv_platform_code_major_ver "Major version of the platform library code." UWORD CU_ATV_PLATFORM_CODE_MAJOR_VER 1 100 0.0 0.0 ECU_ADDRESS 0x4002290e BYTE_ORDER MSB_FIRST /end MEASUREMENT
/begin COMPU_METHOD CU_ATV_PLATFORM_CODE_MAJOR_VER "Conversion method for atv_platform_code_major_ver" RAT_FUNC "%10.0" "one" COEFFS 0.000000 1.000000 0.000000 0.000000 0.000000 1.000000 /end COMPU_METHOD
/* Scalar measurable for DDE 'atv_platform_code_minor_ver'. */
/begin MEASUREMENT atv_platform_code_minor_ver "Minor version of the platform library code." UWORD CU_ATV_PLATFORM_CODE_MINOR_VER 1 100 0.0 0.0 ECU_ADDRESS 0x40022910 BYTE_ORDER MSB_FIRST /end MEASUREMENT
/begin COMPU_METHOD CU_ATV_PLATFORM_CODE_MINOR_VER "Conversion method for atv_platform_code_minor_ver" RAT_FUNC "%10.0" "one" COEFFS 0.000000 1.000000 0.000000 0.000000 0.000000 1.000000 /end COMPU_METHOD
/* Scalar measurable for DDE 'atv_platform_code_month'. */
/begin MEASUREMENT atv_platform_code_month "Month the platform library code was built." UWORD CU_ATV_PLATFORM_CODE_MONTH 1 100 0.0 0.0 ECU_ADDRESS 0x4002290a BYTE_ORDER MSB_FIRST /end MEASUREMENT
/begin COMPU_METHOD CU_ATV_PLATFORM_CODE_MONTH "Conversion method for atv_platform_code_month" RAT_FUNC "%10.0" "one" COEFFS 0.000000 1.000000 0.000000 0.000000 0.000000 1.000000 /end COMPU_METHOD
/* Scalar measurable for DDE 'atv_platform_code_subminor_ver'. */
/begin MEASUREMENT atv_platform_code_subminor_ver "Sub-minor version of the platform library code." UWORD CU_ATV_PLATFORM_CODE_SUBMINOR_0 1 100 0.0 0.0 ECU_ADDRESS 0x40022912 BYTE_ORDER MSB_FIRST /end MEASUREMENT
/begin COMPU_METHOD CU_ATV_PLATFORM_CODE_SUBMINOR_0 "Conversion method for atv_platform_code_subminor_ver" RAT_FUNC "%10.0" "one" COEFFS 0.000000 1.000000 0.000000 0.000000 0.000000 1.000000 /end COMPU_METHOD
/* Scalar measurable for DDE 'atv_platform_code_year'. */
/begin MEASUREMENT atv_platform_code_year "Year the platform library code was built." UWORD CU_ATV_PLATFORM_CODE_YEAR 1 100 0.0 0.0 ECU_ADDRESS 0x40022908 BYTE_ORDER MSB_FIRST /end MEASUREMENT
/begin COMPU_METHOD CU_ATV_PLATFORM_CODE_YEAR "Conversion method for atv_platform_code_year" RAT_FUNC "%10.0" "one" COEFFS 0.000000 1.000000 0.000000 0.000000 0.000000 1.000000 /end COMPU_METHOD
/* Scalar measurable for DDE 'atv_pm_0'. */
/begin MEASUREMENT atv_pm_0 "Power Mode Selector Pos 0" UBYTE CU_ATV_PM_0 1 100 0.0 1.0 ECU_ADDRESS 0x4002296d BYTE_ORDER MSB_FIRST /end MEASUREMENT
/begin COMPU_METHOD CU_ATV_PM_0 "Conversion method for atv_pm_0" RAT_FUNC "%10.0" "one" COEFFS 0.000000 1.000000 0.000000 0.000000 0.000000 1.000000 /end COMPU_METHOD
/* Scalar measurable for DDE 'atv_pm_1'. */
/begin MEASUREMENT atv_pm_1 "Power Mode Selector Pos 1" UBYTE CU_ATV_PM_1 1 100 0.0 1.0 ECU_ADDRESS 0x4002296c BYTE_ORDER MSB_FIRST /end MEASUREMENT
/begin COMPU_METHOD CU_ATV_PM_1 "Conversion method for atv_pm_1" RAT_FUNC "%10.0" "one" COEFFS 0.000000 1.000000 0.000000 0.000000 0.000000 1.000000 /end COMPU_METHOD
/* Scalar measurable for DDE 'atv_pm_2'. */
/begin MEASUREMENT atv_pm_2 "Power Mode Selector Pos 2" UBYTE CU_ATV_PM_2 1 100 0.0 1.0 ECU_ADDRESS 0x4002296b BYTE_ORDER MSB_FIRST /end MEASUREMENT
/begin COMPU_METHOD CU_ATV_PM_2 "Conversion method for atv_pm_2" RAT_FUNC "%10.0" "one" COEFFS 0.000000 1.000000 0.000000 0.000000 0.000000 1.000000 /end COMPU_METHOD
/* Scalar measurable for DDE 'atv_pm_Electric'. */
/begin MEASUREMENT atv_pm_Electric "Power Mode Selector Electric Mode" UBYTE CU_ATV_PM_ELECTRIC 1 100 0.0 1.0 ECU_ADDRESS 0x40022966 BYTE_ORDER MSB_FIRST /end MEASUREMENT
/begin COMPU_METHOD CU_ATV_PM_ELECTRIC "Conversion method for atv_pm_Electric" RAT_FUNC "%10.0" "one" COEFFS 0.000000 1.000000 0.000000 0.000000 0.000000 1.000000 /end COMPU_METHOD
/* Scalar measurable for DDE 'atv_pm_Hybrid'. */
/begin MEASUREMENT atv_pm_Hybrid "Power Mode Selector Hybrid Mode" UBYTE CU_ATV_PM_HYBRID 1 100 0.0 0.0 ECU_ADDRESS 0x4002293c BYTE_ORDER MSB_FIRST /end MEASUREMENT
/begin COMPU_METHOD CU_ATV_PM_HYBRID "Conversion method for atv_pm_Hybrid" RAT_FUNC "%10.0" "one" COEFFS 0.000000 1.000000 0.000000 0.000000 0.000000 1.000000 /end COMPU_METHOD
/* Scalar measurable for DDE 'atv_pm_PreOp'. */
/begin MEASUREMENT atv_pm_PreOp "Power Mode Selector PreOp Mode" UBYTE CU_ATV_PM_PREOP 1 100 0.0 1.0 ECU_ADDRESS 0x40022964 BYTE_ORDER MSB_FIRST /end MEASUREMENT
/begin COMPU_METHOD CU_ATV_PM_PREOP "Conversion method for atv_pm_PreOp" RAT_FUNC "%10.0" "one" COEFFS 0.000000 1.000000 0.000000 0.000000 0.000000 1.000000 /end COMPU_METHOD
/* Scalar measurable for DDE 'atv_pm_Stealth'. */
/begin MEASUREMENT atv_pm_Stealth "Power Mode Selector Stealth Electric Mode" UBYTE CU_ATV_PM_STEALTH 1 100 0.0 1.0 ECU_ADDRESS 0x40022965 BYTE_ORDER MSB_FIRST /end MEASUREMENT
/begin COMPU_METHOD CU_ATV_PM_STEALTH "Conversion method for atv_pm_Stealth" RAT_FUNC "%10.0" "one" COEFFS 0.000000 1.000000 0.000000 0.000000 0.000000 1.000000 /end COMPU_METHOD
/* Scalar measurable for DDE 'atv_pm_g'. */
/begin MEASUREMENT atv_pm_g "Power Mode Selector Pos Giorno" UBYTE CU_ATV_PM_G 1 100 0.0 1.0 ECU_ADDRESS 0x40022967 BYTE_ORDER MSB_FIRST /end MEASUREMENT
/begin COMPU_METHOD CU_ATV_PM_G "Conversion method for atv_pm_g" RAT_FUNC "%10.0" "one" COEFFS 0.000000 1.000000 0.000000 0.000000 0.000000 1.000000 /end COMPU_METHOD
/* Scalar measurable for DDE 'atv_pm_s1'. */
/begin MEASUREMENT atv_pm_s1 "Power Mode Selector Pos S1" UBYTE CU_ATV_PM_S1 1 100 0.0 1.0 ECU_ADDRESS 0x40022968 BYTE_ORDER MSB_FIRST /end MEASUREMENT
/begin COMPU_METHOD CU_ATV_PM_S1 "Conversion method for atv_pm_s1" RAT_FUNC "%10.0" "one" COEFFS 0.000000 1.000000 0.000000 0.000000 0.000000 1.000000 /end COMPU_METHOD
/* Scalar measurable for DDE 'atv_pm_s2'. */
/begin MEASUREMENT atv_pm_s2 "Power Mode Selector Pos S2" UBYTE CU_ATV_PM_S2 1 100 0.0 1.0 ECU_ADDRESS 0x40022969 BYTE_ORDER MSB_FIRST /end MEASUREMENT
/begin COMPU_METHOD CU_ATV_PM_S2 "Conversion method for atv_pm_s2" RAT_FUNC "%10.0" "one" COEFFS 0.000000 1.000000 0.000000 0.000000 0.000000 1.000000 /end COMPU_METHOD
/* Scalar measurable for DDE 'atv_pm_s3'. */
/begin MEASUREMENT atv_pm_s3 "Power Mode Selector Pos S3" UBYTE CU_ATV_PM_S3 1 100 0.0 1.0 ECU_ADDRESS 0x4002296a BYTE_ORDER MSB_FIRST /end MEASUREMENT
/begin COMPU_METHOD CU_ATV_PM_S3 "Conversion method for atv_pm_s3" RAT_FUNC "%10.0" "one" COEFFS 0.000000 1.000000 0.000000 0.000000 0.000000 1.000000 /end COMPU_METHOD
/* Scalar measurable for DDE 'atv_prg_code_day'. */
/begin MEASUREMENT atv_prg_code_day "Day the reprogramming code was built." UWORD CU_ATV_PRG_CODE_DAY 1 100 0.0 0.0 ECU_ADDRESS 0x40022900 BYTE_ORDER MSB_FIRST /end MEASUREMENT
/begin COMPU_METHOD CU_ATV_PRG_CODE_DAY "Conversion method for atv_prg_code_day" RAT_FUNC "%10.0" "one" COEFFS 0.000000 1.000000 0.000000 0.000000 0.000000 1.000000 /end COMPU_METHOD
/* Scalar measurable for DDE 'atv_prg_code_major_ver'. */
/begin MEASUREMENT atv_prg_code_major_ver "Major version of the reprogramming code." UWORD CU_ATV_PRG_CODE_MAJOR_VER 1 100 0.0 0.0 ECU_ADDRESS 0x40022902 BYTE_ORDER MSB_FIRST /end MEASUREMENT
/begin COMPU_METHOD CU_ATV_PRG_CODE_MAJOR_VER "Conversion method for atv_prg_code_major_ver" RAT_FUNC "%10.0" "one" COEFFS 0.000000 1.000000 0.000000 0.000000 0.000000 1.000000 /end COMPU_METHOD
/* Scalar measurable for DDE 'atv_prg_code_minor_ver'. */
/begin MEASUREMENT atv_prg_code_minor_ver "Minor version of the reprogramming code." UWORD CU_ATV_PRG_CODE_MINOR_VER 1 100 0.0 0.0 ECU_ADDRESS 0x40022904 BYTE_ORDER MSB_FIRST /end MEASUREMENT
/begin COMPU_METHOD CU_ATV_PRG_CODE_MINOR_VER "Conversion method for atv_prg_code_minor_ver" RAT_FUNC "%10.0" "one" COEFFS 0.000000 1.000000 0.000000 0.000000 0.000000 1.000000 /end COMPU_METHOD
/* Scalar measurable for DDE 'atv_prg_code_month'. */
/begin MEASUREMENT atv_prg_code_month "Month the reprogramming code was built." UWORD CU_ATV_PRG_CODE_MONTH 1 100 0.0 0.0 ECU_ADDRESS 0x400228fe BYTE_ORDER MSB_FIRST /end MEASUREMENT
/begin COMPU_METHOD CU_ATV_PRG_CODE_MONTH "Conversion method for atv_prg_code_month" RAT_FUNC "%10.0" "one" COEFFS 0.000000 1.000000 0.000000 0.000000 0.000000 1.000000 /end COMPU_METHOD
/* Scalar measurable for DDE 'atv_prg_code_subminor_ver'. */
/begin MEASUREMENT atv_prg_code_subminor_ver "Sub-minor version of the reprogramming code." UWORD CU_ATV_PRG_CODE_SUBMINOR_VER 1 100 0.0 0.0 ECU_ADDRESS 0x40022906 BYTE_ORDER MSB_FIRST /end MEASUREMENT
/begin COMPU_METHOD CU_ATV_PRG_CODE_SUBMINOR_VER "Conversion method for atv_prg_code_subminor_ver" RAT_FUNC "%10.0" "one" COEFFS 0.000000 1.000000 0.000000 0.000000 0.000000 1.000000 /end COMPU_METHOD
/* Scalar measurable for DDE 'atv_prg_code_year'. */
/begin MEASUREMENT atv_prg_code_year "Year the reprogramming code was built." UWORD CU_ATV_PRG_CODE_YEAR 1 100 0.0 0.0 ECU_ADDRESS 0x400228fc BYTE_ORDER MSB_FIRST /end MEASUREMENT
/begin COMPU_METHOD CU_ATV_PRG_CODE_YEAR "Conversion method for atv_prg_code_year" RAT_FUNC "%10.0" "one" COEFFS 0.000000 1.000000 0.000000 0.000000 0.000000 1.000000 /end COMPU_METHOD
/* Scalar measurable for DDE 'atv_reg_current_limit'. */
/begin MEASUREMENT atv_reg_current_limit "Regen Current Limit" UWORD CU_ATV_REG_CURRENT_LIMIT 1 100 0.0 0.0 ECU_ADDRESS 0x40022914 BYTE_ORDER MSB_FIRST /end MEASUREMENT
/begin COMPU_METHOD CU_ATV_REG_CURRENT_LIMIT "Conversion method for atv_reg_current_limit" RAT_FUNC "%10.0" "A" COEFFS 0.000000 1.000000 0.000000 0.000000 0.000000 1.000000 /end COMPU_METHOD
/* Scalar measurable for DDE 'atv_regen_x1000_front'. */
/begin MEASUREMENT atv_regen_x1000_front "Throttle output front neutral braking 0-1000" UWORD CU_ATV_REGEN_X1000_FRONT 1 100 0.0 0.0 ECU_ADDRESS 0x400228dc BYTE_ORDER MSB_FIRST /end MEASUREMENT
/begin COMPU_METHOD CU_ATV_REGEN_X1000_FRONT "Conversion method for atv_regen_x1000_front" RAT_FUNC "%10.0" "V" COEFFS 0.000000 1.000000 0.000000 0.000000 0.000000 1.000000 /end COMPU_METHOD
/* Scalar measurable for DDE 'atv_regen_x1000_rear'. */
/begin MEASUREMENT atv_regen_x1000_rear "Throttle output rear neutral braking 0-1000" UWORD CU_ATV_REGEN_X1000_REAR 1 100 0.0 0.0 ECU_ADDRESS 0x400228de BYTE_ORDER MSB_FIRST /end MEASUREMENT
/begin COMPU_METHOD CU_ATV_REGEN_X1000_REAR "Conversion method for atv_regen_x1000_rear" RAT_FUNC "%10.0" "V" COEFFS 0.000000 1.000000 0.000000 0.000000 0.000000 1.000000 /end COMPU_METHOD
/* Scalar measurable for DDE 'atv_regmap'. */
/begin MEASUREMENT atv_regmap "Actual regeneration map" UBYTE CU_ATV_REGMAP 1 100 0.0 0.0 ECU_ADDRESS 0x40022933 BYTE_ORDER MSB_FIRST /end MEASUREMENT
/begin COMPU_METHOD CU_ATV_REGMAP "Conversion method for atv_regmap" RAT_FUNC "%10.0" "one" COEFFS 0.000000 1.000000 0.000000 0.000000 0.000000 1.000000 /end COMPU_METHOD
/* Scalar measurable for DDE 'atv_rmot_run_timer'. */
/begin MEASUREMENT atv_rmot_run_timer "ICE Run Timer [sec]" ULONG CU_ATV_RMOT_RUN_TIMER 1 100 0.0 2000000000.0 ECU_ADDRESS 0x400228a0 BYTE_ORDER MSB_FIRST /end MEASUREMENT
/begin COMPU_METHOD CU_ATV_RMOT_RUN_TIMER "Conversion method for atv_rmot_run_timer" RAT_FUNC "%10.0" "m" COEFFS 0.000000 1.000000 0.000000 0.000000 0.000000 1.000000 /end COMPU_METHOD
/* Scalar measurable for DDE 'atv_runLed_out'. */
/begin MEASUREMENT atv_runLed_out "RUN LED Status" UBYTE CU_ATV_RUNLED_OUT 1 100 0.0 1.0 ECU_ADDRESS 0x40022949 BYTE_ORDER MSB_FIRST /end MEASUREMENT
/begin COMPU_METHOD CU_ATV_RUNLED_OUT "Conversion method for atv_runLed_out" RAT_FUNC "%10.0" "one" COEFFS 0.000000 1.000000 0.000000 0.000000 0.000000 1.000000 /end COMPU_METHOD
/* Scalar measurable for DDE 'atv_stack_used'. */
/begin MEASUREMENT atv_stack_used "Amount of used stack" ULONG CU_ATV_STACK_USED 1 100 0.0 0.0 ECU_ADDRESS 0x400228a4 BYTE_ORDER MSB_FIRST /end MEASUREMENT
/begin COMPU_METHOD CU_ATV_STACK_USED "Conversion method for atv_stack_used" RAT_FUNC "%10.0" "byte" COEFFS 0.000000 1.000000 0.000000 0.000000 0.000000 1.000000 /end COMPU_METHOD
/* Scalar measurable for DDE 'atv_startBtnArmed'. */
/begin MEASUREMENT atv_startBtnArmed "Start Conditions Verified" UBYTE CU_ATV_STARTBTNARMED 1 100 0.0 1.0 ECU_ADDRESS 0x4002295b BYTE_ORDER MSB_FIRST /end MEASUREMENT
/begin COMPU_METHOD CU_ATV_STARTBTNARMED "Conversion method for atv_startBtnArmed" RAT_FUNC "%10.0" "one" COEFFS 0.000000 1.000000 0.000000 0.000000 0.000000 1.000000 /end COMPU_METHOD
/* Scalar measurable for DDE 'atv_startConditions'. */
/begin MEASUREMENT atv_startConditions "Start Conditions Verified" UBYTE CU_ATV_STARTCONDITIONS 1 100 0.0 1.0 ECU_ADDRESS 0x40022944 BYTE_ORDER MSB_FIRST /end MEASUREMENT
/begin COMPU_METHOD CU_ATV_STARTCONDITIONS "Conversion method for atv_startConditions" RAT_FUNC "%10.0" "one" COEFFS 0.000000 1.000000 0.000000 0.000000 0.000000 1.000000 /end COMPU_METHOD
/* Scalar measurable for DDE 'atv_state_out'. */
/begin MEASUREMENT atv_state_out "VSM State" UBYTE CU_ATV_STATE_OUT 1 100 0.0 0.0 ECU_ADDRESS 0x40022938 BYTE_ORDER MSB_FIRST /end MEASUREMENT
/begin COMPU_METHOD CU_ATV_STATE_OUT "Conversion method for atv_state_out" RAT_FUNC "%10.0" "one" COEFFS 0.000000 1.000000 0.000000 0.000000 0.000000 1.000000 /end COMPU_METHOD
/* Scalar measurable for DDE 'atv_sub_state_out'. */
/begin MEASUREMENT atv_sub_state_out "VSM SubState" UBYTE CU_ATV_SUB_STATE_OUT 1 100 0.0 0.0 ECU_ADDRESS 0x40022939 BYTE_ORDER MSB_FIRST /end MEASUREMENT
/begin COMPU_METHOD CU_ATV_SUB_STATE_OUT "Conversion method for atv_sub_state_out" RAT_FUNC "%10.0" "one" COEFFS 0.000000 1.000000 0.000000 0.000000 0.000000 1.000000 /end COMPU_METHOD
/* Scalar measurable for DDE 'atv_task_duration_1s'. */
/begin MEASUREMENT atv_task_duration_1s "Duration of 1s task (last measured valued)" ULONG CU_ATV_TASK_DURATION_1S 1 100 0.0 0.0 ECU_ADDRESS 0x400228a8 BYTE_ORDER MSB_FIRST /end MEASUREMENT
/begin COMPU_METHOD CU_ATV_TASK_DURATION_1S "Conversion method for atv_task_duration_1s" RAT_FUNC "%10.0" "microsecond" COEFFS 0.000000 1.000000 0.000000 0.000000 0.000000 1.000000 /end COMPU_METHOD
/* Scalar measurable for DDE 'atv_task_duration_1s_max'. */
/begin MEASUREMENT atv_task_duration_1s_max "Duration of 1s task (maximum since power up)" ULONG CU_ATV_TASK_DURATION_1S_MAX 1 100 0.0 0.0 ECU_ADDRESS 0x400228ac BYTE_ORDER MSB_FIRST /end MEASUREMENT
/begin COMPU_METHOD CU_ATV_TASK_DURATION_1S_MAX "Conversion method for atv_task_duration_1s_max" RAT_FUNC "%10.0" "microsecond" COEFFS 0.000000 1.000000 0.000000 0.000000 0.000000 1.000000 /end COMPU_METHOD
/* Scalar measurable for DDE 'atv_throttleGen_X1000_out'. */
/begin MEASUREMENT atv_throttleGen_X1000_out "Ice StartTorque [0.1%]" UWORD CU_ATV_THROTTLEGEN_X1000_OUT 1 100 0.0 0.0 ECU_ADDRESS 0x400228e0 BYTE_ORDER MSB_FIRST /end MEASUREMENT
/begin COMPU_METHOD CU_ATV_THROTTLEGEN_X1000_OUT "Conversion method for atv_throttleGen_X1000_out" RAT_FUNC "%10.0" "one" COEFFS 0.000000 1.000000 0.000000 0.000000 0.000000 1.000000 /end COMPU_METHOD
/* Scalar measurable for DDE 'atv_throttleX1000'. */
/begin MEASUREMENT atv_throttleX1000 "Throttle Input 0-1000" UWORD CU_ATV_THROTTLEX1000 1 100 0.0 0.0 ECU_ADDRESS 0x400228d2 BYTE_ORDER MSB_FIRST /end MEASUREMENT
/begin COMPU_METHOD CU_ATV_THROTTLEX1000 "Conversion method for atv_throttleX1000" RAT_FUNC "%10.0" "one" COEFFS 0.000000 1.000000 0.000000 0.000000 0.000000 1.000000 /end COMPU_METHOD
/* Scalar measurable for DDE 'atv_v_dbg_chg_req'. */
/begin MEASUREMENT atv_v_dbg_chg_req "HV Relay Control (Debug Signal)" UBYTE CU_ATV_V_DBG_CHG_REQ 1 100 0.0 1.0 ECU_ADDRESS 0x40022951 BYTE_ORDER MSB_FIRST /end MEASUREMENT
/begin COMPU_METHOD CU_ATV_V_DBG_CHG_REQ "Conversion method for atv_v_dbg_chg_req" RAT_FUNC "%10.0" "one" COEFFS 0.000000 1.000000 0.000000 0.000000 0.000000 1.000000 /end COMPU_METHOD
/* Scalar measurable for DDE 'atv_v_dbg_heater_req'. */
/begin MEASUREMENT atv_v_dbg_heater_req "HV Relay Control (Debug Signal)" UBYTE CU_ATV_V_DBG_HEATER_REQ 1 100 0.0 1.0 ECU_ADDRESS 0x40022952 BYTE_ORDER MSB_FIRST /end MEASUREMENT
/begin COMPU_METHOD CU_ATV_V_DBG_HEATER_REQ "Conversion method for atv_v_dbg_heater_req" RAT_FUNC "%10.0" "one" COEFFS 0.000000 1.000000 0.000000 0.000000 0.000000 1.000000 /end COMPU_METHOD
/* Scalar measurable for DDE 'atv_vehicle_SOC'. */
/begin MEASUREMENT atv_vehicle_SOC "Vehicle SOC [%]" UBYTE CU_ATV_VEHICLE_SOC 1 100 0.0 0.0 ECU_ADDRESS 0x40022937 BYTE_ORDER MSB_FIRST /end MEASUREMENT
/begin COMPU_METHOD CU_ATV_VEHICLE_SOC "Conversion method for atv_vehicle_SOC" RAT_FUNC "%10.0" "%" COEFFS 0.000000 1.000000 0.000000 0.000000 0.000000 1.000000 /end COMPU_METHOD
/* Scalar measurable for DDE 'atv_wakelock_out'. */
/begin MEASUREMENT atv_wakelock_out "Wakelock Status" UBYTE CU_ATV_WAKELOCK_OUT 1 100 0.0 1.0 ECU_ADDRESS 0x40022959 BYTE_ORDER MSB_FIRST /end MEASUREMENT
/begin COMPU_METHOD CU_ATV_WAKELOCK_OUT "Conversion method for atv_wakelock_out" RAT_FUNC "%10.0" "one" COEFFS 0.000000 1.000000 0.000000 0.000000 0.000000 1.000000 /end COMPU_METHOD
/* Scalar measurable for DDE 'atv_xa1_ain_throttle_raw'. */
/begin MEASUREMENT atv_xa1_ain_throttle_raw "Throttle Input V (Raw Voltage)" FLOAT32_IEEE CU_ATV_XA1_AIN_THROTTLE_RAW 1 100 0.0 0.0 ECU_ADDRESS 0x40022878 BYTE_ORDER MSB_FIRST /end MEASUREMENT
/begin COMPU_METHOD CU_ATV_XA1_AIN_THROTTLE_RAW "Conversion method for atv_xa1_ain_throttle_raw" RAT_FUNC "%10.3" "V" COEFFS 0.000000 1.000000 0.000000 0.000000 0.000000 1.000000 /end COMPU_METHOD
/* Scalar measurable for DDE 'atv_xa3_brake_pedal_raw_ain'. */
/begin MEASUREMENT atv_xa3_brake_pedal_raw_ain "Brake Pedal (Raw Voltage)" FLOAT32_IEEE CU_ATV_XA3_BRAKE_PEDAL_RAW_AIN 1 100 0.0 0.0 ECU_ADDRESS 0x4002285c BYTE_ORDER MSB_FIRST /end MEASUREMENT
/begin COMPU_METHOD CU_ATV_XA3_BRAKE_PEDAL_RAW_AIN "Conversion method for atv_xa3_brake_pedal_raw_ain" RAT_FUNC "%10.3" "V" COEFFS 0.000000 1.000000 0.000000 0.000000 0.000000 1.000000 /end COMPU_METHOD
/* Scalar measurable for DDE 'atv_xc1_raw_ain'. */
/begin MEASUREMENT atv_xc1_raw_ain "Fwd Selector (Raw Voltage)" FLOAT32_IEEE CU_ATV_XC1_RAW_AIN 1 100 0.0 0.0 ECU_ADDRESS 0x40022854 BYTE_ORDER MSB_FIRST /end MEASUREMENT
/begin COMPU_METHOD CU_ATV_XC1_RAW_AIN "Conversion method for atv_xc1_raw_ain" RAT_FUNC "%10.3" "V" COEFFS 0.000000 1.000000 0.000000 0.000000 0.000000 1.000000 /end COMPU_METHOD
/* Scalar measurable for DDE 'atv_xc4_raw_ain'. */
/begin MEASUREMENT atv_xc4_raw_ain "Rwd Selector (Raw Voltage)" FLOAT32_IEEE CU_ATV_XC4_RAW_AIN 1 100 0.0 0.0 ECU_ADDRESS 0x40022858 BYTE_ORDER MSB_FIRST /end MEASUREMENT
/begin COMPU_METHOD CU_ATV_XC4_RAW_AIN "Conversion method for atv_xc4_raw_ain" RAT_FUNC "%10.3" "V" COEFFS 0.000000 1.000000 0.000000 0.000000 0.000000 1.000000 /end COMPU_METHOD
/* Scalar measurable for DDE 'atv_xd1_key_ain'. */
/begin MEASUREMENT atv_xd1_key_ain "Key Input (V)" FLOAT32_IEEE CU_ATV_XD1_KEY_AIN 1 100 0.0 0.0 ECU_ADDRESS 0x40022850 BYTE_ORDER MSB_FIRST /end MEASUREMENT
/begin COMPU_METHOD CU_ATV_XD1_KEY_AIN "Conversion method for atv_xd1_key_ain" RAT_FUNC "%10.3" "V" COEFFS 0.000000 1.000000 0.000000 0.000000 0.000000 1.000000 /end COMPU_METHOD
/* Scalar measurable for DDE 'atv_xd2'. */
/begin MEASUREMENT atv_xd2 "Power Mode Selector s56" FLOAT32_IEEE CU_ATV_XD2 1 100 0.0 0.0 ECU_ADDRESS 0x400228b4 BYTE_ORDER MSB_FIRST /end MEASUREMENT
/begin COMPU_METHOD CU_ATV_XD2 "Conversion method for atv_xd2" RAT_FUNC "%10.3" "V" COEFFS 0.000000 1.000000 0.000000 0.000000 0.000000 1.000000 /end COMPU_METHOD
/* Scalar measurable for DDE 'atv_xd3_raw_ain'. */
/begin MEASUREMENT atv_xd3_raw_ain "Foot Pedal FS1 Switch (Raw Voltage)" FLOAT32_IEEE CU_ATV_XD3_RAW_AIN 1 100 0.0 0.0 ECU_ADDRESS 0x4002287c BYTE_ORDER MSB_FIRST /end MEASUREMENT
/begin COMPU_METHOD CU_ATV_XD3_RAW_AIN "Conversion method for atv_xd3_raw_ain" RAT_FUNC "%10.3" "V" COEFFS 0.000000 1.000000 0.000000 0.000000 0.000000 1.000000 /end COMPU_METHOD
/* Scalar measurable for DDE 'atv_xe2_raw_ain'. */
/begin MEASUREMENT atv_xe2_raw_ain "APU Button (Raw Voltage)" FLOAT32_IEEE CU_ATV_XE2_RAW_AIN 1 100 0.0 0.0 ECU_ADDRESS 0x40022860 BYTE_ORDER MSB_FIRST /end MEASUREMENT
/begin COMPU_METHOD CU_ATV_XE2_RAW_AIN "Conversion method for atv_xe2_raw_ain" RAT_FUNC "%10.3" "V" COEFFS 0.000000 1.000000 0.000000 0.000000 0.000000 1.000000 /end COMPU_METHOD
/* Scalar measurable for DDE 'atv_xe3_ain'. */
/begin MEASUREMENT atv_xe3_ain "(not defined)" SLONG CU_ATV_XE3_AIN 1 100 0.0 0.0 ECU_ADDRESS 0x400228c4 BYTE_ORDER MSB_FIRST /end MEASUREMENT
/begin COMPU_METHOD CU_ATV_XE3_AIN "Conversion method for atv_xe3_ain" RAT_FUNC "%10.0" "V" COEFFS 0.000000 1.000000 0.000000 0.000000 0.000000 1.000000 /end COMPU_METHOD
/* Scalar measurable for DDE 'atv_xe4_raw_ain'. */
/begin MEASUREMENT atv_xe4_raw_ain "2WD/4WD  Selector (Raw Voltage)" FLOAT32_IEEE CU_ATV_XE4_RAW_AIN 1 100 0.0 0.0 ECU_ADDRESS 0x40022884 BYTE_ORDER MSB_FIRST /end MEASUREMENT
/begin COMPU_METHOD CU_ATV_XE4_RAW_AIN "Conversion method for atv_xe4_raw_ain" RAT_FUNC "%10.3" "V" COEFFS 0.000000 1.000000 0.000000 0.000000 0.000000 1.000000 /end COMPU_METHOD
/* Scalar measurable for DDE 'atv_xf4'. */
/begin MEASUREMENT atv_xf4 "PumpA Fault" UBYTE CU_ATV_XF4 1 100 0.0 1.0 ECU_ADDRESS 0x40022946 BYTE_ORDER MSB_FIRST /end MEASUREMENT
/begin COMPU_METHOD CU_ATV_XF4 "Conversion method for atv_xf4" RAT_FUNC "%10.0" "one" COEFFS 0.000000 1.000000 0.000000 0.000000 0.000000 1.000000 /end COMPU_METHOD
/* Scalar measurable for DDE 'atv_yb3_raw_ain'. */
/begin MEASUREMENT atv_yb3_raw_ain "Fuel Sensor [V]" FLOAT32_IEEE CU_ATV_YB3_RAW_AIN 1 100 0.0 0.0 ECU_ADDRESS 0x40022874 BYTE_ORDER MSB_FIRST /end MEASUREMENT
/begin COMPU_METHOD CU_ATV_YB3_RAW_AIN "Conversion method for atv_yb3_raw_ain" RAT_FUNC "%10.3" "V" COEFFS 0.000000 1.000000 0.000000 0.000000 0.000000 1.000000 /end COMPU_METHOD
/* Scalar measurable for DDE 'atv_ye2'. */
/begin MEASUREMENT atv_ye2 "Active Suspension Ctrl" FLOAT32_IEEE CU_ATV_YE2 1 100 0.0 0.0 ECU_ADDRESS 0x400228bc BYTE_ORDER MSB_FIRST /end MEASUREMENT
/begin COMPU_METHOD CU_ATV_YE2 "Conversion method for atv_ye2" RAT_FUNC "%10.3" "V" COEFFS 0.000000 1.000000 0.000000 0.000000 0.000000 1.000000 /end COMPU_METHOD
/* Scalar measurable for DDE 'atv_yg1'. */
/begin MEASUREMENT atv_yg1 "Stealth mode out" UBYTE CU_ATV_YG1 1 100 0.0 1.0 ECU_ADDRESS 0x40022963 BYTE_ORDER MSB_FIRST /end MEASUREMENT
/begin COMPU_METHOD CU_ATV_YG1 "Conversion method for atv_yg1" RAT_FUNC "%10.0" "one" COEFFS 0.000000 1.000000 0.000000 0.000000 0.000000 1.000000 /end COMPU_METHOD
/* Scalar measurable for DDE 'atv_yg2'. */
/begin MEASUREMENT atv_yg2 "RegMap Sel 0" UBYTE CU_ATV_YG2 1 100 0.0 1.0 ECU_ADDRESS 0x4002294c BYTE_ORDER MSB_FIRST /end MEASUREMENT
/begin COMPU_METHOD CU_ATV_YG2 "Conversion method for atv_yg2" RAT_FUNC "%10.0" "one" COEFFS 0.000000 1.000000 0.000000 0.000000 0.000000 1.000000 /end COMPU_METHOD
/* Scalar measurable for DDE 'atv_yg3_raw_ain'. */
/begin MEASUREMENT atv_yg3_raw_ain "Throttle Input V (Raw Voltage)" FLOAT32_IEEE CU_ATV_YG3_RAW_AIN 1 100 0.0 0.0 ECU_ADDRESS 0x40022890 BYTE_ORDER MSB_FIRST /end MEASUREMENT
/begin COMPU_METHOD CU_ATV_YG3_RAW_AIN "Conversion method for atv_yg3_raw_ain" RAT_FUNC "%10.3" "V" COEFFS 0.000000 1.000000 0.000000 0.000000 0.000000 1.000000 /end COMPU_METHOD
/* Scalar measurable for DDE 'atv_yh2'. */
/begin MEASUREMENT atv_yh2 "RegMap Sel 1" UBYTE CU_ATV_YH2 1 100 0.0 1.0 ECU_ADDRESS 0x4002294d BYTE_ORDER MSB_FIRST /end MEASUREMENT
/begin COMPU_METHOD CU_ATV_YH2 "Conversion method for atv_yh2" RAT_FUNC "%10.0" "one" COEFFS 0.000000 1.000000 0.000000 0.000000 0.000000 1.000000 /end COMPU_METHOD
/* Scalar measurable for DDE 'atv_yj2'. */
/begin MEASUREMENT atv_yj2 "RegMap Sel 2" UBYTE CU_ATV_YJ2 1 100 0.0 1.0 ECU_ADDRESS 0x4002294e BYTE_ORDER MSB_FIRST /end MEASUREMENT
/begin COMPU_METHOD CU_ATV_YJ2 "Conversion method for atv_yj2" RAT_FUNC "%10.0" "one" COEFFS 0.000000 1.000000 0.000000 0.000000 0.000000 1.000000 /end COMPU_METHOD
/* Scalar measurable for DDE 'atv_za2'. */
/begin MEASUREMENT atv_za2 "PumpB Fault" UBYTE CU_ATV_ZA2 1 100 0.0 1.0 ECU_ADDRESS 0x40022948 BYTE_ORDER MSB_FIRST /end MEASUREMENT
/begin COMPU_METHOD CU_ATV_ZA2 "Conversion method for atv_za2" RAT_FUNC "%10.0" "one" COEFFS 0.000000 1.000000 0.000000 0.000000 0.000000 1.000000 /end COMPU_METHOD
/* Scalar measurable for DDE 'atv_za3_StartBtn_din'. */
/begin MEASUREMENT atv_za3_StartBtn_din "Start Button Status (RAW)" UBYTE CU_ATV_ZA3_STARTBTN_DIN 1 100 0.0 1.0 ECU_ADDRESS 0x4002293e BYTE_ORDER MSB_FIRST /end MEASUREMENT
/begin COMPU_METHOD CU_ATV_ZA3_STARTBTN_DIN "Conversion method for atv_za3_StartBtn_din" RAT_FUNC "%10.0" "one" COEFFS 0.000000 1.000000 0.000000 0.000000 0.000000 1.000000 /end COMPU_METHOD
/* Scalar measurable for DDE 'atv_zb2'. */
/begin MEASUREMENT atv_zb2 "Generator Sel 1" UBYTE CU_ATV_ZB2 1 100 0.0 1.0 ECU_ADDRESS 0x4002294a BYTE_ORDER MSB_FIRST /end MEASUREMENT
/begin COMPU_METHOD CU_ATV_ZB2 "Conversion method for atv_zb2" RAT_FUNC "%10.0" "one" COEFFS 0.000000 1.000000 0.000000 0.000000 0.000000 1.000000 /end COMPU_METHOD
/* Scalar measurable for DDE 'atv_zb3'. */
/begin MEASUREMENT atv_zb3 "Generator Sel 2" UBYTE CU_ATV_ZB3 1 100 0.0 1.0 ECU_ADDRESS 0x4002294b BYTE_ORDER MSB_FIRST /end MEASUREMENT
/begin COMPU_METHOD CU_ATV_ZB3 "Conversion method for atv_zb3" RAT_FUNC "%10.0" "one" COEFFS 0.000000 1.000000 0.000000 0.000000 0.000000 1.000000 /end COMPU_METHOD
/* Scalar measurable for DDE 'atv_zc2'. */
/begin MEASUREMENT atv_zc2 "Power Mode Selector 58" UBYTE CU_ATV_ZC2 1 100 0.0 1.0 ECU_ADDRESS 0x4002293f BYTE_ORDER MSB_FIRST /end MEASUREMENT
/begin COMPU_METHOD CU_ATV_ZC2 "Conversion method for atv_zc2" RAT_FUNC "%10.0" "one" COEFFS 0.000000 1.000000 0.000000 0.000000 0.000000 1.000000 /end COMPU_METHOD
/* Scalar measurable for DDE 'atv_zc4'. */
/begin MEASUREMENT atv_zc4 "Power Mode Selector 56" UBYTE CU_ATV_ZC4 1 100 0.0 1.0 ECU_ADDRESS 0x40022940 BYTE_ORDER MSB_FIRST /end MEASUREMENT
/begin COMPU_METHOD CU_ATV_ZC4 "Conversion method for atv_zc4" RAT_FUNC "%10.0" "one" COEFFS 0.000000 1.000000 0.000000 0.000000 0.000000 1.000000 /end COMPU_METHOD
/* Scalar measurable for DDE 'atv_zd1_ain'. */
/begin MEASUREMENT atv_zd1_ain "12V level (Raw in)" FLOAT32_IEEE CU_ATV_ZD1_AIN 1 100 0.0 0.0 ECU_ADDRESS 0x40022888 BYTE_ORDER MSB_FIRST /end MEASUREMENT
/begin COMPU_METHOD CU_ATV_ZD1_AIN "Conversion method for atv_zd1_ain" RAT_FUNC "%10.3" "V" COEFFS 0.000000 1.000000 0.000000 0.000000 0.000000 1.000000 /end COMPU_METHOD
/* Scalar measurable for DDE 'atv_ze3'. */
/begin MEASUREMENT atv_ze3 "Power Mode Selector s54" FLOAT32_IEEE CU_ATV_ZE3 1 100 0.0 0.0 ECU_ADDRESS 0x400228b8 BYTE_ORDER MSB_FIRST /end MEASUREMENT
/begin COMPU_METHOD CU_ATV_ZE3 "Conversion method for atv_ze3" RAT_FUNC "%10.3" "V" COEFFS 0.000000 1.000000 0.000000 0.000000 0.000000 1.000000 /end COMPU_METHOD
/* Scalar measurable for DDE 'atv_ze4'. */
/begin MEASUREMENT atv_ze4 "Power Mode Selector 15a" FLOAT32_IEEE CU_ATV_ZE4 1 100 0.0 0.0 ECU_ADDRESS 0x400228b0 BYTE_ORDER MSB_FIRST /end MEASUREMENT
/begin COMPU_METHOD CU_ATV_ZE4 "Conversion method for atv_ze4" RAT_FUNC "%10.3" "V" COEFFS 0.000000 1.000000 0.000000 0.000000 0.000000 1.000000 /end COMPU_METHOD
/* Scalar calibration for DDE 'atvc_ChargeOverride'. */
/begin CHARACTERISTIC atvc_ChargeOverride "Start charge override" VALUE 0x1000e86 RL_ATVC_CHARGEOVERRIDE 1.000000 CU_ATVC_CHARGEOVERRIDE 0.000000 1.000000 BYTE_ORDER MSB_FIRST /end CHARACTERISTIC
/begin RECORD_LAYOUT RL_ATVC_CHARGEOVERRIDE FNC_VALUES 1 UBYTE COLUMN_DIR DIRECT /end RECORD_LAYOUT
/begin COMPU_METHOD CU_ATVC_CHARGEOVERRIDE "Conversion method for atvc_ChargeOverride" RAT_FUNC "%10.0" "one" COEFFS 0.000000 1.000000 0.000000 0.000000 0.000000 1.000000 /end COMPU_METHOD
/* Scalar calibration for DDE 'atvc_EndWarmUpTemp'. */
/begin CHARACTERISTIC atvc_EndWarmUpTemp "Generator warm up current [°C]" VALUE 0x1000e44 RL_ATVC_ENDWARMUPTEMP 55.000000 CU_ATVC_ENDWARMUPTEMP 25.000000 80.000000 BYTE_ORDER MSB_FIRST /end CHARACTERISTIC
/begin RECORD_LAYOUT RL_ATVC_ENDWARMUPTEMP FNC_VALUES 1 SWORD COLUMN_DIR DIRECT /end RECORD_LAYOUT
/begin COMPU_METHOD CU_ATVC_ENDWARMUPTEMP "Conversion method for atvc_EndWarmUpTemp" RAT_FUNC "%10.0" "deg" COEFFS 0.000000 1.000000 0.000000 0.000000 0.000000 1.000000 /end COMPU_METHOD
/* Scalar calibration for DDE 'atvc_ErrTempInv'. */
/begin CHARACTERISTIC atvc_ErrTempInv "Err Inverter Temp" VALUE 0x1000e91 RL_ATVC_ERRTEMPINV 190.000000 CU_ATVC_ERRTEMPINV 10.000000 200.000000 BYTE_ORDER MSB_FIRST /end CHARACTERISTIC
/begin RECORD_LAYOUT RL_ATVC_ERRTEMPINV FNC_VALUES 1 UBYTE COLUMN_DIR DIRECT /end RECORD_LAYOUT
/begin COMPU_METHOD CU_ATVC_ERRTEMPINV "Conversion method for atvc_ErrTempInv" RAT_FUNC "%10.0" "degree_Celsius" COEFFS 0.000000 1.000000 0.000000 0.000000 0.000000 1.000000 /end COMPU_METHOD
/* Scalar calibration for DDE 'atvc_ErrTempMot'. */
/begin CHARACTERISTIC atvc_ErrTempMot "Err Inverter Temp" VALUE 0x1000e92 RL_ATVC_ERRTEMPMOT 190.000000 CU_ATVC_ERRTEMPMOT 10.000000 200.000000 BYTE_ORDER MSB_FIRST /end CHARACTERISTIC
/begin RECORD_LAYOUT RL_ATVC_ERRTEMPMOT FNC_VALUES 1 UBYTE COLUMN_DIR DIRECT /end RECORD_LAYOUT
/begin COMPU_METHOD CU_ATVC_ERRTEMPMOT "Conversion method for atvc_ErrTempMot" RAT_FUNC "%10.0" "degree_Celsius" COEFFS 0.000000 1.000000 0.000000 0.000000 0.000000 1.000000 /end COMPU_METHOD
/* Scalar calibration for DDE 'atvc_GenCurrent0'. */
/begin CHARACTERISTIC atvc_GenCurrent0 "Generator warm up current [A]" VALUE 0x1000e46 RL_ATVC_GENCURRENT0 500.000000 CU_ATVC_GENCURRENT0 -250.000000 250.000000 BYTE_ORDER MSB_FIRST /end CHARACTERISTIC
/begin RECORD_LAYOUT RL_ATVC_GENCURRENT0 FNC_VALUES 1 SWORD COLUMN_DIR DIRECT /end RECORD_LAYOUT
/begin COMPU_METHOD CU_ATVC_GENCURRENT0 "Conversion method for atvc_GenCurrent0" RAT_FUNC "%10.0" "A" COEFFS 0.000000 1.000000 0.000000 0.000000 0.000000 1.000000 /end COMPU_METHOD
/* Scalar calibration for DDE 'atvc_GenCurrent1'. */
/begin CHARACTERISTIC atvc_GenCurrent1 "Generator warm up current [A]" VALUE 0x1000e48 RL_ATVC_GENCURRENT1 500.000000 CU_ATVC_GENCURRENT1 -250.000000 250.000000 BYTE_ORDER MSB_FIRST /end CHARACTERISTIC
/begin RECORD_LAYOUT RL_ATVC_GENCURRENT1 FNC_VALUES 1 SWORD COLUMN_DIR DIRECT /end RECORD_LAYOUT
/begin COMPU_METHOD CU_ATVC_GENCURRENT1 "Conversion method for atvc_GenCurrent1" RAT_FUNC "%10.0" "A" COEFFS 0.000000 1.000000 0.000000 0.000000 0.000000 1.000000 /end COMPU_METHOD
/* Scalar calibration for DDE 'atvc_GenCurrent2'. */
/begin CHARACTERISTIC atvc_GenCurrent2 "Generator warm up current [A]" VALUE 0x1000e4a RL_ATVC_GENCURRENT2 500.000000 CU_ATVC_GENCURRENT2 -250.000000 250.000000 BYTE_ORDER MSB_FIRST /end CHARACTERISTIC
/begin RECORD_LAYOUT RL_ATVC_GENCURRENT2 FNC_VALUES 1 SWORD COLUMN_DIR DIRECT /end RECORD_LAYOUT
/begin COMPU_METHOD CU_ATVC_GENCURRENT2 "Conversion method for atvc_GenCurrent2" RAT_FUNC "%10.0" "A" COEFFS 0.000000 1.000000 0.000000 0.000000 0.000000 1.000000 /end COMPU_METHOD
/* Scalar calibration for DDE 'atvc_GenWarmUpCurrent'. */
/begin CHARACTERISTIC atvc_GenWarmUpCurrent "Generator warm up current [A]" VALUE 0x1000e4c RL_ATVC_GENWARMUPCURRENT 200.000000 CU_ATVC_GENWARMUPCURRENT -100.000000 100.000000 BYTE_ORDER MSB_FIRST /end CHARACTERISTIC
/begin RECORD_LAYOUT RL_ATVC_GENWARMUPCURRENT FNC_VALUES 1 SWORD COLUMN_DIR DIRECT /end RECORD_LAYOUT
/begin COMPU_METHOD CU_ATVC_GENWARMUPCURRENT "Conversion method for atvc_GenWarmUpCurrent" RAT_FUNC "%10.0" "A" COEFFS 0.000000 1.000000 0.000000 0.000000 0.000000 1.000000 /end COMPU_METHOD
/* Scalar calibration for DDE 'atvc_GenWarmUpRPM'. */
/begin CHARACTERISTIC atvc_GenWarmUpRPM "ICE warmup rpm [RPM]" VALUE 0x1000e58 RL_ATVC_GENWARMUPRPM 5000.000000 CU_ATVC_GENWARMUPRPM 2000.000000 7000.000000 BYTE_ORDER MSB_FIRST /end CHARACTERISTIC
/begin RECORD_LAYOUT RL_ATVC_GENWARMUPRPM FNC_VALUES 1 UWORD COLUMN_DIR DIRECT /end RECORD_LAYOUT
/begin COMPU_METHOD CU_ATVC_GENWARMUPRPM "Conversion method for atvc_GenWarmUpRPM" RAT_FUNC "%10.0" "one" COEFFS 0.000000 1.000000 0.000000 0.000000 0.000000 1.000000 /end COMPU_METHOD
/* Scalar calibration for DDE 'atvc_HeatingMat_thr'. */
/begin CHARACTERISTIC atvc_HeatingMat_thr "Heating Mat Activaton Temperature [C]" VALUE 0x1000e8e RL_ATVC_HEATINGMAT_THR 30.000000 CU_ATVC_HEATINGMAT_THR -10.000000 20.000000 BYTE_ORDER MSB_FIRST /end CHARACTERISTIC
/begin RECORD_LAYOUT RL_ATVC_HEATINGMAT_THR FNC_VALUES 1 SBYTE COLUMN_DIR DIRECT /end RECORD_LAYOUT
/begin COMPU_METHOD CU_ATVC_HEATINGMAT_THR "Conversion method for atvc_HeatingMat_thr" RAT_FUNC "%10.0" "one" COEFFS 0.000000 1.000000 0.000000 0.000000 0.000000 1.000000 /end COMPU_METHOD
/* Scalar calibration for DDE 'atvc_ICE_ReserveFuel'. */
/begin CHARACTERISTIC atvc_ICE_ReserveFuel "ICE Tank Size [Liters]" VALUE 0x1002450 RL_ATVC_ICE_RESERVEFUEL 100.000000 CU_ATVC_ICE_RESERVEFUEL 0.000000 100.000000 BYTE_ORDER MSB_FIRST /end CHARACTERISTIC
/begin RECORD_LAYOUT RL_ATVC_ICE_RESERVEFUEL FNC_VALUES 1 FLOAT32_IEEE COLUMN_DIR DIRECT /end RECORD_LAYOUT
/begin COMPU_METHOD CU_ATVC_ICE_RESERVEFUEL "Conversion method for atvc_ICE_ReserveFuel" RAT_FUNC "%10.4" "one" COEFFS 0.000000 1.000000 0.000000 0.000000 0.000000 1.000000 /end COMPU_METHOD
/* Scalar calibration for DDE 'atvc_ICE_Tank_Volume'. */
/begin CHARACTERISTIC atvc_ICE_Tank_Volume "ICE Tank Size [liters]" VALUE 0x1002454 RL_ATVC_ICE_TANK_VOLUME 115.000000 CU_ATVC_ICE_TANK_VOLUME 5.000000 120.000000 BYTE_ORDER MSB_FIRST /end CHARACTERISTIC
/begin RECORD_LAYOUT RL_ATVC_ICE_TANK_VOLUME FNC_VALUES 1 FLOAT32_IEEE COLUMN_DIR DIRECT /end RECORD_LAYOUT
/begin COMPU_METHOD CU_ATVC_ICE_TANK_VOLUME "Conversion method for atvc_ICE_Tank_Volume" RAT_FUNC "%10.4" "one" COEFFS 0.000000 1.000000 0.000000 0.000000 0.000000 1.000000 /end COMPU_METHOD
/* Scalar calibration for DDE 'atvc_ICE_dragging_time'. */
/begin CHARACTERISTIC atvc_ICE_dragging_time "ICE StartUp Draging Time" VALUE 0x100245c RL_ATVC_ICE_DRAGGING_TIME 10.000000 CU_ATVC_ICE_DRAGGING_TIME 5.000000 15.000000 BYTE_ORDER MSB_FIRST /end CHARACTERISTIC
/begin RECORD_LAYOUT RL_ATVC_ICE_DRAGGING_TIME FNC_VALUES 1 FLOAT32_IEEE COLUMN_DIR DIRECT /end RECORD_LAYOUT
/begin COMPU_METHOD CU_ATVC_ICE_DRAGGING_TIME "Conversion method for atvc_ICE_dragging_time" RAT_FUNC "%10.4" "one" COEFFS 0.000000 1.000000 0.000000 0.000000 0.000000 1.000000 /end COMPU_METHOD
/* Scalar calibration for DDE 'atvc_IceMaxSOC'. */
/begin CHARACTERISTIC atvc_IceMaxSOC "ICE Auto Stop (static mode SOC )[%]" VALUE 0x1000e93 RL_ATVC_ICEMAXSOC 49.000000 CU_ATVC_ICEMAXSOC 50.000000 99.000000 BYTE_ORDER MSB_FIRST /end CHARACTERISTIC
/begin RECORD_LAYOUT RL_ATVC_ICEMAXSOC FNC_VALUES 1 UBYTE COLUMN_DIR DIRECT /end RECORD_LAYOUT
/begin COMPU_METHOD CU_ATVC_ICEMAXSOC "Conversion method for atvc_IceMaxSOC" RAT_FUNC "%10.0" "%" COEFFS 0.000000 1.000000 0.000000 0.000000 0.000000 1.000000 /end COMPU_METHOD
/* Scalar calibration for DDE 'atvc_IceMaxTemp'. */
/begin CHARACTERISTIC atvc_IceMaxTemp "Max ICE working temperature [°C]" VALUE 0x1000e4e RL_ATVC_ICEMAXTEMP 80.000000 CU_ATVC_ICEMAXTEMP 70.000000 150.000000 BYTE_ORDER MSB_FIRST /end CHARACTERISTIC
/begin RECORD_LAYOUT RL_ATVC_ICEMAXTEMP FNC_VALUES 1 SWORD COLUMN_DIR DIRECT /end RECORD_LAYOUT
/begin COMPU_METHOD CU_ATVC_ICEMAXTEMP "Conversion method for atvc_IceMaxTemp" RAT_FUNC "%10.0" "deg" COEFFS 0.000000 1.000000 0.000000 0.000000 0.000000 1.000000 /end COMPU_METHOD
/* Scalar calibration for DDE 'atvc_IceOffTh'. */
/begin CHARACTERISTIC atvc_IceOffTh "ICE Off Detection Tresasold [RPM]" VALUE 0x1000e5a RL_ATVC_ICEOFFTH 1800.000000 CU_ATVC_ICEOFFTH 200.000000 2000.000000 BYTE_ORDER MSB_FIRST /end CHARACTERISTIC
/begin RECORD_LAYOUT RL_ATVC_ICEOFFTH FNC_VALUES 1 UWORD COLUMN_DIR DIRECT /end RECORD_LAYOUT
/begin COMPU_METHOD CU_ATVC_ICEOFFTH "Conversion method for atvc_IceOffTh" RAT_FUNC "%10.0" "one" COEFFS 0.000000 1.000000 0.000000 0.000000 0.000000 1.000000 /end COMPU_METHOD
/* Scalar calibration for DDE 'atvc_IceOnTh'. */
/begin CHARACTERISTIC atvc_IceOnTh "ICE On Detection Tresasold [RPM]" VALUE 0x1000e5c RL_ATVC_ICEONTH 1900.000000 CU_ATVC_ICEONTH 2100.000000 4000.000000 BYTE_ORDER MSB_FIRST /end CHARACTERISTIC
/begin RECORD_LAYOUT RL_ATVC_ICEONTH FNC_VALUES 1 UWORD COLUMN_DIR DIRECT /end RECORD_LAYOUT
/begin COMPU_METHOD CU_ATVC_ICEONTH "Conversion method for atvc_IceOnTh" RAT_FUNC "%10.0" "one" COEFFS 0.000000 1.000000 0.000000 0.000000 0.000000 1.000000 /end COMPU_METHOD
/* Scalar calibration for DDE 'atvc_IceStartRetry'. */
/begin CHARACTERISTIC atvc_IceStartRetry "ICE StartUp Max Retry [RPM]" VALUE 0x1000e94 RL_ATVC_ICESTARTRETRY 10.000000 CU_ATVC_ICESTARTRETRY 0.000000 10.000000 BYTE_ORDER MSB_FIRST /end CHARACTERISTIC
/begin RECORD_LAYOUT RL_ATVC_ICESTARTRETRY FNC_VALUES 1 UBYTE COLUMN_DIR DIRECT /end RECORD_LAYOUT
/begin COMPU_METHOD CU_ATVC_ICESTARTRETRY "Conversion method for atvc_IceStartRetry" RAT_FUNC "%10.0" "one" COEFFS 0.000000 1.000000 0.000000 0.000000 0.000000 1.000000 /end COMPU_METHOD
/* Scalar calibration for DDE 'atvc_IceStartSOC'. */
/begin CHARACTERISTIC atvc_IceStartSOC "ICE Auto Start SOC [%]" VALUE 0x1000e95 RL_ATVC_ICESTARTSOC 75.000000 CU_ATVC_ICESTARTSOC 0.000000 75.000000 BYTE_ORDER MSB_FIRST /end CHARACTERISTIC
/begin RECORD_LAYOUT RL_ATVC_ICESTARTSOC FNC_VALUES 1 UBYTE COLUMN_DIR DIRECT /end RECORD_LAYOUT
/begin COMPU_METHOD CU_ATVC_ICESTARTSOC "Conversion method for atvc_IceStartSOC" RAT_FUNC "%10.0" "%" COEFFS 0.000000 1.000000 0.000000 0.000000 0.000000 1.000000 /end COMPU_METHOD
/* Scalar calibration for DDE 'atvc_IceStopSOC'. */
/begin CHARACTERISTIC atvc_IceStopSOC "ICE Auto Stop SOC [%]" VALUE 0x1000e96 RL_ATVC_ICESTOPSOC 19.000000 CU_ATVC_ICESTOPSOC 80.000000 99.000000 BYTE_ORDER MSB_FIRST /end CHARACTERISTIC
/begin RECORD_LAYOUT RL_ATVC_ICESTOPSOC FNC_VALUES 1 UBYTE COLUMN_DIR DIRECT /end RECORD_LAYOUT
/begin COMPU_METHOD CU_ATVC_ICESTOPSOC "Conversion method for atvc_IceStopSOC" RAT_FUNC "%10.0" "%" COEFFS 0.000000 1.000000 0.000000 0.000000 0.000000 1.000000 /end COMPU_METHOD
/* Scalar calibration for DDE 'atvc_OverrideFan'. */
/begin CHARACTERISTIC atvc_OverrideFan "Fan  Override" VALUE 0x1000e97 RL_ATVC_OVERRIDEFAN 100.000000 CU_ATVC_OVERRIDEFAN 0.000000 100.000000 BYTE_ORDER MSB_FIRST /end CHARACTERISTIC
/begin RECORD_LAYOUT RL_ATVC_OVERRIDEFAN FNC_VALUES 1 UBYTE COLUMN_DIR DIRECT /end RECORD_LAYOUT
/begin COMPU_METHOD CU_ATVC_OVERRIDEFAN "Conversion method for atvc_OverrideFan" RAT_FUNC "%10.0" "one" COEFFS 0.000000 1.000000 0.000000 0.000000 0.000000 1.000000 /end COMPU_METHOD
/* Scalar calibration for DDE 'atvc_OverridePumpA'. */
/begin CHARACTERISTIC atvc_OverridePumpA "Pump A Override" VALUE 0x1000e87 RL_ATVC_OVERRIDEPUMPA 1.000000 CU_ATVC_OVERRIDEPUMPA 0.000000 1.000000 BYTE_ORDER MSB_FIRST /end CHARACTERISTIC
/begin RECORD_LAYOUT RL_ATVC_OVERRIDEPUMPA FNC_VALUES 1 UBYTE COLUMN_DIR DIRECT /end RECORD_LAYOUT
/begin COMPU_METHOD CU_ATVC_OVERRIDEPUMPA "Conversion method for atvc_OverridePumpA" RAT_FUNC "%10.0" "one" COEFFS 0.000000 1.000000 0.000000 0.000000 0.000000 1.000000 /end COMPU_METHOD
/* Scalar calibration for DDE 'atvc_OverridePumpB'. */
/begin CHARACTERISTIC atvc_OverridePumpB "Pump B Override" VALUE 0x1000e88 RL_ATVC_OVERRIDEPUMPB 1.000000 CU_ATVC_OVERRIDEPUMPB 0.000000 1.000000 BYTE_ORDER MSB_FIRST /end CHARACTERISTIC
/begin RECORD_LAYOUT RL_ATVC_OVERRIDEPUMPB FNC_VALUES 1 UBYTE COLUMN_DIR DIRECT /end RECORD_LAYOUT
/begin COMPU_METHOD CU_ATVC_OVERRIDEPUMPB "Conversion method for atvc_OverridePumpB" RAT_FUNC "%10.0" "one" COEFFS 0.000000 1.000000 0.000000 0.000000 0.000000 1.000000 /end COMPU_METHOD
/* Scalar calibration for DDE 'atvc_StartThrottleIce'. */
/begin CHARACTERISTIC atvc_StartThrottleIce "ICE StartUp GENERATOR Throttle Val [0.1%]" VALUE 0x1000e5e RL_ATVC_STARTTHROTTLEICE 900.000000 CU_ATVC_STARTTHROTTLEICE 100.000000 1000.000000 BYTE_ORDER MSB_FIRST /end CHARACTERISTIC
/begin RECORD_LAYOUT RL_ATVC_STARTTHROTTLEICE FNC_VALUES 1 UWORD COLUMN_DIR DIRECT /end RECORD_LAYOUT
/begin COMPU_METHOD CU_ATVC_STARTTHROTTLEICE "Conversion method for atvc_StartThrottleIce" RAT_FUNC "%10.0" "one" COEFFS 0.000000 1.000000 0.000000 0.000000 0.000000 1.000000 /end COMPU_METHOD
/* Scalar calibration for DDE 'atvc_an_in_sel_his'. */
/begin CHARACTERISTIC atvc_an_in_sel_his "Analog Selectors Histeresis  [V]" VALUE 0x1002430 RL_ATVC_AN_IN_SEL_HIS 1.000000 CU_ATVC_AN_IN_SEL_HIS 0.000000 1.000000 BYTE_ORDER MSB_FIRST /end CHARACTERISTIC
/begin RECORD_LAYOUT RL_ATVC_AN_IN_SEL_HIS FNC_VALUES 1 FLOAT32_IEEE COLUMN_DIR DIRECT /end RECORD_LAYOUT
/begin COMPU_METHOD CU_ATVC_AN_IN_SEL_HIS "Conversion method for atvc_an_in_sel_his" RAT_FUNC "%10.4" "one" COEFFS 0.000000 1.000000 0.000000 0.000000 0.000000 1.000000 /end COMPU_METHOD
/* Scalar calibration for DDE 'atvc_an_in_sel_th'. */
/begin CHARACTERISTIC atvc_an_in_sel_th "Analog Selectors Threashold Pedal On Trheashold [V]" VALUE 0x1002434 RL_ATVC_AN_IN_SEL_TH 3.000000 CU_ATVC_AN_IN_SEL_TH 1.000000 4.000000 BYTE_ORDER MSB_FIRST /end CHARACTERISTIC
/begin RECORD_LAYOUT RL_ATVC_AN_IN_SEL_TH FNC_VALUES 1 FLOAT32_IEEE COLUMN_DIR DIRECT /end RECORD_LAYOUT
/begin COMPU_METHOD CU_ATVC_AN_IN_SEL_TH "Conversion method for atvc_an_in_sel_th" RAT_FUNC "%10.4" "one" COEFFS 0.000000 1.000000 0.000000 0.000000 0.000000 1.000000 /end COMPU_METHOD
/* Scalar calibration for DDE 'atvc_brake2epedal_split_0'. */
/begin CHARACTERISTIC atvc_brake2epedal_split_0 "brake to epedal quota (200 -> total brake 20% epedal 80% brake pedal) [0.1%]" VALUE 0x1000e50 RL_ATVC_BRAKE2EPEDAL_SPLIT_0 1000.000000 CU_ATVC_BRAKE2EPEDAL_SPLIT_0 0.000000 1000.000000 BYTE_ORDER MSB_FIRST /end CHARACTERISTIC
/begin RECORD_LAYOUT RL_ATVC_BRAKE2EPEDAL_SPLIT_0 FNC_VALUES 1 SWORD COLUMN_DIR DIRECT /end RECORD_LAYOUT
/begin COMPU_METHOD CU_ATVC_BRAKE2EPEDAL_SPLIT_0 "Conversion method for atvc_brake2epedal_split_0" RAT_FUNC "%10.0" "one" COEFFS 0.000000 1.000000 0.000000 0.000000 0.000000 1.000000 /end COMPU_METHOD
/* Scalar calibration for DDE 'atvc_brake2epedal_split_1'. */
/begin CHARACTERISTIC atvc_brake2epedal_split_1 "brake to epedal quota (200 -> total brake 20% epedal 80% brake pedal) [0.1%]" VALUE 0x1000e52 RL_ATVC_BRAKE2EPEDAL_SPLIT_1 1000.000000 CU_ATVC_BRAKE2EPEDAL_SPLIT_1 0.000000 1000.000000 BYTE_ORDER MSB_FIRST /end CHARACTERISTIC
/begin RECORD_LAYOUT RL_ATVC_BRAKE2EPEDAL_SPLIT_1 FNC_VALUES 1 SWORD COLUMN_DIR DIRECT /end RECORD_LAYOUT
/begin COMPU_METHOD CU_ATVC_BRAKE2EPEDAL_SPLIT_1 "Conversion method for atvc_brake2epedal_split_1" RAT_FUNC "%10.0" "one" COEFFS 0.000000 1.000000 0.000000 0.000000 0.000000 1.000000 /end COMPU_METHOD
/* Scalar calibration for DDE 'atvc_brake2epedal_split_2'. */
/begin CHARACTERISTIC atvc_brake2epedal_split_2 "brake to epedal quota (200 -> total brake 20% epedal 80% brake pedal) [0.1%]" VALUE 0x1000e54 RL_ATVC_BRAKE2EPEDAL_SPLIT_2 1000.000000 CU_ATVC_BRAKE2EPEDAL_SPLIT_2 0.000000 1000.000000 BYTE_ORDER MSB_FIRST /end CHARACTERISTIC
/begin RECORD_LAYOUT RL_ATVC_BRAKE2EPEDAL_SPLIT_2 FNC_VALUES 1 SWORD COLUMN_DIR DIRECT /end RECORD_LAYOUT
/begin COMPU_METHOD CU_ATVC_BRAKE2EPEDAL_SPLIT_2 "Conversion method for atvc_brake2epedal_split_2" RAT_FUNC "%10.0" "one" COEFFS 0.000000 1.000000 0.000000 0.000000 0.000000 1.000000 /end COMPU_METHOD
/* Scalar calibration for DDE 'atvc_brake2epedal_split_3'. */
/begin CHARACTERISTIC atvc_brake2epedal_split_3 "brake to epedal quota (200 -> total brake 20% epedal 80% brake pedal) [0.1%]" VALUE 0x1000e56 RL_ATVC_BRAKE2EPEDAL_SPLIT_3 1000.000000 CU_ATVC_BRAKE2EPEDAL_SPLIT_3 0.000000 1000.000000 BYTE_ORDER MSB_FIRST /end CHARACTERISTIC
/begin RECORD_LAYOUT RL_ATVC_BRAKE2EPEDAL_SPLIT_3 FNC_VALUES 1 SWORD COLUMN_DIR DIRECT /end RECORD_LAYOUT
/begin COMPU_METHOD CU_ATVC_BRAKE2EPEDAL_SPLIT_3 "Conversion method for atvc_brake2epedal_split_3" RAT_FUNC "%10.0" "one" COEFFS 0.000000 1.000000 0.000000 0.000000 0.000000 1.000000 /end COMPU_METHOD
/* Scalar calibration for DDE 'atvc_brakePedalHis'. */
/begin CHARACTERISTIC atvc_brakePedalHis "Brake Pedal Histeresis [0.1%]" VALUE 0x1002438 RL_ATVC_BRAKEPEDALHIS 25.000000 CU_ATVC_BRAKEPEDALHIS 0.000000 25.000000 BYTE_ORDER MSB_FIRST /end CHARACTERISTIC
/begin RECORD_LAYOUT RL_ATVC_BRAKEPEDALHIS FNC_VALUES 1 UWORD COLUMN_DIR DIRECT /end RECORD_LAYOUT
/begin COMPU_METHOD CU_ATVC_BRAKEPEDALHIS "Conversion method for atvc_brakePedalHis" RAT_FUNC "%10.0" "one" COEFFS 0.000000 1.000000 0.000000 0.000000 0.000000 1.000000 /end COMPU_METHOD
/* Scalar calibration for DDE 'atvc_brakePedalOn'. */
/begin CHARACTERISTIC atvc_brakePedalOn "Brake Pedal On Trheashold [0.1%]" VALUE 0x100243a RL_ATVC_BRAKEPEDALON 950.000000 CU_ATVC_BRAKEPEDALON 50.000000 1000.000000 BYTE_ORDER MSB_FIRST /end CHARACTERISTIC
/begin RECORD_LAYOUT RL_ATVC_BRAKEPEDALON FNC_VALUES 1 UWORD COLUMN_DIR DIRECT /end RECORD_LAYOUT
/begin COMPU_METHOD CU_ATVC_BRAKEPEDALON "Conversion method for atvc_brakePedalOn" RAT_FUNC "%10.0" "one" COEFFS 0.000000 1.000000 0.000000 0.000000 0.000000 1.000000 /end COMPU_METHOD
/* Scalar calibration for DDE 'atvc_brake_pedal_gain'. */
/begin CHARACTERISTIC atvc_brake_pedal_gain "Brake pedal gain (for eBrake calculation)" VALUE 0x1002444 RL_ATVC_BRAKE_PEDAL_GAIN 3.500000 CU_ATVC_BRAKE_PEDAL_GAIN 0.500000 4.000000 BYTE_ORDER MSB_FIRST /end CHARACTERISTIC
/begin RECORD_LAYOUT RL_ATVC_BRAKE_PEDAL_GAIN FNC_VALUES 1 FLOAT32_IEEE COLUMN_DIR DIRECT /end RECORD_LAYOUT
/begin COMPU_METHOD CU_ATVC_BRAKE_PEDAL_GAIN "Conversion method for atvc_brake_pedal_gain" RAT_FUNC "%10.4" "one" COEFFS 0.000000 1.000000 0.000000 0.000000 0.000000 1.000000 /end COMPU_METHOD
/* Scalar calibration for DDE 'atvc_brake_pedal_zero'. */
/begin CHARACTERISTIC atvc_brake_pedal_zero "Brake pedal zero threashold (V)" VALUE 0x1002448 RL_ATVC_BRAKE_PEDAL_ZERO 1.045000 CU_ATVC_BRAKE_PEDAL_ZERO 0.455000 1.500000 BYTE_ORDER MSB_FIRST /end CHARACTERISTIC
/begin RECORD_LAYOUT RL_ATVC_BRAKE_PEDAL_ZERO FNC_VALUES 1 FLOAT32_IEEE COLUMN_DIR DIRECT /end RECORD_LAYOUT
/begin COMPU_METHOD CU_ATVC_BRAKE_PEDAL_ZERO "Conversion method for atvc_brake_pedal_zero" RAT_FUNC "%10.4" "one" COEFFS 0.000000 1.000000 0.000000 0.000000 0.000000 1.000000 /end COMPU_METHOD
/* Scalar calibration for DDE 'atvc_cell_ot'. */
/begin CHARACTERISTIC atvc_cell_ot "Cell Overtemp [°C]" VALUE 0x1000e8f RL_ATVC_CELL_OT 30.000000 CU_ATVC_CELL_OT 40.000000 70.000000 BYTE_ORDER MSB_FIRST /end CHARACTERISTIC
/begin RECORD_LAYOUT RL_ATVC_CELL_OT FNC_VALUES 1 SBYTE COLUMN_DIR DIRECT /end RECORD_LAYOUT
/begin COMPU_METHOD CU_ATVC_CELL_OT "Conversion method for atvc_cell_ot" RAT_FUNC "%10.0" "mV" COEFFS 0.000000 1.000000 0.000000 0.000000 0.000000 1.000000 /end COMPU_METHOD
/* Scalar calibration for DDE 'atvc_cell_ov'. */
/begin CHARACTERISTIC atvc_cell_ov "Cell Overvoltage [mV]" VALUE 0x1000e60 RL_ATVC_CELL_OV 650.000000 CU_ATVC_CELL_OV 3600.000000 4250.000000 BYTE_ORDER MSB_FIRST /end CHARACTERISTIC
/begin RECORD_LAYOUT RL_ATVC_CELL_OV FNC_VALUES 1 UWORD COLUMN_DIR DIRECT /end RECORD_LAYOUT
/begin COMPU_METHOD CU_ATVC_CELL_OV "Conversion method for atvc_cell_ov" RAT_FUNC "%10.0" "mV" COEFFS 0.000000 1.000000 0.000000 0.000000 0.000000 1.000000 /end COMPU_METHOD
/* Scalar calibration for DDE 'atvc_cell_ut'. */
/begin CHARACTERISTIC atvc_cell_ut "Cell Undertemp [°C]" VALUE 0x1000e90 RL_ATVC_CELL_UT 60.000000 CU_ATVC_CELL_UT -40.000000 20.000000 BYTE_ORDER MSB_FIRST /end CHARACTERISTIC
/begin RECORD_LAYOUT RL_ATVC_CELL_UT FNC_VALUES 1 SBYTE COLUMN_DIR DIRECT /end RECORD_LAYOUT
/begin COMPU_METHOD CU_ATVC_CELL_UT "Conversion method for atvc_cell_ut" RAT_FUNC "%10.0" "mV" COEFFS 0.000000 1.000000 0.000000 0.000000 0.000000 1.000000 /end COMPU_METHOD
/* Scalar calibration for DDE 'atvc_cell_uv'. */
/begin CHARACTERISTIC atvc_cell_uv "Cell Undervoltage [mV]" VALUE 0x1000e62 RL_ATVC_CELL_UV 1100.000000 CU_ATVC_CELL_UV 2500.000000 3600.000000 BYTE_ORDER MSB_FIRST /end CHARACTERISTIC
/begin RECORD_LAYOUT RL_ATVC_CELL_UV FNC_VALUES 1 UWORD COLUMN_DIR DIRECT /end RECORD_LAYOUT
/begin COMPU_METHOD CU_ATVC_CELL_UV "Conversion method for atvc_cell_uv" RAT_FUNC "%10.0" "mV" COEFFS 0.000000 1.000000 0.000000 0.000000 0.000000 1.000000 /end COMPU_METHOD
/* Scalar calibration for DDE 'atvc_chg_complete'. */
/begin CHARACTERISTIC atvc_chg_complete "Cell Charge Complete Voltage [mV]" VALUE 0x1000e64 RL_ATVC_CHG_COMPLETE 550.000000 CU_ATVC_CHG_COMPLETE 3700.000000 4250.000000 BYTE_ORDER MSB_FIRST /end CHARACTERISTIC
/begin RECORD_LAYOUT RL_ATVC_CHG_COMPLETE FNC_VALUES 1 UWORD COLUMN_DIR DIRECT /end RECORD_LAYOUT
/begin COMPU_METHOD CU_ATVC_CHG_COMPLETE "Conversion method for atvc_chg_complete" RAT_FUNC "%10.0" "mV" COEFFS 0.000000 1.000000 0.000000 0.000000 0.000000 1.000000 /end COMPU_METHOD
/* Scalar calibration for DDE 'atvc_chg_target_v'. */
/begin CHARACTERISTIC atvc_chg_target_v "Cell Chg Target [mV]" VALUE 0x1000e66 RL_ATVC_CHG_TARGET_V 1200.000000 CU_ATVC_CHG_TARGET_V 3000.000000 4200.000000 BYTE_ORDER MSB_FIRST /end CHARACTERISTIC
/begin RECORD_LAYOUT RL_ATVC_CHG_TARGET_V FNC_VALUES 1 UWORD COLUMN_DIR DIRECT /end RECORD_LAYOUT
/begin COMPU_METHOD CU_ATVC_CHG_TARGET_V "Conversion method for atvc_chg_target_v" RAT_FUNC "%10.0" "mV" COEFFS 0.000000 1.000000 0.000000 0.000000 0.000000 1.000000 /end COMPU_METHOD
/* Scalar calibration for DDE 'atvc_dcMinFan'. */
/begin CHARACTERISTIC atvc_dcMinFan "Minimum Fan Speed [%]" VALUE 0x1000e98 RL_ATVC_DCMINFAN 100.000000 CU_ATVC_DCMINFAN 0.000000 100.000000 BYTE_ORDER MSB_FIRST /end CHARACTERISTIC
/begin RECORD_LAYOUT RL_ATVC_DCMINFAN FNC_VALUES 1 UBYTE COLUMN_DIR DIRECT /end RECORD_LAYOUT
/begin COMPU_METHOD CU_ATVC_DCMINFAN "Conversion method for atvc_dcMinFan" RAT_FUNC "%10.0" "one" COEFFS 0.000000 1.000000 0.000000 0.000000 0.000000 1.000000 /end COMPU_METHOD
/* Scalar calibration for DDE 'atvc_fmot_run_timer'. */
/begin CHARACTERISTIC atvc_fmot_run_timer "ICE Run Timer [sec]" VALUE 0x1002568 RL_ATVC_FMOT_RUN_TIMER 2000000000.000000 CU_ATVC_FMOT_RUN_TIMER 0.000000 2000000000.000000 BYTE_ORDER MSB_FIRST /end CHARACTERISTIC
/begin RECORD_LAYOUT RL_ATVC_FMOT_RUN_TIMER FNC_VALUES 1 FLOAT32_IEEE COLUMN_DIR DIRECT /end RECORD_LAYOUT
/begin COMPU_METHOD CU_ATVC_FMOT_RUN_TIMER "Conversion method for atvc_fmot_run_timer" RAT_FUNC "%10.4" "m" COEFFS 0.000000 1.000000 0.000000 0.000000 0.000000 1.000000 /end COMPU_METHOD
/* Scalar calibration for DDE 'atvc_fmot_run_timer_reset'. */
/begin CHARACTERISTIC atvc_fmot_run_timer_reset "ICE Run Timer reset" VALUE 0x1000e89 RL_ATVC_FMOT_RUN_TIMER_RESET 1.000000 CU_ATVC_FMOT_RUN_TIMER_RESET 0.000000 1.000000 BYTE_ORDER MSB_FIRST /end CHARACTERISTIC
/begin RECORD_LAYOUT RL_ATVC_FMOT_RUN_TIMER_RESET FNC_VALUES 1 UBYTE COLUMN_DIR DIRECT /end RECORD_LAYOUT
/begin COMPU_METHOD CU_ATVC_FMOT_RUN_TIMER_RESET "Conversion method for atvc_fmot_run_timer_reset" RAT_FUNC "%10.0" "one" COEFFS 0.000000 1.000000 0.000000 0.000000 0.000000 1.000000 /end COMPU_METHOD
/* Scalar calibration for DDE 'atvc_footBrakeIce'. */
/begin CHARACTERISTIC atvc_footBrakeIce "ICE RegTorque Val [0.1%]" VALUE 0x1000e68 RL_ATVC_FOOTBRAKEICE 990.000000 CU_ATVC_FOOTBRAKEICE 10.000000 1000.000000 BYTE_ORDER MSB_FIRST /end CHARACTERISTIC
/begin RECORD_LAYOUT RL_ATVC_FOOTBRAKEICE FNC_VALUES 1 UWORD COLUMN_DIR DIRECT /end RECORD_LAYOUT
/begin COMPU_METHOD CU_ATVC_FOOTBRAKEICE "Conversion method for atvc_footBrakeIce" RAT_FUNC "%10.0" "one" COEFFS 0.000000 1.000000 0.000000 0.000000 0.000000 1.000000 /end COMPU_METHOD
/* Scalar calibration for DDE 'atvc_footBrakeWarmUp'. */
/begin CHARACTERISTIC atvc_footBrakeWarmUp "ICE RegTorque Val [0.1%]" VALUE 0x1000e6a RL_ATVC_FOOTBRAKEWARMUP 1000.000000 CU_ATVC_FOOTBRAKEWARMUP 0.000000 1000.000000 BYTE_ORDER MSB_FIRST /end CHARACTERISTIC
/begin RECORD_LAYOUT RL_ATVC_FOOTBRAKEWARMUP FNC_VALUES 1 UWORD COLUMN_DIR DIRECT /end RECORD_LAYOUT
/begin COMPU_METHOD CU_ATVC_FOOTBRAKEWARMUP "Conversion method for atvc_footBrakeWarmUp" RAT_FUNC "%10.0" "one" COEFFS 0.000000 1.000000 0.000000 0.000000 0.000000 1.000000 /end COMPU_METHOD
/* Scalar calibration for DDE 'atvc_force_inv_preop'. */
/begin CHARACTERISTIC atvc_force_inv_preop "Force Inverter Preop for config" VALUE 0x1002424 RL_ATVC_FORCE_INV_PREOP 1.000000 CU_ATVC_FORCE_INV_PREOP 0.000000 1.000000 BYTE_ORDER MSB_FIRST /end CHARACTERISTIC
/begin RECORD_LAYOUT RL_ATVC_FORCE_INV_PREOP FNC_VALUES 1 UBYTE COLUMN_DIR DIRECT /end RECORD_LAYOUT
/begin COMPU_METHOD CU_ATVC_FORCE_INV_PREOP "Conversion method for atvc_force_inv_preop" RAT_FUNC "%10.0" "one" COEFFS 0.000000 1.000000 0.000000 0.000000 0.000000 1.000000 /end COMPU_METHOD
/* Scalar calibration for DDE 'atvc_fs1_throttle_coherency'. */
/begin CHARACTERISTIC atvc_fs1_throttle_coherency "Max fs1 on [0.1%]" VALUE 0x1000e6c RL_ATVC_FS1_THROTTLE_COHERENCY 990.000000 CU_ATVC_FS1_THROTTLE_COHERENCY 10.000000 1000.000000 BYTE_ORDER MSB_FIRST /end CHARACTERISTIC
/begin RECORD_LAYOUT RL_ATVC_FS1_THROTTLE_COHERENCY FNC_VALUES 1 UWORD COLUMN_DIR DIRECT /end RECORD_LAYOUT
/begin COMPU_METHOD CU_ATVC_FS1_THROTTLE_COHERENCY "Conversion method for atvc_fs1_throttle_coherency" RAT_FUNC "%10.0" "one" COEFFS 0.000000 1.000000 0.000000 0.000000 0.000000 1.000000 /end COMPU_METHOD
/* Scalar calibration for DDE 'atvc_gear_ratio'. */
/begin CHARACTERISTIC atvc_gear_ratio "Primary Gear Ratio []" VALUE 0x100244c RL_ATVC_GEAR_RATIO 4.000000 CU_ATVC_GEAR_RATIO 3.000000 7.000000 BYTE_ORDER MSB_FIRST /end CHARACTERISTIC
/begin RECORD_LAYOUT RL_ATVC_GEAR_RATIO FNC_VALUES 1 FLOAT32_IEEE COLUMN_DIR DIRECT /end RECORD_LAYOUT
/begin COMPU_METHOD CU_ATVC_GEAR_RATIO "Conversion method for atvc_gear_ratio" RAT_FUNC "%10.4" "one" COEFFS 0.000000 1.000000 0.000000 0.000000 0.000000 1.000000 /end COMPU_METHOD
/* Scalar calibration for DDE 'atvc_gen_PWM_Override'. */
/begin CHARACTERISTIC atvc_gen_PWM_Override "GEN TEST PWM RPM CONTROL OVERRIDE" VALUE 0x1000e8a RL_ATVC_GEN_PWM_OVERRIDE 1.000000 CU_ATVC_GEN_PWM_OVERRIDE 0.000000 1.000000 BYTE_ORDER MSB_FIRST /end CHARACTERISTIC
/begin RECORD_LAYOUT RL_ATVC_GEN_PWM_OVERRIDE FNC_VALUES 1 UBYTE COLUMN_DIR DIRECT /end RECORD_LAYOUT
/begin COMPU_METHOD CU_ATVC_GEN_PWM_OVERRIDE "Conversion method for atvc_gen_PWM_Override" RAT_FUNC "%10.0" "one" COEFFS 0.000000 1.000000 0.000000 0.000000 0.000000 1.000000 /end COMPU_METHOD
/* Scalar calibration for DDE 'atvc_gen_TEST_PWM'. */
/begin CHARACTERISTIC atvc_gen_TEST_PWM "GEN TEST PWM RPM CONTROL" VALUE 0x1002458 RL_ATVC_GEN_TEST_PWM 10.000000 CU_ATVC_GEN_TEST_PWM 0.000000 10.000000 BYTE_ORDER MSB_FIRST /end CHARACTERISTIC
/begin RECORD_LAYOUT RL_ATVC_GEN_TEST_PWM FNC_VALUES 1 FLOAT32_IEEE COLUMN_DIR DIRECT /end RECORD_LAYOUT
/begin COMPU_METHOD CU_ATVC_GEN_TEST_PWM "Conversion method for atvc_gen_TEST_PWM" RAT_FUNC "%10.4" "one" COEFFS 0.000000 1.000000 0.000000 0.000000 0.000000 1.000000 /end COMPU_METHOD
/* Scalar calibration for DDE 'atvc_gen_ramp_up'. */
/begin CHARACTERISTIC atvc_gen_ramp_up "ICE rampup torque [RPM]" VALUE 0x1000e6e RL_ATVC_GEN_RAMP_UP 29900.000000 CU_ATVC_GEN_RAMP_UP 100.000000 30000.000000 BYTE_ORDER MSB_FIRST /end CHARACTERISTIC
/begin RECORD_LAYOUT RL_ATVC_GEN_RAMP_UP FNC_VALUES 1 UWORD COLUMN_DIR DIRECT /end RECORD_LAYOUT
/begin COMPU_METHOD CU_ATVC_GEN_RAMP_UP "Conversion method for atvc_gen_ramp_up" RAT_FUNC "%10.0" "one" COEFFS 0.000000 1.000000 0.000000 0.000000 0.000000 1.000000 /end COMPU_METHOD
/* Scalar calibration for DDE 'atvc_gen_start_PID_KI'. */
/begin CHARACTERISTIC atvc_gen_start_PID_KI "ICE Start PID KI" VALUE 0x1000e3c RL_ATVC_GEN_START_PID_KI 9.999000 CU_ATVC_GEN_START_PID_KI 0.001000 10.000000 BYTE_ORDER MSB_FIRST /end CHARACTERISTIC
/begin RECORD_LAYOUT RL_ATVC_GEN_START_PID_KI FNC_VALUES 1 FLOAT32_IEEE COLUMN_DIR DIRECT /end RECORD_LAYOUT
/begin COMPU_METHOD CU_ATVC_GEN_START_PID_KI "Conversion method for atvc_gen_start_PID_KI" RAT_FUNC "%10.4" "one" COEFFS 0.000000 1.000000 0.000000 0.000000 0.000000 1.000000 /end COMPU_METHOD
/* Scalar calibration for DDE 'atvc_gen_start_PID_KP'. */
/begin CHARACTERISTIC atvc_gen_start_PID_KP "ICE Start PID KP" VALUE 0x1000e40 RL_ATVC_GEN_START_PID_KP 9.999000 CU_ATVC_GEN_START_PID_KP 0.001000 10.000000 BYTE_ORDER MSB_FIRST /end CHARACTERISTIC
/begin RECORD_LAYOUT RL_ATVC_GEN_START_PID_KP FNC_VALUES 1 FLOAT32_IEEE COLUMN_DIR DIRECT /end RECORD_LAYOUT
/begin COMPU_METHOD CU_ATVC_GEN_START_PID_KP "Conversion method for atvc_gen_start_PID_KP" RAT_FUNC "%10.4" "one" COEFFS 0.000000 1.000000 0.000000 0.000000 0.000000 1.000000 /end COMPU_METHOD
/* Scalar calibration for DDE 'atvc_gen_start_rpm'. */
/begin CHARACTERISTIC atvc_gen_start_rpm "ICE start speed [RPM]" VALUE 0x1000e70 RL_ATVC_GEN_START_RPM 2300.000000 CU_ATVC_GEN_START_RPM 700.000000 3000.000000 BYTE_ORDER MSB_FIRST /end CHARACTERISTIC
/begin RECORD_LAYOUT RL_ATVC_GEN_START_RPM FNC_VALUES 1 UWORD COLUMN_DIR DIRECT /end RECORD_LAYOUT
/begin COMPU_METHOD CU_ATVC_GEN_START_RPM "Conversion method for atvc_gen_start_rpm" RAT_FUNC "%10.0" "one" COEFFS 0.000000 1.000000 0.000000 0.000000 0.000000 1.000000 /end COMPU_METHOD
/* Scalar calibration for DDE 'atvc_ice_run_timer'. */
/begin CHARACTERISTIC atvc_ice_run_timer "ICE Run Timer [sec]" VALUE 0x100256c RL_ATVC_ICE_RUN_TIMER 2000000000.000000 CU_ATVC_ICE_RUN_TIMER 0.000000 2000000000.000000 BYTE_ORDER MSB_FIRST /end CHARACTERISTIC
/begin RECORD_LAYOUT RL_ATVC_ICE_RUN_TIMER FNC_VALUES 1 FLOAT32_IEEE COLUMN_DIR DIRECT /end RECORD_LAYOUT
/begin COMPU_METHOD CU_ATVC_ICE_RUN_TIMER "Conversion method for atvc_ice_run_timer" RAT_FUNC "%10.4" "m" COEFFS 0.000000 1.000000 0.000000 0.000000 0.000000 1.000000 /end COMPU_METHOD
/* Scalar calibration for DDE 'atvc_ice_run_timer_reset'. */
/begin CHARACTERISTIC atvc_ice_run_timer_reset "ICE Run Timer reset" VALUE 0x1000e8b RL_ATVC_ICE_RUN_TIMER_RESET 1.000000 CU_ATVC_ICE_RUN_TIMER_RESET 0.000000 1.000000 BYTE_ORDER MSB_FIRST /end CHARACTERISTIC
/begin RECORD_LAYOUT RL_ATVC_ICE_RUN_TIMER_RESET FNC_VALUES 1 UBYTE COLUMN_DIR DIRECT /end RECORD_LAYOUT
/begin COMPU_METHOD CU_ATVC_ICE_RUN_TIMER_RESET "Conversion method for atvc_ice_run_timer_reset" RAT_FUNC "%10.0" "one" COEFFS 0.000000 1.000000 0.000000 0.000000 0.000000 1.000000 /end COMPU_METHOD
/* Scalar calibration for DDE 'atvc_maxDischCurr'. */
/begin CHARACTERISTIC atvc_maxDischCurr "Max Outbound current [A]" VALUE 0x100243c RL_ATVC_MAXDISCHCURR 870.000000 CU_ATVC_MAXDISCHCURR 30.000000 900.000000 BYTE_ORDER MSB_FIRST /end CHARACTERISTIC
/begin RECORD_LAYOUT RL_ATVC_MAXDISCHCURR FNC_VALUES 1 UWORD COLUMN_DIR DIRECT /end RECORD_LAYOUT
/begin COMPU_METHOD CU_ATVC_MAXDISCHCURR "Conversion method for atvc_maxDischCurr" RAT_FUNC "%10.0" "one" COEFFS 0.000000 1.000000 0.000000 0.000000 0.000000 1.000000 /end COMPU_METHOD
/* Scalar calibration for DDE 'atvc_maxRegenCurr'. */
/begin CHARACTERISTIC atvc_maxRegenCurr "Max Inbound current [A]" VALUE 0x1000e72 RL_ATVC_MAXREGENCURR 270.000000 CU_ATVC_MAXREGENCURR 30.000000 300.000000 BYTE_ORDER MSB_FIRST /end CHARACTERISTIC
/begin RECORD_LAYOUT RL_ATVC_MAXREGENCURR FNC_VALUES 1 UWORD COLUMN_DIR DIRECT /end RECORD_LAYOUT
/begin COMPU_METHOD CU_ATVC_MAXREGENCURR "Conversion method for atvc_maxRegenCurr" RAT_FUNC "%10.0" "one" COEFFS 0.000000 1.000000 0.000000 0.000000 0.000000 1.000000 /end COMPU_METHOD
/* Scalar calibration for DDE 'atvc_maxTempInv'. */
/begin CHARACTERISTIC atvc_maxTempInv "Max Inverter Temp" VALUE 0x1002425 RL_ATVC_MAXTEMPINV 190.000000 CU_ATVC_MAXTEMPINV 10.000000 200.000000 BYTE_ORDER MSB_FIRST /end CHARACTERISTIC
/begin RECORD_LAYOUT RL_ATVC_MAXTEMPINV FNC_VALUES 1 UBYTE COLUMN_DIR DIRECT /end RECORD_LAYOUT
/begin COMPU_METHOD CU_ATVC_MAXTEMPINV "Conversion method for atvc_maxTempInv" RAT_FUNC "%10.0" "degree_Celsius" COEFFS 0.000000 1.000000 0.000000 0.000000 0.000000 1.000000 /end COMPU_METHOD
/* Scalar calibration for DDE 'atvc_maxTempMotor'. */
/begin CHARACTERISTIC atvc_maxTempMotor "Max Inverter Temp" VALUE 0x1002426 RL_ATVC_MAXTEMPMOTOR 190.000000 CU_ATVC_MAXTEMPMOTOR 10.000000 200.000000 BYTE_ORDER MSB_FIRST /end CHARACTERISTIC
/begin RECORD_LAYOUT RL_ATVC_MAXTEMPMOTOR FNC_VALUES 1 UBYTE COLUMN_DIR DIRECT /end RECORD_LAYOUT
/begin COMPU_METHOD CU_ATVC_MAXTEMPMOTOR "Conversion method for atvc_maxTempMotor" RAT_FUNC "%10.0" "degree_Celsius" COEFFS 0.000000 1.000000 0.000000 0.000000 0.000000 1.000000 /end COMPU_METHOD
/* Scalar calibration for DDE 'atvc_max_footbrake_trq'. */
/begin CHARACTERISTIC atvc_max_footbrake_trq "Brake Pedal On Trheashold [0.1%]" VALUE 0x1000e74 RL_ATVC_MAX_FOOTBRAKE_TRQ 1000.000000 CU_ATVC_MAX_FOOTBRAKE_TRQ 0.000000 1000.000000 BYTE_ORDER MSB_FIRST /end CHARACTERISTIC
/begin RECORD_LAYOUT RL_ATVC_MAX_FOOTBRAKE_TRQ FNC_VALUES 1 UWORD COLUMN_DIR DIRECT /end RECORD_LAYOUT
/begin COMPU_METHOD CU_ATVC_MAX_FOOTBRAKE_TRQ "Conversion method for atvc_max_footbrake_trq" RAT_FUNC "%10.0" "one" COEFFS 0.000000 1.000000 0.000000 0.000000 0.000000 1.000000 /end COMPU_METHOD
/* Scalar calibration for DDE 'atvc_max_gen_neutral_trq'. */
/begin CHARACTERISTIC atvc_max_gen_neutral_trq "Max genertor inverter neutral braking torque [0.1%]" VALUE 0x1000e76 RL_ATVC_MAX_GEN_NEUTRAL_TRQ 1000.000000 CU_ATVC_MAX_GEN_NEUTRAL_TRQ 0.000000 1000.000000 BYTE_ORDER MSB_FIRST /end CHARACTERISTIC
/begin RECORD_LAYOUT RL_ATVC_MAX_GEN_NEUTRAL_TRQ FNC_VALUES 1 UWORD COLUMN_DIR DIRECT /end RECORD_LAYOUT
/begin COMPU_METHOD CU_ATVC_MAX_GEN_NEUTRAL_TRQ "Conversion method for atvc_max_gen_neutral_trq" RAT_FUNC "%10.0" "one" COEFFS 0.000000 1.000000 0.000000 0.000000 0.000000 1.000000 /end COMPU_METHOD
/* Scalar calibration for DDE 'atvc_max_gen_reg_trq'. */
/begin CHARACTERISTIC atvc_max_gen_reg_trq "Max genertor inverter regenertion torque [0.1%]" VALUE 0x1000e78 RL_ATVC_MAX_GEN_REG_TRQ 990.000000 CU_ATVC_MAX_GEN_REG_TRQ 10.000000 1000.000000 BYTE_ORDER MSB_FIRST /end CHARACTERISTIC
/begin RECORD_LAYOUT RL_ATVC_MAX_GEN_REG_TRQ FNC_VALUES 1 UWORD COLUMN_DIR DIRECT /end RECORD_LAYOUT
/begin COMPU_METHOD CU_ATVC_MAX_GEN_REG_TRQ "Conversion method for atvc_max_gen_reg_trq" RAT_FUNC "%10.0" "one" COEFFS 0.000000 1.000000 0.000000 0.000000 0.000000 1.000000 /end COMPU_METHOD
/* Scalar calibration for DDE 'atvc_max_gen_trq'. */
/begin CHARACTERISTIC atvc_max_gen_trq "Max generator inverter torque [0.1%]" VALUE 0x1000e7a RL_ATVC_MAX_GEN_TRQ 990.000000 CU_ATVC_MAX_GEN_TRQ 10.000000 1000.000000 BYTE_ORDER MSB_FIRST /end CHARACTERISTIC
/begin RECORD_LAYOUT RL_ATVC_MAX_GEN_TRQ FNC_VALUES 1 UWORD COLUMN_DIR DIRECT /end RECORD_LAYOUT
/begin COMPU_METHOD CU_ATVC_MAX_GEN_TRQ "Conversion method for atvc_max_gen_trq" RAT_FUNC "%10.0" "one" COEFFS 0.000000 1.000000 0.000000 0.000000 0.000000 1.000000 /end COMPU_METHOD
/* Scalar calibration for DDE 'atvc_max_neutralbrake_trq'. */
/begin CHARACTERISTIC atvc_max_neutralbrake_trq "Brake Pedal On Trheashold [0.1%]" VALUE 0x1000e7c RL_ATVC_MAX_NEUTRALBRAKE_TRQ 1000.000000 CU_ATVC_MAX_NEUTRALBRAKE_TRQ 0.000000 1000.000000 BYTE_ORDER MSB_FIRST /end CHARACTERISTIC
/begin RECORD_LAYOUT RL_ATVC_MAX_NEUTRALBRAKE_TRQ FNC_VALUES 1 UWORD COLUMN_DIR DIRECT /end RECORD_LAYOUT
/begin COMPU_METHOD CU_ATVC_MAX_NEUTRALBRAKE_TRQ "Conversion method for atvc_max_neutralbrake_trq" RAT_FUNC "%10.0" "one" COEFFS 0.000000 1.000000 0.000000 0.000000 0.000000 1.000000 /end COMPU_METHOD
/* Scalar calibration for DDE 'atvc_max_soc'. */
/begin CHARACTERISTIC atvc_max_soc "Maximum battery soc point for vehicle 100 soc [%]" VALUE 0x1000e99 RL_ATVC_MAX_SOC 40.000000 CU_ATVC_MAX_SOC 60.000000 100.000000 BYTE_ORDER MSB_FIRST /end CHARACTERISTIC
/begin RECORD_LAYOUT RL_ATVC_MAX_SOC FNC_VALUES 1 UBYTE COLUMN_DIR DIRECT /end RECORD_LAYOUT
/begin COMPU_METHOD CU_ATVC_MAX_SOC "Conversion method for atvc_max_soc" RAT_FUNC "%10.0" "%" COEFFS 0.000000 1.000000 0.000000 0.000000 0.000000 1.000000 /end COMPU_METHOD
/* Scalar calibration for DDE 'atvc_max_trq_front'. */
/begin CHARACTERISTIC atvc_max_trq_front "Max Drive Torque Front [0.1%]" VALUE 0x1000e7e RL_ATVC_MAX_TRQ_FRONT 990.000000 CU_ATVC_MAX_TRQ_FRONT 10.000000 1000.000000 BYTE_ORDER MSB_FIRST /end CHARACTERISTIC
/begin RECORD_LAYOUT RL_ATVC_MAX_TRQ_FRONT FNC_VALUES 1 UWORD COLUMN_DIR DIRECT /end RECORD_LAYOUT
/begin COMPU_METHOD CU_ATVC_MAX_TRQ_FRONT "Conversion method for atvc_max_trq_front" RAT_FUNC "%10.0" "one" COEFFS 0.000000 1.000000 0.000000 0.000000 0.000000 1.000000 /end COMPU_METHOD
/* Scalar calibration for DDE 'atvc_max_trq_rear'. */
/begin CHARACTERISTIC atvc_max_trq_rear "Max Drive Torque Front [0.1%]" VALUE 0x1000e80 RL_ATVC_MAX_TRQ_REAR 990.000000 CU_ATVC_MAX_TRQ_REAR 10.000000 1000.000000 BYTE_ORDER MSB_FIRST /end CHARACTERISTIC
/begin RECORD_LAYOUT RL_ATVC_MAX_TRQ_REAR FNC_VALUES 1 UWORD COLUMN_DIR DIRECT /end RECORD_LAYOUT
/begin COMPU_METHOD CU_ATVC_MAX_TRQ_REAR "Conversion method for atvc_max_trq_rear" RAT_FUNC "%10.0" "one" COEFFS 0.000000 1.000000 0.000000 0.000000 0.000000 1.000000 /end COMPU_METHOD
/* Scalar calibration for DDE 'atvc_minTempInv'. */
/begin CHARACTERISTIC atvc_minTempInv "Min Inverter Temp" VALUE 0x1000e9a RL_ATVC_MINTEMPINV 190.000000 CU_ATVC_MINTEMPINV 10.000000 200.000000 BYTE_ORDER MSB_FIRST /end CHARACTERISTIC
/begin RECORD_LAYOUT RL_ATVC_MINTEMPINV FNC_VALUES 1 UBYTE COLUMN_DIR DIRECT /end RECORD_LAYOUT
/begin COMPU_METHOD CU_ATVC_MINTEMPINV "Conversion method for atvc_minTempInv" RAT_FUNC "%10.0" "degree_Celsius" COEFFS 0.000000 1.000000 0.000000 0.000000 0.000000 1.000000 /end COMPU_METHOD
/* Scalar calibration for DDE 'atvc_minTempMotor'. */
/begin CHARACTERISTIC atvc_minTempMotor "Min Inverter Temp" VALUE 0x1000e9b RL_ATVC_MINTEMPMOTOR 190.000000 CU_ATVC_MINTEMPMOTOR 10.000000 200.000000 BYTE_ORDER MSB_FIRST /end CHARACTERISTIC
/begin RECORD_LAYOUT RL_ATVC_MINTEMPMOTOR FNC_VALUES 1 UBYTE COLUMN_DIR DIRECT /end RECORD_LAYOUT
/begin COMPU_METHOD CU_ATVC_MINTEMPMOTOR "Conversion method for atvc_minTempMotor" RAT_FUNC "%10.0" "degree_Celsius" COEFFS 0.000000 1.000000 0.000000 0.000000 0.000000 1.000000 /end COMPU_METHOD
/* Scalar calibration for DDE 'atvc_min_soc'. */
/begin CHARACTERISTIC atvc_min_soc "Minimum battery soc point for vehicle 0 soc [%]" VALUE 0x1002427 RL_ATVC_MIN_SOC 40.000000 CU_ATVC_MIN_SOC 0.000000 40.000000 BYTE_ORDER MSB_FIRST /end CHARACTERISTIC
/begin RECORD_LAYOUT RL_ATVC_MIN_SOC FNC_VALUES 1 UBYTE COLUMN_DIR DIRECT /end RECORD_LAYOUT
/begin COMPU_METHOD CU_ATVC_MIN_SOC "Conversion method for atvc_min_soc" RAT_FUNC "%10.0" "%" COEFFS 0.000000 1.000000 0.000000 0.000000 0.000000 1.000000 /end COMPU_METHOD
/* Scalar calibration for DDE 'atvc_odometer'. */
/begin CHARACTERISTIC atvc_odometer "Odometer [m]" VALUE 0x1002570 RL_ATVC_ODOMETER 2000000000.000000 CU_ATVC_ODOMETER 0.000000 2000000000.000000 BYTE_ORDER MSB_FIRST /end CHARACTERISTIC
/begin RECORD_LAYOUT RL_ATVC_ODOMETER FNC_VALUES 1 FLOAT32_IEEE COLUMN_DIR DIRECT /end RECORD_LAYOUT
/begin COMPU_METHOD CU_ATVC_ODOMETER "Conversion method for atvc_odometer" RAT_FUNC "%10.4" "m" COEFFS 0.000000 1.000000 0.000000 0.000000 0.000000 1.000000 /end COMPU_METHOD
/* Scalar calibration for DDE 'atvc_odometer_reset'. */
/begin CHARACTERISTIC atvc_odometer_reset "Odometer reset" VALUE 0x1000e8c RL_ATVC_ODOMETER_RESET 1.000000 CU_ATVC_ODOMETER_RESET 0.000000 1.000000 BYTE_ORDER MSB_FIRST /end CHARACTERISTIC
/begin RECORD_LAYOUT RL_ATVC_ODOMETER_RESET FNC_VALUES 1 UBYTE COLUMN_DIR DIRECT /end RECORD_LAYOUT
/begin COMPU_METHOD CU_ATVC_ODOMETER_RESET "Conversion method for atvc_odometer_reset" RAT_FUNC "%10.0" "one" COEFFS 0.000000 1.000000 0.000000 0.000000 0.000000 1.000000 /end COMPU_METHOD
/* Scalar calibration for DDE 'atvc_rmot_run_timer'. */
/begin CHARACTERISTIC atvc_rmot_run_timer "ICE Run Timer [sec]" VALUE 0x1002574 RL_ATVC_RMOT_RUN_TIMER 2000000000.000000 CU_ATVC_RMOT_RUN_TIMER 0.000000 2000000000.000000 BYTE_ORDER MSB_FIRST /end CHARACTERISTIC
/begin RECORD_LAYOUT RL_ATVC_RMOT_RUN_TIMER FNC_VALUES 1 FLOAT32_IEEE COLUMN_DIR DIRECT /end RECORD_LAYOUT
/begin COMPU_METHOD CU_ATVC_RMOT_RUN_TIMER "Conversion method for atvc_rmot_run_timer" RAT_FUNC "%10.4" "m" COEFFS 0.000000 1.000000 0.000000 0.000000 0.000000 1.000000 /end COMPU_METHOD
/* Scalar calibration for DDE 'atvc_rmot_run_timer_reset'. */
/begin CHARACTERISTIC atvc_rmot_run_timer_reset "ICE Run Timer reset" VALUE 0x1000e8d RL_ATVC_RMOT_RUN_TIMER_RESET 1.000000 CU_ATVC_RMOT_RUN_TIMER_RESET 0.000000 1.000000 BYTE_ORDER MSB_FIRST /end CHARACTERISTIC
/begin RECORD_LAYOUT RL_ATVC_RMOT_RUN_TIMER_RESET FNC_VALUES 1 UBYTE COLUMN_DIR DIRECT /end RECORD_LAYOUT
/begin COMPU_METHOD CU_ATVC_RMOT_RUN_TIMER_RESET "Conversion method for atvc_rmot_run_timer_reset" RAT_FUNC "%10.0" "one" COEFFS 0.000000 1.000000 0.000000 0.000000 0.000000 1.000000 /end COMPU_METHOD
/* Scalar calibration for DDE 'atvc_tempSwitchOffFan'. */
/begin CHARACTERISTIC atvc_tempSwitchOffFan "Fan Off Temp" VALUE 0x1000e9c RL_ATVC_TEMPSWITCHOFFFAN 90.000000 CU_ATVC_TEMPSWITCHOFFFAN 10.000000 100.000000 BYTE_ORDER MSB_FIRST /end CHARACTERISTIC
/begin RECORD_LAYOUT RL_ATVC_TEMPSWITCHOFFFAN FNC_VALUES 1 UBYTE COLUMN_DIR DIRECT /end RECORD_LAYOUT
/begin COMPU_METHOD CU_ATVC_TEMPSWITCHOFFFAN "Conversion method for atvc_tempSwitchOffFan" RAT_FUNC "%10.0" "degree_Celsius" COEFFS 0.000000 1.000000 0.000000 0.000000 0.000000 1.000000 /end COMPU_METHOD
/* Scalar calibration for DDE 'atvc_tempSwitchOnFan'. */
/begin CHARACTERISTIC atvc_tempSwitchOnFan "Fan On Temp" VALUE 0x1000e9d RL_ATVC_TEMPSWITCHONFAN 90.000000 CU_ATVC_TEMPSWITCHONFAN 10.000000 100.000000 BYTE_ORDER MSB_FIRST /end CHARACTERISTIC
/begin RECORD_LAYOUT RL_ATVC_TEMPSWITCHONFAN FNC_VALUES 1 UBYTE COLUMN_DIR DIRECT /end RECORD_LAYOUT
/begin COMPU_METHOD CU_ATVC_TEMPSWITCHONFAN "Conversion method for atvc_tempSwitchOnFan" RAT_FUNC "%10.0" "degree_Celsius" COEFFS 0.000000 1.000000 0.000000 0.000000 0.000000 1.000000 /end COMPU_METHOD
/* Scalar calibration for DDE 'atvc_throttleFull'. */
/begin CHARACTERISTIC atvc_throttleFull "High Pedal limit [0.1%]" VALUE 0x1000e82 RL_ATVC_THROTTLEFULL 300.000000 CU_ATVC_THROTTLEFULL 700.000000 1000.000000 BYTE_ORDER MSB_FIRST /end CHARACTERISTIC
/begin RECORD_LAYOUT RL_ATVC_THROTTLEFULL FNC_VALUES 1 UWORD COLUMN_DIR DIRECT /end RECORD_LAYOUT
/begin COMPU_METHOD CU_ATVC_THROTTLEFULL "Conversion method for atvc_throttleFull" RAT_FUNC "%10.0" "one" COEFFS 0.000000 1.000000 0.000000 0.000000 0.000000 1.000000 /end COMPU_METHOD
/* Scalar calibration for DDE 'atvc_throttleNeutralPoint'. */
/begin CHARACTERISTIC atvc_throttleNeutralPoint "Throttle neutral position [0.1%]" VALUE 0x1000e84 RL_ATVC_THROTTLENEUTRALPOINT 450.000000 CU_ATVC_THROTTLENEUTRALPOINT 0.000000 450.000000 BYTE_ORDER MSB_FIRST /end CHARACTERISTIC
/begin RECORD_LAYOUT RL_ATVC_THROTTLENEUTRALPOINT FNC_VALUES 1 UWORD COLUMN_DIR DIRECT /end RECORD_LAYOUT
/begin COMPU_METHOD CU_ATVC_THROTTLENEUTRALPOINT "Conversion method for atvc_throttleNeutralPoint" RAT_FUNC "%10.0" "one" COEFFS 0.000000 1.000000 0.000000 0.000000 0.000000 1.000000 /end COMPU_METHOD
/* Scalar calibration for DDE 'atvc_throttleZero'. */
/begin CHARACTERISTIC atvc_throttleZero "Low Pedal limit [0.1%]" VALUE 0x100243e RL_ATVC_THROTTLEZERO 400.000000 CU_ATVC_THROTTLEZERO 0.000000 400.000000 BYTE_ORDER MSB_FIRST /end CHARACTERISTIC
/begin RECORD_LAYOUT RL_ATVC_THROTTLEZERO FNC_VALUES 1 UWORD COLUMN_DIR DIRECT /end RECORD_LAYOUT
/begin COMPU_METHOD CU_ATVC_THROTTLEZERO "Conversion method for atvc_throttleZero" RAT_FUNC "%10.0" "one" COEFFS 0.000000 1.000000 0.000000 0.000000 0.000000 1.000000 /end COMPU_METHOD
/* Scalar calibration for DDE 'atvc_velocityLimitFwd'. */
/begin CHARACTERISTIC atvc_velocityLimitFwd "Speed Limit Forward [Km/h]" VALUE 0x1000e9e RL_ATVC_VELOCITYLIMITFWD 117.000000 CU_ATVC_VELOCITYLIMITFWD 3.000000 120.000000 BYTE_ORDER MSB_FIRST /end CHARACTERISTIC
/begin RECORD_LAYOUT RL_ATVC_VELOCITYLIMITFWD FNC_VALUES 1 UBYTE COLUMN_DIR DIRECT /end RECORD_LAYOUT
/begin COMPU_METHOD CU_ATVC_VELOCITYLIMITFWD "Conversion method for atvc_velocityLimitFwd" RAT_FUNC "%10.0" "one" COEFFS 0.000000 1.000000 0.000000 0.000000 0.000000 1.000000 /end COMPU_METHOD
/* Scalar calibration for DDE 'atvc_velocityLimitRwd'. */
/begin CHARACTERISTIC atvc_velocityLimitRwd "Speed Limit Reverse [Km/h]" VALUE 0x1000e9f RL_ATVC_VELOCITYLIMITRWD 97.000000 CU_ATVC_VELOCITYLIMITRWD 3.000000 100.000000 BYTE_ORDER MSB_FIRST /end CHARACTERISTIC
/begin RECORD_LAYOUT RL_ATVC_VELOCITYLIMITRWD FNC_VALUES 1 UBYTE COLUMN_DIR DIRECT /end RECORD_LAYOUT
/begin COMPU_METHOD CU_ATVC_VELOCITYLIMITRWD "Conversion method for atvc_velocityLimitRwd" RAT_FUNC "%10.0" "one" COEFFS 0.000000 1.000000 0.000000 0.000000 0.000000 1.000000 /end COMPU_METHOD
/* Scalar calibration for DDE 'atvc_wheel_radius'. */
/begin CHARACTERISTIC atvc_wheel_radius "Wheel Rolling Radius[m]" VALUE 0x1002440 RL_ATVC_WHEEL_RADIUS 0.100000 CU_ATVC_WHEEL_RADIUS 0.340000 0.440000 BYTE_ORDER MSB_FIRST /end CHARACTERISTIC
/begin RECORD_LAYOUT RL_ATVC_WHEEL_RADIUS FNC_VALUES 1 FLOAT32_IEEE COLUMN_DIR DIRECT /end RECORD_LAYOUT
/begin COMPU_METHOD CU_ATVC_WHEEL_RADIUS "Conversion method for atvc_wheel_radius" RAT_FUNC "%10.4" "m" COEFFS 0.000000 1.000000 0.000000 0.000000 0.000000 1.000000 /end COMPU_METHOD
/* Scalar calibration for DDE 'atvca_fmot_run_timer'. */
/begin CHARACTERISTIC atvca_fmot_run_timer "ICE Run Timer [sec]" VALUE 0x4002eb8c RL_ATVCA_FMOT_RUN_TIMER 2000000000.000000 CU_ATVCA_FMOT_RUN_TIMER 0.000000 2000000000.000000 BYTE_ORDER MSB_FIRST /end CHARACTERISTIC
/begin RECORD_LAYOUT RL_ATVCA_FMOT_RUN_TIMER FNC_VALUES 1 FLOAT32_IEEE COLUMN_DIR DIRECT /end RECORD_LAYOUT
/begin COMPU_METHOD CU_ATVCA_FMOT_RUN_TIMER "Conversion method for atvca_fmot_run_timer" RAT_FUNC "%10.4" "m" COEFFS 0.000000 1.000000 0.000000 0.000000 0.000000 1.000000 /end COMPU_METHOD
/* Scalar calibration for DDE 'atvca_ice_run_timer'. */
/begin CHARACTERISTIC atvca_ice_run_timer "ICE Run Timer [sec]" VALUE 0x4002eb90 RL_ATVCA_ICE_RUN_TIMER 2000000000.000000 CU_ATVCA_ICE_RUN_TIMER 0.000000 2000000000.000000 BYTE_ORDER MSB_FIRST /end CHARACTERISTIC
/begin RECORD_LAYOUT RL_ATVCA_ICE_RUN_TIMER FNC_VALUES 1 FLOAT32_IEEE COLUMN_DIR DIRECT /end RECORD_LAYOUT
/begin COMPU_METHOD CU_ATVCA_ICE_RUN_TIMER "Conversion method for atvca_ice_run_timer" RAT_FUNC "%10.4" "m" COEFFS 0.000000 1.000000 0.000000 0.000000 0.000000 1.000000 /end COMPU_METHOD
/* Scalar calibration for DDE 'atvca_odometer'. */
/begin CHARACTERISTIC atvca_odometer "Odometer [m]" VALUE 0x4002eb94 RL_ATVCA_ODOMETER 2000000000.000000 CU_ATVCA_ODOMETER 0.000000 2000000000.000000 BYTE_ORDER MSB_FIRST /end CHARACTERISTIC
/begin RECORD_LAYOUT RL_ATVCA_ODOMETER FNC_VALUES 1 FLOAT32_IEEE COLUMN_DIR DIRECT /end RECORD_LAYOUT
/begin COMPU_METHOD CU_ATVCA_ODOMETER "Conversion method for atvca_odometer" RAT_FUNC "%10.4" "m" COEFFS 0.000000 1.000000 0.000000 0.000000 0.000000 1.000000 /end COMPU_METHOD
/* Scalar calibration for DDE 'atvca_rmot_run_timer'. */
/begin CHARACTERISTIC atvca_rmot_run_timer "ICE Run Timer [sec]" VALUE 0x4002eb98 RL_ATVCA_RMOT_RUN_TIMER 2000000000.000000 CU_ATVCA_RMOT_RUN_TIMER 0.000000 2000000000.000000 BYTE_ORDER MSB_FIRST /end CHARACTERISTIC
/begin RECORD_LAYOUT RL_ATVCA_RMOT_RUN_TIMER FNC_VALUES 1 FLOAT32_IEEE COLUMN_DIR DIRECT /end RECORD_LAYOUT
/begin COMPU_METHOD CU_ATVCA_RMOT_RUN_TIMER "Conversion method for atvca_rmot_run_timer" RAT_FUNC "%10.4" "m" COEFFS 0.000000 1.000000 0.000000 0.000000 0.000000 1.000000 /end COMPU_METHOD
/* Map (1d) calibration for DDE 'atvm_currentfromrpm_z'. */
/begin CHARACTERISTIC atvm_currentfromrpm_z "(not defined)" CURVE 0x1000e0c RL_ATVM_CURRENTFROMRPM_Z 200.000000 CU_ATVM_CURRENTFROMRPM_Z 0.000000 200.000000
 /begin AXIS_DESCR COM_AXIS atv_RPM_Gen CU_ATVM_CURRENTFROMRPM_X 4 1000.000000 7500.000000 AXIS_PTS_REF APD_ATVM_CURRENTFROMRPM_X /end AXIS_DESCR
 BYTE_ORDER MSB_FIRST /end CHARACTERISTIC
/begin RECORD_LAYOUT RL_ATVM_CURRENTFROMRPM_Z FNC_VALUES 1 FLOAT32_IEEE COLUMN_DIR DIRECT /end RECORD_LAYOUT
/begin COMPU_METHOD CU_ATVM_CURRENTFROMRPM_Z "Conversion method for atvm_currentfromrpm_z" RAT_FUNC "%10.4" "A" COEFFS 0.000000 1.000000 0.000000 0.000000 0.000000 1.000000 /end COMPU_METHOD
/begin AXIS_PTS APD_ATVM_CURRENTFROMRPM_X "(not defined)" 0x1000dfc atv_RPM_Gen RL_ATVM_CURRENTFROMRPM_X 6500.000000 CU_ATVM_CURRENTFROMRPM_X 4 1000.0 7500.0 BYTE_ORDER MSB_FIRST /end AXIS_PTS
/begin RECORD_LAYOUT RL_ATVM_CURRENTFROMRPM_X AXIS_PTS_X 1 FLOAT32_IEEE INDEX_INCR DIRECT /end RECORD_LAYOUT
/begin COMPU_METHOD CU_ATVM_CURRENTFROMRPM_X "Conversion method for atvm_currentfromrpm_x" RAT_FUNC "%10.4" "rpm" COEFFS 0.000000 1.000000 0.000000 0.000000 0.000000 1.000000 /end COMPU_METHOD
/* Map (1d) calibration for DDE 'atvm_rpmfromcurrent_z'. */
/begin CHARACTERISTIC atvm_rpmfromcurrent_z "(not defined)" CURVE 0x1000e2c RL_ATVM_RPMFROMCURRENT_Z 6500.000000 CU_ATVM_RPMFROMCURRENT_Z 1000.000000 7500.000000
 /begin AXIS_DESCR COM_AXIS NO_INPUT_QUANTITY CU_ATVM_RPMFROMCURRENT_X 4 0.000000 200.000000 AXIS_PTS_REF APD_ATVM_RPMFROMCURRENT_X /end AXIS_DESCR
 BYTE_ORDER MSB_FIRST /end CHARACTERISTIC
/begin RECORD_LAYOUT RL_ATVM_RPMFROMCURRENT_Z FNC_VALUES 1 FLOAT32_IEEE COLUMN_DIR DIRECT /end RECORD_LAYOUT
/begin COMPU_METHOD CU_ATVM_RPMFROMCURRENT_Z "Conversion method for atvm_rpmfromcurrent_z" RAT_FUNC "%10.4" "rpm" COEFFS 0.000000 1.000000 0.000000 0.000000 0.000000 1.000000 /end COMPU_METHOD
/begin AXIS_PTS APD_ATVM_RPMFROMCURRENT_X "(not defined)" 0x1000e1c NO_INPUT_QUANTITY RL_ATVM_RPMFROMCURRENT_X 200.000000 CU_ATVM_RPMFROMCURRENT_X 4 0.0 200.0 BYTE_ORDER MSB_FIRST /end AXIS_PTS
/begin RECORD_LAYOUT RL_ATVM_RPMFROMCURRENT_X AXIS_PTS_X 1 FLOAT32_IEEE INDEX_INCR DIRECT /end RECORD_LAYOUT
/begin COMPU_METHOD CU_ATVM_RPMFROMCURRENT_X "Conversion method for atvm_rpmfromcurrent_x" RAT_FUNC "%10.4" "A" COEFFS 0.000000 1.000000 0.000000 0.000000 0.000000 1.000000 /end COMPU_METHOD
/* Vector/array calibration for DDE 'atvv_map'. */
/begin CHARACTERISTIC atvv_map "(not defined)" VAL_BLK 0x1002578 RL_ATVV_MAP 3.000000 CU_ATVV_MAP 0.000000 3.000000 NUMBER 2 BYTE_ORDER MSB_FIRST /end CHARACTERISTIC
/begin RECORD_LAYOUT RL_ATVV_MAP FNC_VALUES 1 UBYTE COLUMN_DIR DIRECT /end RECORD_LAYOUT
/begin COMPU_METHOD CU_ATVV_MAP "Conversion method for atvv_map" RAT_FUNC "%10.0" "one" COEFFS 0.000000 1.000000 0.000000 0.000000 0.000000 1.000000 /end COMPU_METHOD
/* Vector/array calibration for DDE 'atvva_map'. */
/begin CHARACTERISTIC atvva_map "(not defined)" VAL_BLK 0x4002eb9c RL_ATVVA_MAP 3.000000 CU_ATVVA_MAP 0.000000 3.000000 NUMBER 2 BYTE_ORDER MSB_FIRST /end CHARACTERISTIC
/begin RECORD_LAYOUT RL_ATVVA_MAP FNC_VALUES 1 UBYTE COLUMN_DIR DIRECT /end RECORD_LAYOUT
/begin COMPU_METHOD CU_ATVVA_MAP "Conversion method for atvva_map" RAT_FUNC "%10.0" "one" COEFFS 0.000000 1.000000 0.000000 0.000000 0.000000 1.000000 /end COMPU_METHOD
/* Scalar measurable for DDE 'bms_pack_soc'. */
/begin MEASUREMENT bms_pack_soc "Battery SOC" UBYTE CU_BMS_PACK_SOC 1 100 0.0 0.0 ECU_ADDRESS 0x4002292f BYTE_ORDER MSB_FIRST /end MEASUREMENT
/begin COMPU_METHOD CU_BMS_PACK_SOC "Conversion method for bms_pack_soc" RAT_FUNC "%10.0" "%" COEFFS 0.000000 1.000000 0.000000 0.000000 0.000000 1.000000 /end COMPU_METHOD
/* Scalar measurable for DDE 'bms_pack_voltage'. */
/begin MEASUREMENT bms_pack_voltage "Battery Voltage" FLOAT32_IEEE CU_BMS_PACK_VOLTAGE 1 100 0.0 0.0 ECU_ADDRESS 0x4002286c BYTE_ORDER MSB_FIRST /end MEASUREMENT
/begin COMPU_METHOD CU_BMS_PACK_VOLTAGE "Conversion method for bms_pack_voltage" RAT_FUNC "%10.0" "V" COEFFS 0.000000 1.000000 0.000000 0.000000 0.000000 1.000000 /end COMPU_METHOD
/* Scalar measurable for DDE 'bms_rolling_counter'. */
/begin MEASUREMENT bms_rolling_counter "BMS Rolling counter" UBYTE CU_BMS_ROLLING_COUNTER 1 100 0.0 0.0 ECU_ADDRESS 0x40022930 BYTE_ORDER MSB_FIRST /end MEASUREMENT
/begin COMPU_METHOD CU_BMS_ROLLING_COUNTER "Conversion method for bms_rolling_counter" RAT_FUNC "%10.0" "one" COEFFS 0.000000 1.000000 0.000000 0.000000 0.000000 1.000000 /end COMPU_METHOD
/* Scalar calibration for DDE 'isoc_emissions_report_min_sev'. */
/begin CHARACTERISTIC isoc_emissions_report_min_sev "Emissions severity report status" VALUE 0x10007ec RL_ISOC_EMISSIONS_REPORT_MIN_S0 5.000000 CU_ISOC_EMISSIONS_REPORT_MIN_S0 0.000000 5.000000 BYTE_ORDER MSB_FIRST /end CHARACTERISTIC
/begin RECORD_LAYOUT RL_ISOC_EMISSIONS_REPORT_MIN_S0 FNC_VALUES 1 UBYTE COLUMN_DIR DIRECT /end RECORD_LAYOUT
/begin COMPU_METHOD CU_ISOC_EMISSIONS_REPORT_MIN_S0 "Conversion method for isoc_emissions_report_min_sev" RAT_FUNC "%10.0" "n/a" COEFFS 0.000000 1.000000 0.000000 0.000000 0.000000 1.000000 /end COMPU_METHOD
/* Scalar calibration for DDE 'isoc_override_service_03'. */
/begin CHARACTERISTIC isoc_override_service_03 "J1979 calibration to override service $03 response.  Set this to 1 to add Previously Active DTCs to the message" VALUE 0x10007ed RL_ISOC_OVERRIDE_SERVICE_03 1.000000 CU_ISOC_OVERRIDE_SERVICE_03 0.000000 1.000000 BYTE_ORDER MSB_FIRST /end CHARACTERISTIC
/begin RECORD_LAYOUT RL_ISOC_OVERRIDE_SERVICE_03 FNC_VALUES 1 UBYTE COLUMN_DIR DIRECT /end RECORD_LAYOUT
/begin COMPU_METHOD CU_ISOC_OVERRIDE_SERVICE_03 "Conversion method for isoc_override_service_03" RAT_FUNC "%10.0" "n/a" COEFFS 0.000000 1.000000 0.000000 0.000000 0.000000 1.000000 /end COMPU_METHOD
/* Scalar calibration for DDE 'isoc_override_service_07'. */
/begin CHARACTERISTIC isoc_override_service_07 "J1979 calibration to override service $07 response.  Set this to 1 to add Active DTCs to the message" VALUE 0x10007ee RL_ISOC_OVERRIDE_SERVICE_07 1.000000 CU_ISOC_OVERRIDE_SERVICE_07 0.000000 1.000000 BYTE_ORDER MSB_FIRST /end CHARACTERISTIC
/begin RECORD_LAYOUT RL_ISOC_OVERRIDE_SERVICE_07 FNC_VALUES 1 UBYTE COLUMN_DIR DIRECT /end RECORD_LAYOUT
/begin COMPU_METHOD CU_ISOC_OVERRIDE_SERVICE_07 "Conversion method for isoc_override_service_07" RAT_FUNC "%10.0" "n/a" COEFFS 0.000000 1.000000 0.000000 0.000000 0.000000 1.000000 /end COMPU_METHOD
/* Scalar calibration for DDE 'isoc_override_service_0a'. */
/begin CHARACTERISTIC isoc_override_service_0a "J1979 calibration to override service $0A response.  Set this to 1 to add Previously Active DTCs to the message" VALUE 0x10007ef RL_ISOC_OVERRIDE_SERVICE_0A 1.000000 CU_ISOC_OVERRIDE_SERVICE_0A 0.000000 1.000000 BYTE_ORDER MSB_FIRST /end CHARACTERISTIC
/begin RECORD_LAYOUT RL_ISOC_OVERRIDE_SERVICE_0A FNC_VALUES 1 UBYTE COLUMN_DIR DIRECT /end RECORD_LAYOUT
/begin COMPU_METHOD CU_ISOC_OVERRIDE_SERVICE_0A "Conversion method for isoc_override_service_0a" RAT_FUNC "%10.0" "n/a" COEFFS 0.000000 1.000000 0.000000 0.000000 0.000000 1.000000 /end COMPU_METHOD
/* Scalar calibration for DDE 'isoc_uds_dtc_format_id'. */
/begin CHARACTERISTIC isoc_uds_dtc_format_id "Value used for DTCFormatID in NumberOfDtc UDS $19 response messages" VALUE 0x10007f0 RL_ISOC_UDS_DTC_FORMAT_ID 255.000000 CU_ISOC_UDS_DTC_FORMAT_ID 0.000000 255.000000 BYTE_ORDER MSB_FIRST /end CHARACTERISTIC
/begin RECORD_LAYOUT RL_ISOC_UDS_DTC_FORMAT_ID FNC_VALUES 1 UBYTE COLUMN_DIR DIRECT /end RECORD_LAYOUT
/begin COMPU_METHOD CU_ISOC_UDS_DTC_FORMAT_ID "Conversion method for isoc_uds_dtc_format_id" RAT_FUNC "%10.0" "n/a" COEFFS 0.000000 1.000000 0.000000 0.000000 0.000000 1.000000 /end COMPU_METHOD
/* String calibration for DDE 'mpls_app_build_time'. */
/begin CHARACTERISTIC mpls_app_build_time "Date and time of app build." ASCII 0x1000960 RL_MPLS_APP_BUILD_TIME 0 CU_MPLS_APP_BUILD_TIME 0 255 NUMBER 26 /end CHARACTERISTIC
/begin RECORD_LAYOUT RL_MPLS_APP_BUILD_TIME FNC_VALUES 1 UBYTE COLUMN_DIR DIRECT /end RECORD_LAYOUT
/begin COMPU_METHOD CU_MPLS_APP_BUILD_TIME "Conversion method for mpls_app_build_time" RAT_FUNC "%10.0" "" COEFFS 0.0 1.0 0.0 0.0 0.0 1.0 /end COMPU_METHOD
/* String calibration for DDE 'mpls_app_copyright'. */
/begin CHARACTERISTIC mpls_app_copyright "The application copyright text." ASCII 0x1000908 RL_MPLS_APP_COPYRIGHT 0 CU_MPLS_APP_COPYRIGHT 0 255 NUMBER 6 /end CHARACTERISTIC
/begin RECORD_LAYOUT RL_MPLS_APP_COPYRIGHT FNC_VALUES 1 UBYTE COLUMN_DIR DIRECT /end RECORD_LAYOUT
/begin COMPU_METHOD CU_MPLS_APP_COPYRIGHT "Conversion method for mpls_app_copyright" RAT_FUNC "%10.0" "" COEFFS 0.0 1.0 0.0 0.0 0.0 1.0 /end COMPU_METHOD
/* String calibration for DDE 'mpls_app_description'. */
/begin CHARACTERISTIC mpls_app_description "Description from the application." ASCII 0x1000900 RL_MPLS_APP_DESCRIPTION 0 CU_MPLS_APP_DESCRIPTION 0 255 NUMBER 6 /end CHARACTERISTIC
/begin RECORD_LAYOUT RL_MPLS_APP_DESCRIPTION FNC_VALUES 1 UBYTE COLUMN_DIR DIRECT /end RECORD_LAYOUT
/begin COMPU_METHOD CU_MPLS_APP_DESCRIPTION "Conversion method for mpls_app_description" RAT_FUNC "%10.0" "" COEFFS 0.0 1.0 0.0 0.0 0.0 1.0 /end COMPU_METHOD
/* String calibration for DDE 'mpls_app_name'. */
/begin CHARACTERISTIC mpls_app_name "The application name." ASCII 0x10008e4 RL_MPLS_APP_NAME 0 CU_MPLS_APP_NAME 0 255 NUMBER 25 /end CHARACTERISTIC
/begin RECORD_LAYOUT RL_MPLS_APP_NAME FNC_VALUES 1 UBYTE COLUMN_DIR DIRECT /end RECORD_LAYOUT
/begin COMPU_METHOD CU_MPLS_APP_NAME "Conversion method for mpls_app_name" RAT_FUNC "%10.0" "" COEFFS 0.0 1.0 0.0 0.0 0.0 1.0 /end COMPU_METHOD
/* String calibration for DDE 'mpls_app_version'. */
/begin CHARACTERISTIC mpls_app_version "The application version." ASCII 0x1000958 RL_MPLS_APP_VERSION 0 CU_MPLS_APP_VERSION 0 255 NUMBER 5 /end CHARACTERISTIC
/begin RECORD_LAYOUT RL_MPLS_APP_VERSION FNC_VALUES 1 UBYTE COLUMN_DIR DIRECT /end RECORD_LAYOUT
/begin COMPU_METHOD CU_MPLS_APP_VERSION "Conversion method for mpls_app_version" RAT_FUNC "%10.0" "" COEFFS 0.0 1.0 0.0 0.0 0.0 1.0 /end COMPU_METHOD
/* String calibration for DDE 'mpls_plat_build_time'. */
/begin CHARACTERISTIC mpls_plat_build_time "Date and time of platform build." ASCII 0x1002460 RL_MPLS_PLAT_BUILD_TIME 0 CU_MPLS_PLAT_BUILD_TIME 0 255 NUMBER 30 /end CHARACTERISTIC
/begin RECORD_LAYOUT RL_MPLS_PLAT_BUILD_TIME FNC_VALUES 1 UBYTE COLUMN_DIR DIRECT /end RECORD_LAYOUT
/begin COMPU_METHOD CU_MPLS_PLAT_BUILD_TIME "Conversion method for mpls_plat_build_time" RAT_FUNC "%10.0" "" COEFFS 0.0 1.0 0.0 0.0 0.0 1.0 /end COMPU_METHOD
/* String calibration for DDE 'mpls_plat_copyright'. */
/begin CHARACTERISTIC mpls_plat_copyright "Date and time of platform build." ASCII 0x1002498 RL_MPLS_PLAT_COPYRIGHT 0 CU_MPLS_PLAT_COPYRIGHT 0 255 NUMBER 29 /end CHARACTERISTIC
/begin RECORD_LAYOUT RL_MPLS_PLAT_COPYRIGHT FNC_VALUES 1 UBYTE COLUMN_DIR DIRECT /end RECORD_LAYOUT
/begin COMPU_METHOD CU_MPLS_PLAT_COPYRIGHT "Conversion method for mpls_plat_copyright" RAT_FUNC "%10.0" "" COEFFS 0.0 1.0 0.0 0.0 0.0 1.0 /end COMPU_METHOD
/* String calibration for DDE 'mpls_plat_target'. */
/begin CHARACTERISTIC mpls_plat_target "Target platform." ASCII 0x1002480 RL_MPLS_PLAT_TARGET 0 CU_MPLS_PLAT_TARGET 0 255 NUMBER 4 /end CHARACTERISTIC
/begin RECORD_LAYOUT RL_MPLS_PLAT_TARGET FNC_VALUES 1 UBYTE COLUMN_DIR DIRECT /end RECORD_LAYOUT
/begin COMPU_METHOD CU_MPLS_PLAT_TARGET "Conversion method for mpls_plat_target" RAT_FUNC "%10.0" "" COEFFS 0.0 1.0 0.0 0.0 0.0 1.0 /end COMPU_METHOD
/* String calibration for DDE 'mpls_plat_version'. */
/begin CHARACTERISTIC mpls_plat_version "Version of platform." ASCII 0x1002488 RL_MPLS_PLAT_VERSION 0 CU_MPLS_PLAT_VERSION 0 255 NUMBER 13 /end CHARACTERISTIC
/begin RECORD_LAYOUT RL_MPLS_PLAT_VERSION FNC_VALUES 1 UBYTE COLUMN_DIR DIRECT /end RECORD_LAYOUT
/begin COMPU_METHOD CU_MPLS_PLAT_VERSION "Conversion method for mpls_plat_version" RAT_FUNC "%10.0" "" COEFFS 0.0 1.0 0.0 0.0 0.0 1.0 /end COMPU_METHOD
/* Scalar calibration for DDE 'pj1939c_node_addr_0'. */
/begin CHARACTERISTIC pj1939c_node_addr_0 "J1939 node address set up during initialisation" VALUE 0x1000830 RL_PJ1939C_NODE_ADDR_0 253.000000 CU_PJ1939C_NODE_ADDR_0 0.000000 253.000000 BYTE_ORDER MSB_FIRST /end CHARACTERISTIC
/begin RECORD_LAYOUT RL_PJ1939C_NODE_ADDR_0 FNC_VALUES 1 UBYTE COLUMN_DIR DIRECT /end RECORD_LAYOUT
/begin COMPU_METHOD CU_PJ1939C_NODE_ADDR_0 "Conversion method for pj1939c_node_addr_0" RAT_FUNC "%10.0" "none" COEFFS 0.000000 1.000000 0.000000 0.000000 0.000000 1.000000 /end COMPU_METHOD
/begin FUNCTION Maps "Group /ByType/Maps"
 /begin REF_CHARACTERISTIC atvm_currentfromrpm_x atvm_currentfromrpm_z atvm_rpmfromcurrent_x atvm_rpmfromcurrent_z /end REF_CHARACTERISTIC
/end FUNCTION
/begin FUNCTION Scalars "Group /ByType/Scalars"
 /begin REF_CHARACTERISTIC atvc_ChargeOverride atvc_EndWarmUpTemp atvc_ErrTempInv atvc_ErrTempMot atvc_GenCurrent0 atvc_GenCurrent1 atvc_GenCurrent2 atvc_GenWarmUpCurrent atvc_GenWarmUpRPM atvc_HeatingMat_thr atvc_ICE_ReserveFuel atvc_ICE_Tank_Volume atvc_IceMaxSOC atvc_IceMaxTemp atvc_IceStartSOC atvc_IceStopSOC atvc_OverrideFan atvc_OverridePumpA atvc_OverridePumpB atvc_brake2epedal_split_0 atvc_brake2epedal_split_1 atvc_brake2epedal_split_2 atvc_brake2epedal_split_3 atvc_brake_pedal_gain atvc_brake_pedal_zero atvc_cell_ot atvc_cell_ov atvc_cell_ut atvc_cell_uv atvc_chg_complete atvc_chg_target_v atvc_dcMinFan atvc_fmot_run_timer_reset atvc_force_inv_preop atvc_fs1_throttle_coherency atvc_gear_ratio atvc_gen_PWM_Override atvc_gen_TEST_PWM atvc_gen_ramp_up atvc_gen_start_PID_KI atvc_gen_start_PID_KP atvc_gen_start_rpm atvc_ice_run_timer_reset atvc_maxDischCurr atvc_maxRegenCurr atvc_maxTempInv atvc_maxTempMotor atvc_max_footbrake_trq atvc_max_gen_neutral_trq atvc_max_gen_reg_trq atvc_max_gen_trq atvc_max_neutralbrake_trq atvc_max_soc atvc_max_trq_front atvc_max_trq_rear atvc_minTempInv atvc_minTempMotor atvc_min_soc atvc_odometer_reset atvc_rmot_run_timer_reset atvc_tempSwitchOffFan atvc_tempSwitchOnFan atvc_throttleFull atvc_throttleNeutralPoint atvc_throttleZero atvc_velocityLimitFwd atvc_velocityLimitRwd atvc_wheel_radius /end REF_CHARACTERISTIC
/end FUNCTION
/begin FUNCTION Signals "Group /ByType/Signals"
 /begin LOC_MEASUREMENT atv_12v atv_4wd_din atv_GenCurrentSetPoint atv_GenSelProcessed atv_HandBrakePos atv_HandBrakeStatus atv_ICE_Start_Timer atv_ICE_Start_Timer_Valid atv_IceFault atv_IceKey_out atv_IceOn atv_IceRG atv_IceSM atv_IceShutdown_out atv_PumpAFault atv_PumpBFault atv_RPM_Gen atv_RegMapSelProcessed atv_TRad_in atv_TRad_out atv_T_Air atv_T_ICE atv_app_code_day atv_app_code_major_ver atv_app_code_minor_ver atv_app_code_month atv_app_code_subminor_ver atv_app_code_year atv_apu_req_in atv_bmsMaxChgCurr atv_bmsMaxDisCurr atv_boot_code_day atv_boot_code_major_ver atv_boot_code_minor_ver atv_boot_code_month atv_boot_code_subminor_ver atv_boot_code_year atv_brake2epedal_split_actual atv_brake_pedalX1000 atv_brake_pedal_digital_in atv_can_wakeup atv_chg_present atv_cpu_loading atv_cpu_loading_max atv_dbg_pumpA_out atv_dbg_pumpB_out atv_en_dcdc_out atv_fmot_run_timer atv_footBrake_X1000_out atv_fs1_in atv_fs1_out atv_fuel_level atv_fuel_qty atv_fuel_reserve atv_ice_rpm_req atv_ice_run_timer atv_map atv_max_cell atv_min_cell atv_motoring_x1000_front atv_motoring_x1000_front_final atv_motoring_x1000_rear atv_motoring_x1000_rear_final atv_mtr_current_limit atv_odometer atv_platform_code_day atv_platform_code_major_ver atv_platform_code_minor_ver atv_platform_code_month atv_platform_code_subminor_ver atv_platform_code_year atv_pm_0 atv_pm_1 atv_pm_2 atv_pm_Electric atv_pm_Hybrid atv_pm_PreOp atv_pm_Stealth atv_pm_g atv_pm_s1 atv_pm_s2 atv_pm_s3 atv_prg_code_day atv_prg_code_major_ver atv_prg_code_minor_ver atv_prg_code_month atv_prg_code_subminor_ver atv_prg_code_year atv_reg_current_limit atv_regen_x1000_front atv_regen_x1000_rear atv_regmap atv_rmot_run_timer atv_runLed_out atv_stack_used atv_startBtnArmed atv_startConditions atv_state_out atv_sub_state_out atv_task_duration_1s atv_task_duration_1s_max atv_throttleGen_X1000_out atv_throttleX1000 atv_v_dbg_chg_req atv_v_dbg_heater_req atv_vehicle_SOC atv_wakelock_out atv_xa1_ain_throttle_raw atv_xa3_brake_pedal_raw_ain atv_xc1_raw_ain atv_xc4_raw_ain atv_xd1_key_ain atv_xd2 atv_xd3_raw_ain atv_xe2_raw_ain atv_xe3_ain atv_xe4_raw_ain atv_xf4 atv_yb3_raw_ain atv_ye2 atv_yg1 atv_yg2 atv_yg3_raw_ain atv_yh2 atv_yj2 atv_za2 atv_za3_StartBtn_din atv_zb2 atv_zb3 atv_zc2 atv_zc4 atv_zd1_ain atv_ze3 atv_ze4 bms_pack_soc bms_pack_voltage bms_rolling_counter /end LOC_MEASUREMENT
/end FUNCTION
/begin FUNCTION ByType "Group /ByType" /begin SUB_FUNCTION Adaptives Automatic Maps Scalars Signals /end SUB_FUNCTION /end FUNCTION
/begin FUNCTION Others "Group /Others"
 /begin REF_CHARACTERISTIC atvc_ICE_dragging_time atvc_IceOffTh atvc_IceOnTh atvc_IceStartRetry atvc_StartThrottleIce atvc_an_in_sel_his atvc_an_in_sel_th atvc_brakePedalHis atvc_brakePedalOn atvc_footBrakeIce atvc_footBrakeWarmUp /end REF_CHARACTERISTIC
/end FUNCTION
/end MODULE
/end PROJECT
